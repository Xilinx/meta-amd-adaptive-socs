## meta-amd-adaptive-socs-bsp/conf/machine/versal-v80-multidomain.conf
```bitbake
#@TYPE: Machine
#@NAME: versal-v80-multidomain
#@DESCRIPTION: Machine configuration for the versal-v80-multidomain boards.


BBMULTICONFIG += "versal-v80-multidomain-microblaze-pmc versal-v80-multidomain-microblaze-psm versal-v80-multidomain-cortexr5-0-freertos versal-v80-multidomain-cortexr5-1-baremetal"
MACHINEOVERRIDES .= ":versal-v80-sdt-seg"

#### Preamble
MACHINEOVERRIDES =. "${@['', 'versal-v80-multidomain:']['versal-v80-multidomain' !='${MACHINE}']}"
#### Regular settings follow
TUNEFILE[microblaze-pmc] = "conf/machine/include/versal-v80-multidomain/microblaze.inc"
TUNEFILE[microblaze-psm] = "conf/machine/include/versal-v80-multidomain/microblaze.inc"

# Platform Loader and Manager
PLM_DEPENDS = ""
PLM_MCDEPENDS = "mc::versal-v80-multidomain-microblaze-pmc:plm-firmware:do_deploy"
PLM_DEPLOY_DIR = "${TMPDIR}-versal-v80-multidomain-microblaze-pmc/deploy/images/${MACHINE}"

# PSM Firmware
PSM_DEPENDS = ""
PSM_MCDEPENDS = "mc::versal-v80-multidomain-microblaze-psm:psm-firmware:do_deploy"
PSM_FIRMWARE_DEPLOY_DIR = "${TMPDIR}-versal-v80-multidomain-microblaze-psm/deploy/images/${MACHINE}"

# Set the default (linux) domain device tree
CONFIG_DTFILE_DIR := "${@bb.utils.which(d.getVar('BBPATH'), 'conf/dts/versal-v80-multidomain')}"
CONFIG_DTFILE ?= "${CONFIG_DTFILE_DIR}/cortexa72-linux.dts"
CONFIG_DTFILE[vardepsexclude] += "CONFIG_DTFILE_DIR"

# Serial Console Settings
SERIAL_CONSOLES ?= "115200;ttyAMA0"

# Yocto arm-trusted-firmware(TF-A) variables
TFA_CONSOLE ?= "pl011"
TFA_BL33_LOAD ?= "0x8000000"

# Yocto u-boot-xlnx variables

# Set DDR Base address for u-boot-xlnx-scr variables
DDR_BASEADDR ?= "0x0"
SKIP_APPEND_BASEADDR ?= "0"

# Yocto KERNEL Variables
UBOOT_ENTRYPOINT ?= "0x200000"
UBOOT_LOADADDRESS ?= "0x200000"

# Yocto MACHINE_FEATURES Variable
MACHINE_FEATURES += "fpga-overlay efi"

# Required generic machine inclusion
require conf/machine/versal-generic.conf

QB_MEM = "-m 8G"
QEMU_HW_DTB_PS = "${QEMU_HW_DTB_PATH}/board-versal-ps-v80.dtb"
QEMU_HW_DTB_PMC = "${QEMU_HW_DTB_PATH}/board-versal-pmc-virt.dtb"
QEMU_HW_OSPI_FILE = "qemu-ospi-${MACHINE}.bin"
QB_OPT_APPEND:append := " -drive file=@DEPLOY_DIR_IMAGE@/${QEMU_HW_OSPI_FILE},if=mtd,format=raw,index=4"
QB_ROOTFS_OPT = "-drive if=sd,index=2,file=@ROOTFS@,format=raw"

# This is an 'SDT' based BSP
XILINX_WITH_ESW = "sdt"

# Original SDT artifacts URL
SDT_URI = "https://edf.amd.com/sswreleases/rel-v2026.1/sdt/2026.1/2026.1_0308_1_03090000/external/versal-v80-sdt-seg/versal-v80-sdt-seg_2026.1_0308_1_03090000.tar.gz"
SDT_URI[sha256sum] = "bc21f2d6432c32f4b793c4cb51ce01ec45ee1b7536277a734add1f1b8064aacf"
SDT_URI[S] = "${WORKDIR}/versal-v80-sdt-seg_2026.1_0308_1_03090000"

# Set the system device trees
SYSTEM_DTFILE_DEPENDS = "sdt-artifacts"
SYSTEM_DTFILE_DIR = "${RECIPE_SYSROOT}${datadir}/sdt/${MACHINE}"
SYSTEM_DTFILE = "${SYSTEM_DTFILE_DIR}/system-top.dts"

# Load the dynamic machine features
include conf/machine/include/versal-v80-multidomain/${BB_CURRENT_MC}-features.conf
LIBXIL_CONFIG = "conf/machine/include/versal-v80-multidomain/${BB_CURRENT_MC}-libxil.conf"

# PDI variables
PDI_PATH_DEPENDS = "sdt-artifacts"
PDI_PATH_DIR = "${RECIPE_SYSROOT}${datadir}/sdt/${MACHINE}"
PDI_PATH = "${PDI_PATH_DIR}/v80_base_boot.pdi"

# Primary Bootmode value
DEFAULT_HW_BOOT_MODE = "8"

# Update bootbin to use proper device tree
BIF_PARTITION_IMAGE[device-tree] = "${RECIPE_SYSROOT}/boot/devicetree/${@os.path.basename(d.getVar('CONFIG_DTFILE').replace('.dts', '.dtb'))}"

# Remap boot files to ensure the right device tree is listed first
IMAGE_BOOT_FILES =+ "devicetree/${@os.path.basename(d.getVar('CONFIG_DTFILE').replace('.dts', '.dtb'))}"
PACKAGE_EXTRA_ARCHS:append = " versal_v80_sdt_seg"

#### No additional settings should be after the Postamble
#### Postamble
PACKAGE_EXTRA_ARCHS:append = "${@['', ' versal_v80_multidomain']['versal-v80-multidomain' != '${MACHINE}']}"
```

## meta-amd-adaptive-socs-bsp/conf/machine/versal-vmk180-md.conf
```bitbake
#@TYPE: Machine
#@NAME: versal-vmk180-md
#@DESCRIPTION: Machine configuration for the versal-vmk180-md boards.


BBMULTICONFIG += "versal-vmk180-md-microblaze-pmc versal-vmk180-md-microblaze-psm versal-vmk180-md-cortexr5-0-freertos versal-vmk180-md-cortexr5-1-baremetal"
MACHINEOVERRIDES .= ":versal-vmk180-sdt-seg"

#### Preamble
MACHINEOVERRIDES =. "${@['', 'versal-vmk180-md:']['versal-vmk180-md' !='${MACHINE}']}"
#### Regular settings follow
TUNEFILE[microblaze-pmc] = "conf/machine/include/versal-vmk180-md/microblaze.inc"
TUNEFILE[microblaze-psm] = "conf/machine/include/versal-vmk180-md/microblaze.inc"

# Platform Loader and Manager
PLM_DEPENDS = ""
PLM_MCDEPENDS = "mc::versal-vmk180-md-microblaze-pmc:plm-firmware:do_deploy"
PLM_DEPLOY_DIR = "${TMPDIR}-versal-vmk180-md-microblaze-pmc/deploy/images/${MACHINE}"

# PSM Firmware
PSM_DEPENDS = ""
PSM_MCDEPENDS = "mc::versal-vmk180-md-microblaze-psm:psm-firmware:do_deploy"
PSM_FIRMWARE_DEPLOY_DIR = "${TMPDIR}-versal-vmk180-md-microblaze-psm/deploy/images/${MACHINE}"

# Set the default (linux) domain device tree
CONFIG_DTFILE_DIR := "${@bb.utils.which(d.getVar('BBPATH'), 'conf/dts/versal-vmk180-md')}"
CONFIG_DTFILE ?= "${CONFIG_DTFILE_DIR}/cortexa72-linux.dts"
CONFIG_DTFILE[vardepsexclude] += "CONFIG_DTFILE_DIR"

# Serial Console Settings
SERIAL_CONSOLES ?= "115200;ttyAMA0"

# Yocto arm-trusted-firmware(TF-A) variables
TFA_CONSOLE ?= "pl011"
TFA_BL33_LOAD ?= "0x8000000"

# Yocto u-boot-xlnx variables

# Set DDR Base address for u-boot-xlnx-scr variables
DDR_BASEADDR ?= "0x0"
SKIP_APPEND_BASEADDR ?= "0"

# Yocto KERNEL Variables
UBOOT_ENTRYPOINT ?= "0x200000"
UBOOT_LOADADDRESS ?= "0x200000"

# Yocto MACHINE_FEATURES Variable
MACHINE_FEATURES += "fpga-overlay efi"

# Required generic machine inclusion
require conf/machine/versal-generic.conf

QB_MEM = "-m 8G"
QEMU_HW_DTB_PS = "${QEMU_HW_DTB_PATH}/board-versal-ps-vmk180.dtb"
QEMU_HW_DTB_PMC = "${QEMU_HW_DTB_PATH}/board-versal-pmc-virt.dtb"
QB_ROOTFS_OPT = "-drive if=sd,index=1,file=@ROOTFS@,format=raw"

# This is an 'SDT' based BSP
XILINX_WITH_ESW = "sdt"

# Original SDT artifacts URL
SDT_URI = "https://edf.amd.com/sswreleases/rel-v2026.1/sdt/2026.1/2026.1_0225_1_02260207/external/versal-vmk180-sdt-seg/versal-vmk180-sdt-seg_2026.1_0225_1_02260207.tar.gz"
SDT_URI[sha256sum] = "07ce28c2fc14216b498e7216508d89aee869f6d8dee3f73fa551dc4b4de6d550"
SDT_URI[S] = "${WORKDIR}/versal-vmk180-sdt-seg_2026.1_0225_1_02260207"

# Set the system device trees
SYSTEM_DTFILE_DEPENDS = "sdt-artifacts"
SYSTEM_DTFILE_DIR = "${RECIPE_SYSROOT}${datadir}/sdt/${MACHINE}"
SYSTEM_DTFILE = "${SYSTEM_DTFILE_DIR}/system-top.dts"

# Load the dynamic machine features
include conf/machine/include/versal-vmk180-md/${BB_CURRENT_MC}-features.conf
LIBXIL_CONFIG = "conf/machine/include/versal-vmk180-md/${BB_CURRENT_MC}-libxil.conf"

# PDI variables
PDI_PATH_DEPENDS = "sdt-artifacts"
PDI_PATH_DIR = "${RECIPE_SYSROOT}${datadir}/sdt/${MACHINE}"
PDI_PATH = "${PDI_PATH_DIR}/vmk180_base_boot.pdi"

# Primary Bootmode value
DEFAULT_HW_BOOT_MODE = "5"

# Update bootbin to use proper device tree
BIF_PARTITION_IMAGE[device-tree] = "${RECIPE_SYSROOT}/boot/devicetree/${@os.path.basename(d.getVar('CONFIG_DTFILE').replace('.dts', '.dtb'))}"

# Remap boot files to ensure the right device tree is listed first
IMAGE_BOOT_FILES =+ "devicetree/${@os.path.basename(d.getVar('CONFIG_DTFILE').replace('.dts', '.dtb'))}"
PACKAGE_EXTRA_ARCHS:append = " versal_vmk180_sdt_seg"

#### No additional settings should be after the Postamble
#### Postamble
PACKAGE_EXTRA_ARCHS:append = "${@['', ' versal_vmk180_md']['versal-vmk180-md' != '${MACHINE}']}"
```

## meta-amd-adaptive-socs-bsp/conf/machine/versal-vmk180-multidomain.conf
```bitbake
#@TYPE: Machine
#@NAME: versal-vmk180-multidomain
#@DESCRIPTION: Machine configuration for the versal-vmk180-multidomain boards.


BBMULTICONFIG += "versal-vmk180-multidomain-microblaze-pmc versal-vmk180-multidomain-microblaze-psm versal-vmk180-multidomain-cortexr5-0-freertos versal-vmk180-multidomain-cortexr5-1-baremetal"
MACHINEOVERRIDES .= ":versal-vmk180-sdt-seg"

#### Preamble
MACHINEOVERRIDES =. "${@['', 'versal-vmk180-multidomain:']['versal-vmk180-multidomain' !='${MACHINE}']}"
#### Regular settings follow
TUNEFILE[microblaze-pmc] = "conf/machine/include/versal-vmk180-multidomain/microblaze.inc"
TUNEFILE[microblaze-psm] = "conf/machine/include/versal-vmk180-multidomain/microblaze.inc"

# Platform Loader and Manager
PLM_DEPENDS = ""
PLM_MCDEPENDS = "mc::versal-vmk180-multidomain-microblaze-pmc:plm-firmware:do_deploy"
PLM_DEPLOY_DIR = "${TMPDIR}-versal-vmk180-multidomain-microblaze-pmc/deploy/images/${MACHINE}"

# PSM Firmware
PSM_DEPENDS = ""
PSM_MCDEPENDS = "mc::versal-vmk180-multidomain-microblaze-psm:psm-firmware:do_deploy"
PSM_FIRMWARE_DEPLOY_DIR = "${TMPDIR}-versal-vmk180-multidomain-microblaze-psm/deploy/images/${MACHINE}"

# Set the default (linux) domain device tree
CONFIG_DTFILE_DIR := "${@bb.utils.which(d.getVar('BBPATH'), 'conf/dts/versal-vmk180-multidomain')}"
CONFIG_DTFILE ?= "${CONFIG_DTFILE_DIR}/cortexa72-linux.dts"
CONFIG_DTFILE[vardepsexclude] += "CONFIG_DTFILE_DIR"

# Serial Console Settings
SERIAL_CONSOLES ?= "115200;ttyAMA0"

# Yocto arm-trusted-firmware(TF-A) variables
TFA_CONSOLE ?= "pl011"
TFA_BL33_LOAD ?= "0x8000000"

# Yocto u-boot-xlnx variables

# Set DDR Base address for u-boot-xlnx-scr variables
DDR_BASEADDR ?= "0x0"
SKIP_APPEND_BASEADDR ?= "0"

# Yocto KERNEL Variables
UBOOT_ENTRYPOINT ?= "0x200000"
UBOOT_LOADADDRESS ?= "0x200000"

# Yocto MACHINE_FEATURES Variable
MACHINE_FEATURES += "fpga-overlay efi"

# Required generic machine inclusion
require conf/machine/versal-generic.conf

# QEMU Memory Configuration
QB_MEM = "-machine dynamic-mem=on -device amd-ddr-memory,address=0x800000000,size=0x180000000 -device amd-ddr-memory,address=0x50000000000,size=0x100000000 -device amd-ddr-memory,address=0x60000000000,size=0x100000000"

QEMU_HW_DTB_PS = "${QEMU_HW_DTB_PATH}/board-versal-ps-vmk180.dtb"
QEMU_HW_DTB_PMC = "${QEMU_HW_DTB_PATH}/board-versal-pmc-virt.dtb"
# Enable libmetal application
BOOTBIN_INC = "libmetal-demo-rpu1.inc"

# This is an 'SDT' based BSP
XILINX_WITH_ESW = "sdt"

# Original SDT artifacts URL
SDT_URI = "https://edf.amd.com/sswreleases/rel-v2026.1/sdt/2026.1/2026.1_0406_1_04061619/external/versal-vmk180-sdt-seg/versal-vmk180-sdt-seg_2026.1_0406_1_04061619.tar.gz"
SDT_URI[sha256sum] = "b4ead1f7120c89bf795d000a7cb42c9afac01e55feb2f97ec6de8bcc0c9de5df"
SDT_URI[S] = "${WORKDIR}/versal-vmk180-sdt-seg_2026.1_0406_1_04061619"

# Set the system device trees
SYSTEM_DTFILE_DEPENDS = "sdt-artifacts"
SYSTEM_DTFILE_DIR = "${RECIPE_SYSROOT}${datadir}/sdt/${MACHINE}"
SYSTEM_DTFILE = "${SYSTEM_DTFILE_DIR}/system-top.dts"

# Load the dynamic machine features
include conf/machine/include/versal-vmk180-multidomain/${BB_CURRENT_MC}-features.conf
LIBXIL_CONFIG = "conf/machine/include/versal-vmk180-multidomain/${BB_CURRENT_MC}-libxil.conf"

# PDI variables
PDI_PATH_DEPENDS = "sdt-artifacts"
PDI_PATH_DIR = "${RECIPE_SYSROOT}${datadir}/sdt/${MACHINE}"
PDI_PATH = "${PDI_PATH_DIR}/vmk180_base_boot.pdi"

# Primary Bootmode value
DEFAULT_HW_BOOT_MODE = "5"

# Update bootbin to use proper device tree
BIF_PARTITION_IMAGE[device-tree] = "${RECIPE_SYSROOT}/boot/devicetree/${@os.path.basename(d.getVar('CONFIG_DTFILE').replace('.dts', '.dtb'))}"

# Remap boot files to ensure the right device tree is listed first
IMAGE_BOOT_FILES =+ "devicetree/${@os.path.basename(d.getVar('CONFIG_DTFILE').replace('.dts', '.dtb'))}"
PACKAGE_EXTRA_ARCHS:append = " versal_vmk180_sdt_seg"

#### No additional settings should be after the Postamble
#### Postamble
PACKAGE_EXTRA_ARCHS:append = "${@['', ' versal_vmk180_multidomain']['versal-vmk180-multidomain' != '${MACHINE}']}"
```

## meta-amd-adaptive-socs-bsp/conf/machine/versal-vmk180-sdt-seg.conf
```bitbake
#@TYPE: Machine
#@NAME: versal-vmk180-sdt-seg
#@DESCRIPTION: Machine configuration for the versal-vmk180-sdt-seg boards.


BBMULTICONFIG += "versal-vmk180-sdt-seg-microblaze-pmc versal-vmk180-sdt-seg-microblaze-psm versal-vmk180-sdt-seg-cortexr5-0-freertos"

#### Preamble
MACHINEOVERRIDES =. "${@['', 'versal-vmk180-sdt-seg:']['versal-vmk180-sdt-seg' !='${MACHINE}']}"
#### Regular settings follow
TUNEFILE[microblaze-pmc] = "conf/machine/include/versal-vmk180-sdt-seg/microblaze.inc"
TUNEFILE[microblaze-psm] = "conf/machine/include/versal-vmk180-sdt-seg/microblaze.inc"

# Platform Loader and Manager
PLM_DEPENDS = ""
PLM_MCDEPENDS = "mc::versal-vmk180-sdt-seg-microblaze-pmc:plm-firmware:do_deploy"
PLM_DEPLOY_DIR = "${TMPDIR}-versal-vmk180-sdt-seg-microblaze-pmc/deploy/images/${MACHINE}"

# PSM Firmware
PSM_DEPENDS = ""
PSM_MCDEPENDS = "mc::versal-vmk180-sdt-seg-microblaze-psm:psm-firmware:do_deploy"
PSM_FIRMWARE_DEPLOY_DIR = "${TMPDIR}-versal-vmk180-sdt-seg-microblaze-psm/deploy/images/${MACHINE}"

# Set the default (linux) domain device tree
CONFIG_DTFILE_DIR := "${@bb.utils.which(d.getVar('BBPATH'), 'conf/dts/versal-vmk180-sdt-seg')}"
CONFIG_DTFILE ?= "${CONFIG_DTFILE_DIR}/cortexa72-linux.dts"
CONFIG_DTFILE[vardepsexclude] += "CONFIG_DTFILE_DIR"

# Serial Console Settings
SERIAL_CONSOLES ?= "115200;ttyAMA0"

# Yocto arm-trusted-firmware(TF-A) variables
TFA_CONSOLE ?= "pl011"
TFA_BL33_LOAD ?= "0x8000000"

# Yocto u-boot-xlnx variables

# Set DDR Base address for u-boot-xlnx-scr variables
DDR_BASEADDR ?= "0x0"
SKIP_APPEND_BASEADDR ?= "0"

# Yocto KERNEL Variables
UBOOT_ENTRYPOINT  ?= "0x200000"
UBOOT_LOADADDRESS ?= "0x200000"

# Yocto MACHINE_FEATURES Variable
MACHINE_FEATURES += "fpga-overlay"

# Required generic machine inclusion
require conf/machine/versal-generic.conf

# Enable meta-xilinx-imgrcvry if available
include conf/enable-xilinx-imgrcvry.conf
QB_MEM = "-m 8G"
QEMU_HW_DTB_PS = "${QEMU_HW_DTB_PATH}/board-versal-ps-vmk180.dtb"
QEMU_HW_DTB_PMC = "${QEMU_HW_DTB_PATH}/board-versal-pmc-virt.dtb"
QB_ROOTFS_OPT = "-drive if=sd,index=1,file=@ROOTFS@,format=raw"

# This is an 'SDT' based BSP
XILINX_WITH_ESW = "sdt"

# Original SDT artifacts URL
SDT_URI = "https://edf.amd.com/sswreleases/rel-v2026.1/sdt/2026.1/2026.1_0110_1_01110000/external/versal-vmk180-sdt-seg/versal-vmk180-sdt-seg_2026.1_0110_1_01110000.tar.gz"
SDT_URI[sha256sum] = "6d198841fe207309d9f438f015dd3e1c8e961a7f62a6f8acda03f12b5558e9a8"
SDT_URI[S] = "${WORKDIR}/versal-vmk180-sdt-seg_2026.1_0110_1_01110000"

# Set the system device trees
SYSTEM_DTFILE_DEPENDS = "sdt-artifacts"
SYSTEM_DTFILE_DIR = "${RECIPE_SYSROOT}${datadir}/sdt/${MACHINE}"
SYSTEM_DTFILE = "${SYSTEM_DTFILE_DIR}/system-top.dts"

# Load the dynamic machine features
include conf/machine/include/versal-vmk180-sdt-seg/${BB_CURRENT_MC}-features.conf
LIBXIL_CONFIG = "conf/machine/include/versal-vmk180-sdt-seg/${BB_CURRENT_MC}-libxil.conf"

# Versal PDI
PDI_PATH_DEPENDS = "sdt-artifacts"
PDI_PATH_DIR = "${RECIPE_SYSROOT}${datadir}/sdt/${MACHINE}"
PDI_PATH = "${PDI_PATH_DIR}/vmk180_base_boot.pdi"

# Update bootbin to use proper device tree
BIF_PARTITION_IMAGE[device-tree] = "${RECIPE_SYSROOT}/boot/devicetree/${@os.path.basename(d.getVar('CONFIG_DTFILE').replace('.dts', '.dtb'))}"

# Remap boot files to ensure the right device tree is listed first
IMAGE_BOOT_FILES =+ "devicetree/${@os.path.basename(d.getVar('CONFIG_DTFILE').replace('.dts', '.dtb'))}"

#### No additional settings should be after the Postamble
#### Postamble
PACKAGE_EXTRA_ARCHS:append = "${@['', ' versal_vmk180_sdt_seg']['versal-vmk180-sdt-seg' != '${MACHINE}']}"
```
