## meta-amd-adaptive-socs-bsp/conf/machine/zynqmp-zcu102-md.conf
```bitbake
#@TYPE: Machine
#@NAME: zynqmp-zcu102-md
#@DESCRIPTION: Machine configuration for the zynqmp-zcu102-md boards.


BBMULTICONFIG += "zynqmp-zcu102-md-cortexa53-fsbl zynqmp-zcu102-md-microblaze-pmu"
MACHINEOVERRIDES .= ":zynqmp-zcu102-sdt-full"

#### Preamble
MACHINEOVERRIDES =. "${@['', 'zynqmp-zcu102-md:']['zynqmp-zcu102-md' !='${MACHINE}']}"
#### Regular settings follow
TUNEFILE[microblaze-pmu] = "conf/machine/include/zynqmp-zcu102-md/microblaze.inc"

# First Stage Boot Loader
FSBL_DEPENDS = ""
FSBL_MCDEPENDS = "mc::zynqmp-zcu102-md-cortexa53-fsbl:fsbl-firmware:do_deploy"
FSBL_DEPLOY_DIR = "${TMPDIR}-zynqmp-zcu102-md-cortexa53-fsbl/deploy/images/${MACHINE}"

# PMU Firmware
PMU_DEPENDS = ""
PMU_MCDEPENDS = "mc::zynqmp-zcu102-md-microblaze-pmu:pmu-firmware:do_deploy"
PMU_FIRMWARE_DEPLOY_DIR = "${TMPDIR}-zynqmp-zcu102-md-microblaze-pmu/deploy/images/${MACHINE}"

# Set the default (linux) domain device tree
CONFIG_DTFILE_DIR := "${@bb.utils.which(d.getVar('BBPATH'), 'conf/dts/zynqmp-zcu102-md')}"
CONFIG_DTFILE ?= "${CONFIG_DTFILE_DIR}/cortexa53-linux.dts"
CONFIG_DTFILE[vardepsexclude] += "CONFIG_DTFILE_DIR"

# Serial Console Settings
SERIAL_CONSOLES ?= "115200;ttyPS0"

# Yocto arm-trusted-firmware(TF-A) variables
TFA_CONSOLE ?= "cadence"
TFA_BL33_LOAD ?= "0x8000000"

# Yocto u-boot-xlnx variables

# Set DDR Base address for u-boot-xlnx-scr variables
DDR_BASEADDR ?= "0x0"
SKIP_APPEND_BASEADDR ?= "0"

# Yocto KERNEL Variables
UBOOT_ENTRYPOINT ?= "0x200000"
UBOOT_LOADADDRESS ?= "0x200000"

# Yocto MACHINE_FEATURES Variable
MACHINE_FEATURES += "mali400 fpga-overlay efi"

# Required generic machine inclusion
require conf/machine/zynqmp-generic.conf

QB_MEM = "-m 4G"
QEMU_HW_DTB_PS = "${QEMU_HW_DTB_PATH}/board-zynqmp-zcu102.dtb"
QEMU_HW_DTB_PMU = "${QEMU_HW_DTB_PATH}/zynqmp-pmu.dtb"

# This is an 'SDT' based BSP
XILINX_WITH_ESW = "sdt"

# Original SDT artifacts URL
SDT_URI = "https://edf.amd.com/sswreleases/rel-v2026.1/sdt/2026.1/2026.1_0217_1_02181146/external/zynqmp-zcu102-sdt-full/zynqmp-zcu102-sdt-full_2026.1_0217_1_02181146.tar.gz"
SDT_URI[sha256sum] = "68016e0cc08999c821973a3fc567933599c0a1efc72ccf9c971b2a8e3a8607e7"
SDT_URI[S] = "${WORKDIR}/zynqmp-zcu102-sdt-full_2026.1_0217_1_02181146"

# Set the system device trees
SYSTEM_DTFILE_DEPENDS = "sdt-artifacts"
SYSTEM_DTFILE_DIR = "${RECIPE_SYSROOT}${datadir}/sdt/${MACHINE}"
SYSTEM_DTFILE = "${SYSTEM_DTFILE_DIR}/system-top.dts"

# Load the dynamic machine features
include conf/machine/include/zynqmp-zcu102-md/${BB_CURRENT_MC}-features.conf
LIBXIL_CONFIG = "conf/machine/include/zynqmp-zcu102-md/${BB_CURRENT_MC}-libxil.conf"

# Update bootbin to use proper device tree
BIF_PARTITION_IMAGE[device-tree] = "${RECIPE_SYSROOT}/boot/devicetree/${@os.path.basename(d.getVar('CONFIG_DTFILE').replace('.dts', '.dtb'))}"

# Remap boot files to ensure the right device tree is listed first
IMAGE_BOOT_FILES =+ "devicetree/${@os.path.basename(d.getVar('CONFIG_DTFILE').replace('.dts', '.dtb'))}"
PACKAGE_EXTRA_ARCHS:append = " zynqmp_zcu102_sdt_full"

#### No additional settings should be after the Postamble
#### Postamble
PACKAGE_EXTRA_ARCHS:append = "${@['', ' zynqmp_zcu102_md']['zynqmp-zcu102-md' != '${MACHINE}']}"
```

## meta-amd-adaptive-socs-bsp/conf/machine/zynqmp-zcu104-multidomain.conf
```bitbake
#@TYPE: Machine
#@NAME: zynqmp-zcu104-multidomain
#@DESCRIPTION: AMP/multidomain machine for the AMD Zynq UltraScale+ MPSoC ZCU104 evaluation kit: Cortex-A53 Linux plus Cortex-A53 FSBL and MicroBlaze PMU sub-machines built from system device tree.

BBMULTICONFIG += "zynqmp-zcu104-multidomain-cortexa53-fsbl zynqmp-zcu104-multidomain-cortexr5-0-zephyr zynqmp-zcu104-multidomain-cortexr5-1-baremetal zynqmp-zcu104-multidomain-microblaze-pmu"
MACHINEOVERRIDES .= ":zynqmp-zcu104-sdt-full"

#### Preamble
MACHINEOVERRIDES =. "${@['', 'zynqmp-zcu104-multidomain:']['zynqmp-zcu104-multidomain' !='${MACHINE}']}"
#### Regular settings follow
TUNEFILE[microblaze-pmu] = "conf/machine/include/zynqmp-zcu104-multidomain/microblaze.inc"

# First Stage Boot Loader
FSBL_DEPENDS = ""
FSBL_MCDEPENDS = "mc::zynqmp-zcu104-multidomain-cortexa53-fsbl:fsbl-firmware:do_deploy"
FSBL_DEPLOY_DIR = "${TMPDIR}-zynqmp-zcu104-multidomain-cortexa53-fsbl/deploy/images/${MACHINE}"

# PMU Firmware
PMU_DEPENDS = ""
PMU_MCDEPENDS = "mc::zynqmp-zcu104-multidomain-microblaze-pmu:pmu-firmware:do_deploy"
PMU_FIRMWARE_DEPLOY_DIR = "${TMPDIR}-zynqmp-zcu104-multidomain-microblaze-pmu/deploy/images/${MACHINE}"

# Set the default (linux) domain device tree
CONFIG_DTFILE_DIR := "${@bb.utils.which(d.getVar('BBPATH'), 'conf/dts/zynqmp-zcu104-multidomain')}"
CONFIG_DTFILE ?= "${CONFIG_DTFILE_DIR}/cortexa53-linux.dts"
CONFIG_DTFILE[vardepsexclude] += "CONFIG_DTFILE_DIR"

DTB_FILE_PATH ?= "${RECIPE_SYSROOT}/boot/devicetree/${@os.path.basename(d.getVar('CONFIG_DTFILE').replace('.dts', '.dtb'))}"

# Serial Console Settings
SERIAL_CONSOLES ?= "115200;ttyPS0"

# Yocto arm-trusted-firmware(TF-A) variables
TFA_CONSOLE ?= "cadence"
TFA_BL33_LOAD ?= "0x8000000"

# Yocto u-boot-xlnx variables
UBOOT_USER_SPECIFIED_TEXT_BASE ?= "0x8000000"

# Set DDR Base address for u-boot-xlnx-scr variables
DDR_BASEADDR ?= "0x0"
SKIP_APPEND_BASEADDR ?= "0"

# Yocto KERNEL Variables
UBOOT_ENTRYPOINT ?= "0x200000"
UBOOT_LOADADDRESS ?= "0x200000"

# Yocto MACHINE_FEATURES Variable
MACHINE_FEATURES += "mali400 vcu fpga-overlay efi"

# Yocto MACHINE_HWCODECS Variable
MACHINE_HWCODECS ?= "libvcu-omxil"

# Required generic machine inclusion
require conf/machine/zynqmp-generic.conf

QB_MEM = "-m 4G"
QEMU_HW_DTB_PS = "${QEMU_HW_DTB_PATH}/board-zynqmp-zcu104.dtb"
QEMU_HW_DTB_PMU = "${QEMU_HW_DTB_PATH}/zynqmp-pmu.dtb"
# Enable libmetal application
BOOTBIN_INC = "libmetal-demo-rpu1.inc"
# Enable meta-xilinx-imgrcvry if available
include conf/enable-xilinx-imgrcvry.conf
# Enable QSPI flash
CFLAGS:append:pn-image-selector = " -DXIS_QSPI_FLSH"
QEMU_FLASH_TYPE = "qspi"
# QSPI flash size (64MB)
SPI_IMAGE_SIZE = "0x400_0000"
# Boot.bin A/B offsets for 64MB QSPI
SPI_BOOTBIN_OFFSET = "0x15C_0000 0x260_0000"
SPI_USER_SCRATCH_OFFSET = "0x364_0000"
SPI_MANIFEST_OFFSET = "0x3FF_0000"
# UEFI Capsule Update / LVFS Configuration
PRODUCT_NAME = "ZCU104"
PRODUCT_GUID = "1a2d18f9-c48a-5142-96b1-429524a78c8c"
PRODUCT_URL = "https://www.amd.com/en/products/adaptive-socs-and-fpgas/evaluation-boards/zcu104.html"
# Recovery kernel - above CMA (0x2EE00000) and kernel_comp_addr_r (0x33C00000), below fdt_addr_r (0x40000000)
IMGRCVRY_KERNEL_ADDR = "0x34000000"
# Recovery rootfs address
IMGRCVRY_ROOTFS_ADDR = "0x38000000"
# Preboot config file
PREBOOT_CFG_FILE = "file://preboot_cmd_zynqmp_multidomain.cfg"

# This is an 'SDT' based BSP
XILINX_WITH_ESW = "sdt"

# Original SDT artifacts URL
SDT_URI = "https://edf.amd.com/sswreleases/rel-v2026.2/sdt/2026.2/2026.2_1019_1_10190543/external/zynqmp-zcu104-sdt-full/zynqmp-zcu104-sdt-full_2026.2_1019_1_10190543.tar.gz"
SDT_URI[sha256sum] = "a7778e3a9711758865baa395261ea6bc0f232ef10e14a1a9599f4f4406d30877"
SDT_URI[S] = "${UNPACKDIR}/zynqmp-zcu104-sdt-full_2026.2_1019_1_10190543"

# Set the system device trees
SYSTEM_DTFILE_DEPENDS = "sdt-artifacts"
SYSTEM_DTFILE_DIR = "${RECIPE_SYSROOT}${datadir}/sdt/${MACHINE}"
SYSTEM_DTFILE = "${SYSTEM_DTFILE_DIR}/system-top.dts"

# Load the dynamic machine features
include conf/machine/include/zynqmp-zcu104-multidomain/${BB_CURRENT_MC}-features.conf
LIBXIL_CONFIG = "conf/machine/include/zynqmp-zcu104-multidomain/${BB_CURRENT_MC}-libxil.conf"

# Primary Bootmode value
DEFAULT_HW_BOOT_MODE = "5"

# Update bootbin to use proper device tree
BIF_PARTITION_IMAGE[device-tree] = "${DTB_FILE_PATH}"

# Remap boot files to ensure the right device tree is listed first
IMAGE_BOOT_FILES =+ "devicetree/${@os.path.basename(d.getVar('CONFIG_DTFILE').replace('.dts', '.dtb'))}"
PACKAGE_EXTRA_ARCHS:append = " zynqmp_zcu104_sdt_full"

#### No additional settings should be after the Postamble
#### Postamble
PACKAGE_EXTRA_ARCHS:append = "${@['', ' zynqmp_zcu104_multidomain']['zynqmp-zcu104-multidomain' != '${MACHINE}']}"
```

## meta-amd-adaptive-socs-bsp/conf/machine/zynqmp-zcu104-sdt-full.conf
```bitbake
#@TYPE: Machine
#@NAME: zynqmp-zcu104-sdt-full
#@DESCRIPTION: Machine configuration for the zynqmp-zcu104-sdt-full boards.


BBMULTICONFIG += "zynqmp-zcu104-sdt-full-cortexa53-fsbl zynqmp-zcu104-sdt-full-microblaze-pmu"

#### Preamble
MACHINEOVERRIDES =. "${@['', 'zynqmp-zcu104-sdt-full:']['zynqmp-zcu104-sdt-full' !='${MACHINE}']}"
#### Regular settings follow
TUNEFILE[microblaze-pmu] = "conf/machine/include/zynqmp-zcu104-sdt-full/microblaze.inc"

# First Stage Boot Loader
FSBL_DEPENDS = ""
FSBL_MCDEPENDS = "mc::zynqmp-zcu104-sdt-full-cortexa53-fsbl:fsbl-firmware:do_deploy"
FSBL_DEPLOY_DIR = "${TMPDIR}-zynqmp-zcu104-sdt-full-cortexa53-fsbl/deploy/images/${MACHINE}"

# PMU Firmware
PMU_DEPENDS = ""
PMU_MCDEPENDS = "mc::zynqmp-zcu104-sdt-full-microblaze-pmu:pmu-firmware:do_deploy"
PMU_FIRMWARE_DEPLOY_DIR = "${TMPDIR}-zynqmp-zcu104-sdt-full-microblaze-pmu/deploy/images/${MACHINE}"

# Set the default (linux) domain device tree
CONFIG_DTFILE_DIR := "${@bb.utils.which(d.getVar('BBPATH'), 'conf/dts/zynqmp-zcu104-sdt-full')}"
CONFIG_DTFILE ?= "${CONFIG_DTFILE_DIR}/cortexa53-linux.dts"
CONFIG_DTFILE[vardepsexclude] += "CONFIG_DTFILE_DIR"

# Yocto arm-trusted-firmware(TF-A) variables
TFA_CONSOLE ?= "cadence"
TFA_BL33_LOAD ?= "0x8000000"

# Yocto u-boot-xlnx variables
UBOOT_MACHINE ?= "xilinx_zynqmp_virt_defconfig"

# Set DDR Base address for u-boot-xlnx-scr variables
DDR_BASEADDR ?= "0x0"
SKIP_APPEND_BASEADDR ?= "0"

# Yocto KERNEL Variables
UBOOT_ENTRYPOINT  ?= "0x200000"
UBOOT_LOADADDRESS ?= "0x200000"

# Yocto MACHINE_FEATURES Variable
MACHINE_FEATURES += "mali400 vcu fpga-overlay"

# Yocto IMAGE_FEATURES Variable
MACHINE_HWCODECS = "libvcu-omxil"
IMAGE_FEATURES += "hwcodecs"

# Required generic machine inclusion
require conf/machine/zynqmp-generic.conf

QB_MEM = "-m 4G"
QEMU_HW_DTB_PS = "${QEMU_HW_DTB_PATH}/board-zynqmp-zcu104.dtb"
QEMU_HW_DTB_PMU = "${QEMU_HW_DTB_PATH}/zynqmp-pmu.dtb"
# Temporarily enable XEN and XEN QEMU DTSI to system.dtb
ENABLE_XEN_DTSI = "1"
ENABLE_XEN_QEMU_DTSI = "1"

# This is an 'SDT' based BSP
XILINX_WITH_ESW = "sdt"

# Original SDT artifacts URL
SDT_URI = "https://edf.amd.com/sswreleases/rel-v2026.1/sdt/2026.1/2026.1_1226_1_12270000/external/zynqmp-zcu104-sdt-full/zynqmp-zcu104-sdt-full_2026.1_1226_1_12270000.tar.gz"
SDT_URI[sha256sum] = "876664cd9b6225046b1ee2f1b6fe88fce9351e57d9d7f9f74115c224953b59a1"
SDT_URI[S] = "${WORKDIR}/zynqmp-zcu104-sdt-full_2026.1_1226_1_12270000"

# Set the system device trees
SYSTEM_DTFILE_DEPENDS = "sdt-artifacts"
SYSTEM_DTFILE_DIR = "${RECIPE_SYSROOT}${datadir}/sdt/${MACHINE}"
SYSTEM_DTFILE = "${SYSTEM_DTFILE_DIR}/system-top.dts"

# Load the dynamic machine features
include conf/machine/include/zynqmp-zcu104-sdt-full/${BB_CURRENT_MC}-features.conf
LIBXIL_CONFIG = "conf/machine/include/zynqmp-zcu104-sdt-full/${BB_CURRENT_MC}-libxil.conf"

# Update bootbin to use proper device tree
BIF_PARTITION_IMAGE[device-tree] = "${RECIPE_SYSROOT}/boot/devicetree/${@os.path.basename(d.getVar('CONFIG_DTFILE').replace('.dts', '.dtb'))}"

# Remap boot files to ensure the right device tree is listed first
IMAGE_BOOT_FILES =+ "devicetree/${@os.path.basename(d.getVar('CONFIG_DTFILE').replace('.dts', '.dtb'))}"

#### No additional settings should be after the Postamble
#### Postamble
PACKAGE_EXTRA_ARCHS:append = "${@['', ' zynqmp_zcu104_sdt_full']['zynqmp-zcu104-sdt-full' != '${MACHINE}']}"
```

## meta-amd-adaptive-socs-zephyr-bsp/conf/machine/include/mbv32-scu200-zephyr-sdt/microblaze-v.inc
```bitbake
require conf/machine/include/xilinx-microblaze-v.inc

# compatible = "xlnx,microblaze_v";
TUNE_FEATURES:tune-microblaze-v = "${@oe.tune.riscv_isa_to_tune("rv32imac_zicsr_zifencei_zicbom")}"
```
