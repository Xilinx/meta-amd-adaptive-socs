## meta-amd-adaptive-socs-bsp/conf/machine/versal-2ve-2vm-vmk365-multidomain.conf
```bitbake
#@TYPE: Machine
#@NAME: versal-2ve-2vm-vmk365-multidomain
#@DESCRIPTION: Segmented SDT machine for the AMD Versal Gen 2 VMK365 evaluation kit: Cortex-A78 Linux plus MicroBlaze PMC firmware sub-machine.

BBMULTICONFIG += "versal-2ve-2vm-vmk365-multidomain-cortexr52-0-zephyr versal-2ve-2vm-vmk365-multidomain-cortexr52-1-baremetal versal-2ve-2vm-vmk365-multidomain-microblaze-pmc"
MACHINEOVERRIDES .= ":versal-2ve-2vm-vmk365-sdt-seg"

#### Preamble
MACHINEOVERRIDES =. "${@['', 'versal-2ve-2vm-vmk365-multidomain:']['versal-2ve-2vm-vmk365-multidomain' !='${MACHINE}']}"
#### Regular settings follow
TUNEFILE[microblaze-pmc] = "conf/machine/include/versal-2ve-2vm-vmk365-multidomain/microblaze.inc"

# Platform Loader and Manager
PLM_DEPENDS = ""
PLM_MCDEPENDS = "mc::versal-2ve-2vm-vmk365-multidomain-microblaze-pmc:plm-firmware:do_deploy"
PLM_DEPLOY_DIR = "${TMPDIR}-versal-2ve-2vm-vmk365-multidomain-microblaze-pmc/deploy/images/${MACHINE}"

# Set the default (linux) domain device tree
CONFIG_DTFILE_DIR := "${@bb.utils.which(d.getVar('BBPATH'), 'conf/dts/versal-2ve-2vm-vmk365-multidomain')}"
CONFIG_DTFILE ?= "${CONFIG_DTFILE_DIR}/cortexa78-linux.dts"
CONFIG_DTFILE[vardepsexclude] += "CONFIG_DTFILE_DIR"

DTB_FILE_PATH ?= "${RECIPE_SYSROOT}/boot/devicetree/${@os.path.basename(d.getVar('CONFIG_DTFILE').replace('.dts', '.dtb'))}"

# Serial Console Settings
SERIAL_CONSOLES ?= "115200;ttyAMA1"

# Yocto arm-trusted-firmware(TF-A) variables
TFA_CONSOLE ?= "pl011_1"
TFA_MEM_BASE ?= "0x1600000"
TFA_MEM_SIZE ?= "0x200000"
TFA_BL33_LOAD ?= "0x40000000"

# Yocto OP-TEE variables
OPTEE_CONSOLE ?= "0"

# Yocto u-boot-xlnx variables
UBOOT_USER_SPECIFIED_TEXT_BASE ?= "0x40000000"

# Set DDR Base address for u-boot-xlnx-scr variables
DDR_BASEADDR ?= "0x0"
SKIP_APPEND_BASEADDR ?= "0"

# Yocto KERNEL Variables
UBOOT_ENTRYPOINT ?= "0x20200000"
UBOOT_LOADADDRESS ?= "0x20200000"

# Yocto MACHINE_FEATURES Variable
MACHINE_FEATURES += "vcu2 malig78ae optee fpga-overlay efi"

# Required generic machine inclusion
require conf/machine/versal-2ve-2vm-generic.conf

# QEMU Memory Configuration
QB_MEM = "-machine dynamic-mem=on -device amd-ddr-memory,address=0x800000000,size=0x180000000 -device amd-ddr-memory,address=0x50000000000,size=0x200000000"

QEMU_HW_DTB_PS = "${QEMU_HW_DTB_PATH}/board-versal2-psxc-vmk365.dtb"
QEMU_FLASH_TYPE = "ospi"
QB_DEFAULT_FSTYPE = "wic.ufs"
# OSPI flash size (256MB)
SPI_IMAGE_SIZE = "0x1000_0000"
QEMU_SECONDARY_BOOT_MODE = "11"
QB_NETWORK_DEVICE = "-net nic -net nic,netdev=net0,macaddr=@MAC@"
QEMU_HW_SERIAL = "-serial null -serial null -serial null -serial mon:stdio -serial null"
# Enable meta-xilinx-imgrcvry if available
include conf/enable-xilinx-imgrcvry.conf
# Enables the restoration of the multi-boot register for A/B firmware platforms
EXTRA_OECMAKE:append:pn-xilplmi = " -DXILPLMI_pm_restore_multiboot=ON"
# UEFI Capsule Update / LVFS Configuration
PRODUCT_NAME = "VMK365"
PRODUCT_GUID = "0bfabdae-279f-5ef3-879f-04fd2b2f93d7"
PRODUCT_URL = "https://www.amd.com/en/products/adaptive-socs-and-fpgas/versal.html"
# Enable Push Button support and select FW update button on MIO 49
CFLAGS:append:pn-image-selector = " -DXIS_ENABLE_PB -DXIS_CONFIG_MIO"
# Enable libmetal application
BOOTBIN_INC = "libmetal-demo-rpu1.inc"

# This is an 'SDT' based BSP
XILINX_WITH_ESW = "sdt"

# Original SDT artifacts URL
SDT_URI = "https://edf.amd.com/sswreleases/rel-v2026.2/sdt/2026.2/2026.2_1021_1_10210413/external/versal-2ve-2vm-vmk365-sdt-seg/versal-2ve-2vm-vmk365-sdt-seg_2026.2_1021_1_10210413.tar.gz"
SDT_URI[sha256sum] = "14474d4d37215b0e41db3bb89ea3888e54f862ef435951c99cade4d9d267a69d"
SDT_URI[S] = "${UNPACKDIR}/versal-2ve-2vm-vmk365-sdt-seg_2026.2_1021_1_10210413"

# Set the system device trees
SYSTEM_DTFILE_DEPENDS = "sdt-artifacts"
SYSTEM_DTFILE_DIR = "${RECIPE_SYSROOT}${datadir}/sdt/${MACHINE}"
SYSTEM_DTFILE = "${SYSTEM_DTFILE_DIR}/system-top.dts"

# Load the dynamic machine features
include conf/machine/include/versal-2ve-2vm-vmk365-multidomain/${BB_CURRENT_MC}-features.conf
LIBXIL_CONFIG = "conf/machine/include/versal-2ve-2vm-vmk365-multidomain/${BB_CURRENT_MC}-libxil.conf"

# PDI variables
PDI_PATH_DEPENDS = "sdt-artifacts"
PDI_PATH_DIR = "${RECIPE_SYSROOT}${datadir}/sdt/${MACHINE}"
PDI_PATH = "${PDI_PATH_DIR}/vmk365_base_boot.pdi"

# Primary Bootmode value
DEFAULT_HW_BOOT_MODE = "8"

# Update bootbin to use proper device tree
BIF_PARTITION_IMAGE[device-tree] = "${DTB_FILE_PATH}"

# Remap boot files to ensure the right device tree is listed first
IMAGE_BOOT_FILES =+ "devicetree/${@os.path.basename(d.getVar('CONFIG_DTFILE').replace('.dts', '.dtb'))}"
PACKAGE_EXTRA_ARCHS:append = " versal_2ve_2vm_vmk365_sdt_seg"

#### No additional settings should be after the Postamble
#### Postamble
PACKAGE_EXTRA_ARCHS:append = "${@['', ' versal_2ve_2vm_vmk365_multidomain']['versal-2ve-2vm-vmk365-multidomain' != '${MACHINE}']}"
```

## meta-amd-adaptive-socs-bsp/conf/machine/versal-2vp-vpk360-multidomain.conf
```bitbake
#@TYPE: Machine
#@NAME: versal-2vp-vpk360-multidomain
#@DESCRIPTION: Segmented SDT machine for the AMD Versal Premium VPK360 evaluation kit: Cortex-A72 Linux plus MicroBlaze PMC/PSM firmware sub-machines.

BBMULTICONFIG += "versal-2vp-vpk360-multidomain-microblaze-pmc versal-2vp-vpk360-multidomain-microblaze-psm versal-2vp-vpk360-multidomain-cortexr5-0-freertos versal-2vp-vpk360-multidomain-cortexr5-1-baremetal"
MACHINEOVERRIDES .= ":versal-2vp-vpk360-sdt-seg"

#### Preamble
MACHINEOVERRIDES =. "${@['', 'versal-2vp-vpk360-multidomain:']['versal-2vp-vpk360-multidomain' !='${MACHINE}']}"
#### Regular settings follow
TUNEFILE[microblaze-pmc] = "conf/machine/include/versal-2vp-vpk360-multidomain/microblaze.inc"
TUNEFILE[microblaze-psm] = "conf/machine/include/versal-2vp-vpk360-multidomain/microblaze.inc"

# Platform Loader and Manager
PLM_DEPENDS = ""
PLM_MCDEPENDS = "mc::versal-2vp-vpk360-multidomain-microblaze-pmc:plm-firmware:do_deploy"
PLM_DEPLOY_DIR = "${TMPDIR}-versal-2vp-vpk360-multidomain-microblaze-pmc/deploy/images/${MACHINE}"

# PSM Firmware
PSM_DEPENDS = ""
PSM_MCDEPENDS = "mc::versal-2vp-vpk360-multidomain-microblaze-psm:psm-firmware:do_deploy"
PSM_FIRMWARE_DEPLOY_DIR = "${TMPDIR}-versal-2vp-vpk360-multidomain-microblaze-psm/deploy/images/${MACHINE}"

# Set the default (linux) domain device tree
CONFIG_DTFILE_DIR := "${@bb.utils.which(d.getVar('BBPATH'), 'conf/dts/versal-2vp-vpk360-multidomain')}"
CONFIG_DTFILE ?= "${CONFIG_DTFILE_DIR}/cortexa72-linux.dts"
CONFIG_DTFILE[vardepsexclude] += "CONFIG_DTFILE_DIR"

DTB_FILE_PATH ?= "${RECIPE_SYSROOT}/boot/devicetree/${@os.path.basename(d.getVar('CONFIG_DTFILE').replace('.dts', '.dtb'))}"

# Serial Console Settings
SERIAL_CONSOLES ?= "115200;ttyAMA0"

# Yocto arm-trusted-firmware(TF-A) variables
TFA_CONSOLE ?= "pl011"
TFA_BL33_LOAD ?= "0x8000000"

# Yocto u-boot-xlnx variables

# Set DDR Base address for u-boot-xlnx-scr variables
DDR_BASEADDR ?= "0x0"
SKIP_APPEND_BASEADDR ?= "0"

# Yocto KERNEL Variables
UBOOT_ENTRYPOINT ?= "0x200000"
UBOOT_LOADADDRESS ?= "0x200000"

# Yocto MACHINE_FEATURES Variable
MACHINE_FEATURES += "fpga-overlay efi"

# ID Code, can be found in SDTGen bif file
BIF_TOPLEVEL_ATTR[id_code] = "0x4c74093"

# Required generic machine inclusion
require conf/machine/versal-2vp-generic.conf

# QEMU Memory Configuration
QB_MEM = "-machine dynamic-mem=on -device amd-ddr-memory,address=0x800000000,size=0x180000000 -device amd-ddr-memory,address=0x50000000000,size=0x200000000 -device amd-ddr-memory,address=0x60000000000,size=0x100000000"

QEMU_HW_DTB_PS = "${QEMU_HW_DTB_PATH}/board-versal2-ps-vpk360.dtb"
QEMU_HW_DTB_PMC = "${QEMU_HW_DTB_PATH}/board-versal2-pmc-vpk360.dtb"
QEMU_FLASH_TYPE = "ospi"
# OSPI flash size (256MB)
SPI_IMAGE_SIZE = "0x1000_0000"
QEMU_HW_BOOT_MODE = "8"
QEMU_HW_OSPI_FILE = "qemu-ospi-${MACHINE}.bin"
QEMU_SECONDARY_BOOT_MODE = "14"
QB_ROOTFS_OPT = "-drive if=sd,index=1,file=@ROOTFS@,format=raw"
# Enable meta-xilinx-imgrcvry if available
include conf/enable-xilinx-imgrcvry.conf
# Enables the restoration of the multi-boot register for A/B firmware platforms
XLNX_CMAKE_BSP_VARS:pn-xilplmi:append = " -DPLM_ENABLE_RESTORE_MULTIBOOT"
# Enable Push Button support
CFLAGS:pn-image-selector:append = " -DXIS_ENABLE_PB"
# Image recovery kernel address
IMGRCVRY_KERNEL_ADDR = "0x20200000"
# Image recovery rootfs address
IMGRCVRY_ROOTFS_ADDR = "0x24000000"
# Preboot config file
PREBOOT_CFG_FILE = "file://preboot_cmd_versal_2vp.cfg"
# UEFI Capsule Update / LVFS Configuration
PRODUCT_NAME = "VPK360"
PRODUCT_GUID = "2ca0d16b-dcc2-5ee5-95bd-c9551224d78f"
PRODUCT_URL = "https://www.amd.com/en/products/adaptive-socs-and-fpgas/versal.html"
# Enable libmetal application
BOOTBIN_INC = "libmetal-demo-rpu1.inc"

# This is an 'SDT' based BSP
XILINX_WITH_ESW = "sdt"

# Original SDT artifacts URL
SDT_URI = "https://edf.amd.com/sswreleases/rel-v2026.1/sdt/2026.1.1/2026.1.1_0816_1_08170047/external/versal-2vp-vpk360-sdt-seg/versal-2vp-vpk360-sdt-seg_2026.1.1_0816_1_08170047.tar.gz"
SDT_URI[sha256sum] = "06b5f61a6003443b72e3ef85b2645c78325db4a2a874cd55a88a6f60c623571a"
SDT_URI[S] = "${WORKDIR}/versal-2vp-vpk360-sdt-seg_2026.1.1_0816_1_08170047"

# Set the system device trees
SYSTEM_DTFILE_DEPENDS = "sdt-artifacts"
SYSTEM_DTFILE_DIR = "${RECIPE_SYSROOT}${datadir}/sdt/${MACHINE}"
SYSTEM_DTFILE = "${SYSTEM_DTFILE_DIR}/system-top.dts"

# Load the dynamic machine features
include conf/machine/include/versal-2vp-vpk360-multidomain/${BB_CURRENT_MC}-features.conf
LIBXIL_CONFIG = "conf/machine/include/versal-2vp-vpk360-multidomain/${BB_CURRENT_MC}-libxil.conf"

# PDI variables
PDI_PATH_DEPENDS = "sdt-artifacts"
PDI_PATH_DIR = "${RECIPE_SYSROOT}${datadir}/sdt/${MACHINE}"
PDI_PATH = "${PDI_PATH_DIR}/vpk360_base_boot.pdi"

# Primary Bootmode value
DEFAULT_HW_BOOT_MODE = "8"

# Update bootbin to use proper device tree
BIF_PARTITION_IMAGE[device-tree] = "${DTB_FILE_PATH}"

# Remap boot files to ensure the right device tree is listed first
IMAGE_BOOT_FILES =+ "devicetree/${@os.path.basename(d.getVar('CONFIG_DTFILE').replace('.dts', '.dtb'))}"
PACKAGE_EXTRA_ARCHS:append = " versal_2vp_vpk360_sdt_seg"

#### No additional settings should be after the Postamble
#### Postamble
PACKAGE_EXTRA_ARCHS:append = "${@['', ' versal_2vp_vpk360_multidomain']['versal-2vp-vpk360-multidomain' != '${MACHINE}']}"
```

## meta-amd-adaptive-socs-bsp/conf/machine/versal-l20-sdt-seg.conf
```bitbake
#@TYPE: Machine
#@NAME: versal-l20-sdt-seg
#@DESCRIPTION: Machine configuration for the versal-l20-sdt-seg boards.

BBMULTICONFIG += "versal-l20-sdt-seg-microblaze-pmc versal-l20-sdt-seg-microblaze-psm"

#### Preamble
MACHINEOVERRIDES =. "${@['', 'versal-l20-sdt-seg:']['versal-l20-sdt-seg' !='${MACHINE}']}"
#### Regular settings follow
TUNEFILE[microblaze-pmc] = "conf/machine/include/versal-l20-sdt-seg/microblaze.inc"
TUNEFILE[microblaze-psm] = "conf/machine/include/versal-l20-sdt-seg/microblaze.inc"

# Platform Loader and Manager
PLM_DEPENDS = ""
PLM_MCDEPENDS = "mc::versal-l20-sdt-seg-microblaze-pmc:plm-firmware:do_deploy"
PLM_DEPLOY_DIR = "${TMPDIR}-versal-l20-sdt-seg-microblaze-pmc/deploy/images/${MACHINE}"

# PSM Firware
PSM_DEPENDS = ""
PSM_MCDEPENDS = "mc::versal-l20-sdt-seg-microblaze-psm:psm-firmware:do_deploy"
PSM_FIRMWARE_DEPLOY_DIR = "${TMPDIR}-versal-l20-sdt-seg-microblaze-psm/deploy/images/${MACHINE}"

# Set the default (linux) domain device tree
CONFIG_DTFILE_DIR := "${@bb.utils.which(d.getVar('BBPATH'), 'conf/dts/versal-l20-sdt-seg')}"
CONFIG_DTFILE ?= "${CONFIG_DTFILE_DIR}/cortexa72-linux.dts"
CONFIG_DTFILE[vardepsexclude] += "CONFIG_DTFILE_DIR"

# Yocto arm-trusted-firmware(TF-A) variables
TFA_CONSOLE ?= "pl011"
TFA_BL33_LOAD ?= "0x8000000"

# Set DDR Base address for u-boot-xlnx-scr variables
DDR_BASEADDR ?= "0x0"
SKIP_APPEND_BASEADDR ?= "0"

# Yocto KERNEL Variables
UBOOT_ENTRYPOINT  ?= "0x200000"
UBOOT_LOADADDRESS ?= "0x200000"

# Yocto MACHINE_FEATURES Variable
MACHINE_FEATURES += "fpga-overlay"

# Required generic machine inclusion
require conf/machine/versal-generic.conf

QB_MEM = "-m 8G"
QEMU_HW_DTB_PS = "${QEMU_HW_DTB_PATH}/board-versal-ps-vm-p-m1369-00.dtb"
QEMU_HW_DTB_PMC = "${QEMU_HW_DTB_PATH}/board-versal-pmc-virt.dtb"
QB_ROOTFS_OPT = "-drive if=sd,index=1,file=@ROOTFS@,format=raw"


# This is an 'SDT' based BSP
XILINX_WITH_ESW = "sdt"

# Original SDT artifacts URL
SDT_URI = "https://petalinux.xilinx.com/sswreleases/rel-v2025.2/sdt/2025.2/2025.2_0702_1_07030318/external/versal-l20-sdt-seg/versal-l20-sdt-seg_2025.2_0702_1_07030318.tar.gz"
SDT_URI[sha256sum] = "a4f19343cc5db48a66b561c0da1578f4ebfe6811970003c2b3be38cc43ba008b"
SDT_URI[S] = "${WORKDIR}/versal-l20-sdt-seg_2025.2_0702_1_07030318"

# Set the system device trees
SYSTEM_DTFILE_DEPENDS = "sdt-artifacts"
SYSTEM_DTFILE_DIR = "${RECIPE_SYSROOT}${datadir}/sdt/${MACHINE}"
SYSTEM_DTFILE = "${SYSTEM_DTFILE_DIR}/system-top.dts"

# Load the dynamic machine features
include conf/machine/include/versal-l20-sdt-seg/${BB_CURRENT_MC}-features.conf
LIBXIL_CONFIG = "conf/machine/include/versal-l20-sdt-seg/${BB_CURRENT_MC}-libxil.conf"

# Versal PDI
PDI_PATH_DEPENDS = "sdt-artifacts"
PDI_PATH_DIR = "${RECIPE_SYSROOT}${datadir}/sdt/${MACHINE}"
PDI_PATH = "${PDI_PATH_DIR}/l20_base_boot.pdi"

# Update bootbin to use proper device tree
BIF_PARTITION_IMAGE[device-tree] = "${RECIPE_SYSROOT}/boot/devicetree/${@os.path.basename(d.getVar('CONFIG_DTFILE').replace('.dts', '.dtb'))}"

# Remap boot files to ensure the right device tree is listed first
IMAGE_BOOT_FILES =+ "devicetree/${@os.path.basename(d.getVar('CONFIG_DTFILE').replace('.dts', '.dtb'))}"

#### No additional settings should be after the Postamble
#### Postamble
PACKAGE_EXTRA_ARCHS:append = "${@['', ' versal_l20_sdt_seg']['versal-l20-sdt-seg' != '${MACHINE}']}"
```
