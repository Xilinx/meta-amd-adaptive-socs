## meta-amd-adaptive-socs-bsp/conf/machine/versal-vpk120-md.conf
```bitbake
#@TYPE: Machine
#@NAME: versal-vpk120-md
#@DESCRIPTION: Machine configuration for the versal-vpk120-md boards.


BBMULTICONFIG += "versal-vpk120-md-microblaze-pmc versal-vpk120-md-microblaze-psm versal-vpk120-md-cortexr5-0-freertos versal-vpk120-md-cortexr5-1-baremetal"
MACHINEOVERRIDES .= ":versal-vpk120-sdt-seg"

#### Preamble
MACHINEOVERRIDES =. "${@['', 'versal-vpk120-md:']['versal-vpk120-md' !='${MACHINE}']}"
#### Regular settings follow
TUNEFILE[microblaze-pmc] = "conf/machine/include/versal-vpk120-md/microblaze.inc"
TUNEFILE[microblaze-psm] = "conf/machine/include/versal-vpk120-md/microblaze.inc"

# Platform Loader and Manager
PLM_DEPENDS = ""
PLM_MCDEPENDS = "mc::versal-vpk120-md-microblaze-pmc:plm-firmware:do_deploy"
PLM_DEPLOY_DIR = "${TMPDIR}-versal-vpk120-md-microblaze-pmc/deploy/images/${MACHINE}"

# PSM Firmware
PSM_DEPENDS = ""
PSM_MCDEPENDS = "mc::versal-vpk120-md-microblaze-psm:psm-firmware:do_deploy"
PSM_FIRMWARE_DEPLOY_DIR = "${TMPDIR}-versal-vpk120-md-microblaze-psm/deploy/images/${MACHINE}"

# Set the default (linux) domain device tree
CONFIG_DTFILE_DIR := "${@bb.utils.which(d.getVar('BBPATH'), 'conf/dts/versal-vpk120-md')}"
CONFIG_DTFILE ?= "${CONFIG_DTFILE_DIR}/cortexa72-linux.dts"
CONFIG_DTFILE[vardepsexclude] += "CONFIG_DTFILE_DIR"

# Serial Console Settings
SERIAL_CONSOLES ?= "115200;ttyAMA0"

# Yocto arm-trusted-firmware(TF-A) variables
TFA_CONSOLE ?= "pl011"
TFA_BL33_LOAD ?= "0x8000000"

# Yocto u-boot-xlnx variables

# Set DDR Base address for u-boot-xlnx-scr variables
DDR_BASEADDR ?= "0x0"
SKIP_APPEND_BASEADDR ?= "0"

# Yocto KERNEL Variables
UBOOT_ENTRYPOINT ?= "0x200000"
UBOOT_LOADADDRESS ?= "0x200000"

# Yocto MACHINE_FEATURES Variable
MACHINE_FEATURES += "fpga-overlay efi"

# Required generic machine inclusion
require conf/machine/versal-generic.conf

QB_MEM = "-m 8G"
QEMU_HW_DTB_PS = "${QEMU_HW_DTB_PATH}/board-versal-ps-vpk120.dtb"
QEMU_HW_DTB_PMC = "${QEMU_HW_DTB_PATH}/board-versal-pmc-virt.dtb"
QB_ROOTFS_OPT = "-drive if=sd,index=1,file=@ROOTFS@,format=raw"

# This is an 'SDT' based BSP
XILINX_WITH_ESW = "sdt"

# Original SDT artifacts URL
SDT_URI = "https://edf.amd.com/sswreleases/rel-v2026.1/sdt/2026.1/2026.1_0210_1_02110449/external/versal-vpk120-sdt-seg/versal-vpk120-sdt-seg_2026.1_0210_1_02110449.tar.gz"
SDT_URI[sha256sum] = "d172256bd1b6f103ba80bb94f8bd53623dd8ff175f6c9ff38ad9addeeeb8cb8b"
SDT_URI[S] = "${WORKDIR}/versal-vpk120-sdt-seg_2026.1_0210_1_02110449"

# Set the system device trees
SYSTEM_DTFILE_DEPENDS = "sdt-artifacts"
SYSTEM_DTFILE_DIR = "${RECIPE_SYSROOT}${datadir}/sdt/${MACHINE}"
SYSTEM_DTFILE = "${SYSTEM_DTFILE_DIR}/system-top.dts"

# Load the dynamic machine features
include conf/machine/include/versal-vpk120-md/${BB_CURRENT_MC}-features.conf
LIBXIL_CONFIG = "conf/machine/include/versal-vpk120-md/${BB_CURRENT_MC}-libxil.conf"

# PDI variables
PDI_PATH_DEPENDS = "sdt-artifacts"
PDI_PATH_DIR = "${RECIPE_SYSROOT}${datadir}/sdt/${MACHINE}"
PDI_PATH = "${PDI_PATH_DIR}/vpk120_base_boot.pdi"

# Update bootbin to use proper device tree
BIF_PARTITION_IMAGE[device-tree] = "${RECIPE_SYSROOT}/boot/devicetree/${@os.path.basename(d.getVar('CONFIG_DTFILE').replace('.dts', '.dtb'))}"

# Remap boot files to ensure the right device tree is listed first
IMAGE_BOOT_FILES =+ "devicetree/${@os.path.basename(d.getVar('CONFIG_DTFILE').replace('.dts', '.dtb'))}"
PACKAGE_EXTRA_ARCHS:append = " versal_vpk120_sdt_seg"

#### No additional settings should be after the Postamble
#### Postamble
PACKAGE_EXTRA_ARCHS:append = "${@['', ' versal_vpk120_md']['versal-vpk120-md' != '${MACHINE}']}"
```

## meta-amd-adaptive-socs-bsp/conf/machine/versal-vrk160-revb-multidomain.conf
```bitbake
#@TYPE: Machine
#@NAME: versal-vrk160-revb-multidomain
#@DESCRIPTION: AMP/multidomain machine for the AMD Versal RF VRK160 REVB evaluation kit: Cortex-A72 Linux, Cortex-R5 FreeRTOS/baremetal, and MicroBlaze PMC/PSM sub-machines built from system device tree.

BBMULTICONFIG += "versal-vrk160-revb-multidomain-microblaze-pmc versal-vrk160-revb-multidomain-microblaze-psm versal-vrk160-revb-multidomain-cortexr5-0-freertos versal-vrk160-revb-multidomain-cortexr5-1-baremetal"
MACHINEOVERRIDES .= ":versal-vrk160-revb-sdt-seg"

#### Preamble
MACHINEOVERRIDES =. "${@['', 'versal-vrk160-revb-multidomain:']['versal-vrk160-revb-multidomain' !='${MACHINE}']}"
#### Regular settings follow
TUNEFILE[microblaze-pmc] = "conf/machine/include/versal-vrk160-revb-multidomain/microblaze.inc"
TUNEFILE[microblaze-psm] = "conf/machine/include/versal-vrk160-revb-multidomain/microblaze.inc"

# Platform Loader and Manager
PLM_DEPENDS = ""
PLM_MCDEPENDS = "mc::versal-vrk160-revb-multidomain-microblaze-pmc:plm-firmware:do_deploy"
PLM_DEPLOY_DIR = "${TMPDIR}-versal-vrk160-revb-multidomain-microblaze-pmc/deploy/images/${MACHINE}"

# PSM Firmware
PSM_DEPENDS = ""
PSM_MCDEPENDS = "mc::versal-vrk160-revb-multidomain-microblaze-psm:psm-firmware:do_deploy"
PSM_FIRMWARE_DEPLOY_DIR = "${TMPDIR}-versal-vrk160-revb-multidomain-microblaze-psm/deploy/images/${MACHINE}"

# Set the default (linux) domain device tree
CONFIG_DTFILE_DIR := "${@bb.utils.which(d.getVar('BBPATH'), 'conf/dts/versal-vrk160-revb-multidomain')}"
CONFIG_DTFILE ?= "${CONFIG_DTFILE_DIR}/cortexa72-linux.dts"
CONFIG_DTFILE[vardepsexclude] += "CONFIG_DTFILE_DIR"

DTB_FILE_PATH ?= "${RECIPE_SYSROOT}/boot/devicetree/${@os.path.basename(d.getVar('CONFIG_DTFILE').replace('.dts', '.dtb'))}"

# Serial Console Settings
SERIAL_CONSOLES ?= "115200;ttyAMA0"

# Yocto arm-trusted-firmware(TF-A) variables
TFA_CONSOLE ?= "pl011"
TFA_BL33_LOAD ?= "0x8000000"

# Yocto u-boot-xlnx variables

# Set DDR Base address for u-boot-xlnx-scr variables
DDR_BASEADDR ?= "0x0"
SKIP_APPEND_BASEADDR ?= "0"

# Yocto KERNEL Variables
UBOOT_ENTRYPOINT ?= "0x200000"
UBOOT_LOADADDRESS ?= "0x200000"

# Yocto MACHINE_FEATURES Variable
MACHINE_FEATURES += "fpga-overlay efi"

# Required generic machine inclusion
require conf/machine/versal-generic.conf

# QEMU Memory Configuration
QB_MEM = "-machine dynamic-mem=on -device amd-ddr-memory,address=0x800000000,size=0x80000000 -device amd-ddr-memory,address=0x50000000000,size=0x100000000 -device amd-ddr-memory,address=0x60000000000,size=0x100000000 -device amd-ddr-memory,address=0x70000000000,size=0x100000000"

QEMU_HW_DTB_PS = "${QEMU_HW_DTB_PATH}/board-versal-ps-vrk160-revB.dtb"
QEMU_HW_DTB_PMC = "${QEMU_HW_DTB_PATH}/board-versal-pmc-virt.dtb"
QEMU_FLASH_TYPE = "ospi"
# OSPI flash size (256MB)
SPI_IMAGE_SIZE = "0x1000_0000"
# Enable meta-xilinx-imgrcvry if available
include conf/enable-xilinx-imgrcvry.conf
# Enables the restoration of the multi-boot register for A/B firmware platforms
XLNX_CMAKE_BSP_VARS:pn-xilplmi:append = " -DPLM_ENABLE_RESTORE_MULTIBOOT"
# UEFI Capsule Update / LVFS Configuration
PRODUCT_NAME = "VRK160-RevB"
PRODUCT_GUID = "f1c0d5e8-7a23-4b91-b0f8-3e5c6a2d97f3"
PRODUCT_URL = "https://www.amd.com/en/products/adaptive-socs-and-fpgas/versal.html"
# Enable libmetal application
BOOTBIN_INC = "libmetal-demo-rpu1.inc"

# This is an 'SDT' based BSP
XILINX_WITH_ESW = "sdt"

# Original SDT artifacts URL
SDT_URI = "https://edf.amd.com/sswreleases/rel-v2026.1/sdt/2026.1.1/2026.1.1_0831_1_08312257/external/versal-vrk160-revb-sdt-seg/versal-vrk160-revb-sdt-seg_2026.1.1_0831_1_08312257.tar.gz"
SDT_URI[sha256sum] = "12bc882f712214e23d56724994b585b6bb3495f2a274a6a42360f93df4d9ad45"
SDT_URI[S] = "${WORKDIR}/versal-vrk160-revb-sdt-seg_2026.1.1_0831_1_08312257"

# Set the system device trees
SYSTEM_DTFILE_DEPENDS = "sdt-artifacts"
SYSTEM_DTFILE_DIR = "${RECIPE_SYSROOT}${datadir}/sdt/${MACHINE}"
SYSTEM_DTFILE = "${SYSTEM_DTFILE_DIR}/system-top.dts"

# Load the dynamic machine features
include conf/machine/include/versal-vrk160-revb-multidomain/${BB_CURRENT_MC}-features.conf
LIBXIL_CONFIG = "conf/machine/include/versal-vrk160-revb-multidomain/${BB_CURRENT_MC}-libxil.conf"

# PDI variables
PDI_PATH_DEPENDS = "sdt-artifacts"
PDI_PATH_DIR = "${RECIPE_SYSROOT}${datadir}/sdt/${MACHINE}"
PDI_PATH = "${PDI_PATH_DIR}/vrk160_revb_base_boot.pdi"

# Primary Bootmode value
DEFAULT_HW_BOOT_MODE = "8"

# Update bootbin to use proper device tree
BIF_PARTITION_IMAGE[device-tree] = "${DTB_FILE_PATH}"

# Remap boot files to ensure the right device tree is listed first
IMAGE_BOOT_FILES =+ "devicetree/${@os.path.basename(d.getVar('CONFIG_DTFILE').replace('.dts', '.dtb'))}"
PACKAGE_EXTRA_ARCHS:append = " versal_vrk160_revb_sdt_seg"

#### No additional settings should be after the Postamble
#### Postamble
PACKAGE_EXTRA_ARCHS:append = "${@['', ' versal_vrk160_revb_multidomain']['versal-vrk160-revb-multidomain' != '${MACHINE}']}"
```

## meta-amd-adaptive-socs-bsp/conf/machine/versal-vrk165-sdt-seg.conf
```bitbake
#@TYPE: Machine
#@NAME: versal-vrk165-sdt-seg
#@DESCRIPTION: Machine configuration for the versal-vrk165-sdt-seg boards.


BBMULTICONFIG += "versal-vrk165-sdt-seg-microblaze-pmc versal-vrk165-sdt-seg-microblaze-psm versal-vrk165-sdt-seg-cortexr5-0-freertos versal-vrk165-sdt-seg-cortexr5-1-baremetal"

#### Preamble
MACHINEOVERRIDES =. "${@['', 'versal-vrk165-sdt-seg:']['versal-vrk165-sdt-seg' !='${MACHINE}']}"
#### Regular settings follow
TUNEFILE[microblaze-pmc] = "conf/machine/include/versal-vrk165-sdt-seg/microblaze.inc"
TUNEFILE[microblaze-psm] = "conf/machine/include/versal-vrk165-sdt-seg/microblaze.inc"

# Platform Loader and Manager
PLM_DEPENDS = ""
PLM_MCDEPENDS = "mc::versal-vrk165-sdt-seg-microblaze-pmc:plm-firmware:do_deploy"
PLM_DEPLOY_DIR = "${TMPDIR}-versal-vrk165-sdt-seg-microblaze-pmc/deploy/images/${MACHINE}"

# PSM Firware
PSM_DEPENDS = ""
PSM_MCDEPENDS = "mc::versal-vrk165-sdt-seg-microblaze-psm:psm-firmware:do_deploy"
PSM_FIRMWARE_DEPLOY_DIR = "${TMPDIR}-versal-vrk165-sdt-seg-microblaze-psm/deploy/images/${MACHINE}"

# Set the default (linux) domain device tree
CONFIG_DTFILE_DIR := "${@bb.utils.which(d.getVar('BBPATH'), 'conf/dts/versal-vrk165-sdt-seg')}"
CONFIG_DTFILE ?= "${CONFIG_DTFILE_DIR}/cortexa72-linux.dts"
CONFIG_DTFILE[vardepsexclude] += "CONFIG_DTFILE_DIR"

# Yocto arm-trusted-firmware(TF-A) variables
TFA_CONSOLE ?= "pl011"
TFA_BL33_LOAD ?= "0x8000000"

# Set DDR Base address for u-boot-xlnx-scr variables
DDR_BASEADDR ?= "0x0"
SKIP_APPEND_BASEADDR ?= "0"

# Yocto KERNEL Variables
UBOOT_ENTRYPOINT  ?= "0x200000"
UBOOT_LOADADDRESS ?= "0x200000"

# Yocto MACHINE_FEATURES Variable
MACHINE_FEATURES += "fpga-overlay"

# Required generic machine inclusion
require conf/machine/versal-generic.conf

# Enable meta-xilinx-imgrcvry if available
include conf/enable-xilinx-imgrcvry.conf
QB_MEM = "-m 12G"
QEMU_HW_DTB_PS = "${QEMU_HW_DTB_PATH}/board-versal-ps-vrk165.dtb"
QEMU_HW_DTB_PMC = "${QEMU_HW_DTB_PATH}/board-versal-pmc-virt.dtb"
QEMU_HW_BOOT_MODE = "8"
QEMU_HW_OSPI_FILE = "qemu-ospi-${MACHINE}.bin"
QB_OPT_APPEND:append := " -drive file=@DEPLOY_DIR_IMAGE@/${QEMU_HW_OSPI_FILE},if=mtd,format=raw,index=4"

# This is an 'SDT' based BSP
XILINX_WITH_ESW = "sdt"

# Original SDT artifacts URL
SDT_URI = "https://edf.amd.com/sswreleases/rel-v2025.2/sdt/2025.2.1/2025.2.1_0108_1_01090000/external/versal-vrk165-sdt-seg/versal-vrk165-sdt-seg_2025.2.1_0108_1_01090000.tar.gz"
SDT_URI[sha256sum] = "23664bef1ce6d2e501930b0a7b83bc5a73d9862862c21c148736afc0efafa9e3"
SDT_URI[S] = "${WORKDIR}/versal-vrk165-sdt-seg_2025.2.1_0108_1_01090000"

# Set the system device trees
SYSTEM_DTFILE_DEPENDS = "sdt-artifacts"
SYSTEM_DTFILE_DIR = "${RECIPE_SYSROOT}${datadir}/sdt/${MACHINE}"
SYSTEM_DTFILE = "${SYSTEM_DTFILE_DIR}/system-top.dts"

# Load the dynamic machine features
include conf/machine/include/versal-vrk165-sdt-seg/${BB_CURRENT_MC}-features.conf
LIBXIL_CONFIG = "conf/machine/include/versal-vrk165-sdt-seg/${BB_CURRENT_MC}-libxil.conf"

# Versal PDI
PDI_PATH_DEPENDS = "sdt-artifacts"
PDI_PATH_DIR = "${RECIPE_SYSROOT}${datadir}/sdt/${MACHINE}"
PDI_PATH = "${PDI_PATH_DIR}/vrk165_base_boot.pdi"

# Update bootbin to use proper device tree
BIF_PARTITION_IMAGE[device-tree] = "${RECIPE_SYSROOT}/boot/devicetree/${@os.path.basename(d.getVar('CONFIG_DTFILE').replace('.dts', '.dtb'))}"

# Remap boot files to ensure the right device tree is listed first
IMAGE_BOOT_FILES =+ "devicetree/${@os.path.basename(d.getVar('CONFIG_DTFILE').replace('.dts', '.dtb'))}"

#### No additional settings should be after the Postamble
#### Postamble
PACKAGE_EXTRA_ARCHS:append = "${@['', ' versal_vrk165_sdt_seg']['versal-vrk165-sdt-seg' != '${MACHINE}']}"
```

## meta-amd-adaptive-socs-bsp/conf/machine/zynq-zc706-sdt-full.conf
```bitbake
#@TYPE: Machine
#@NAME: zynq-zc706-sdt-full
#@DESCRIPTION: Machine configuration for the zynq-zc706-sdt-full boards.


BBMULTICONFIG += "zynq-zc706-sdt-full-cortexa9-fsbl"

#### Preamble
MACHINEOVERRIDES =. "${@['', 'zynq-zc706-sdt-full:']['zynq-zc706-sdt-full' !='${MACHINE}']}"
#### Regular settings follow

# First Stage Boot Loader
FSBL_DEPENDS = ""
FSBL_MCDEPENDS = "mc::zynq-zc706-sdt-full-cortexa9-fsbl:fsbl-firmware:do_deploy"
FSBL_DEPLOY_DIR = "${TMPDIR}-zynq-zc706-sdt-full-cortexa9-fsbl/deploy/images/${MACHINE}"

# Set the default (linux) domain device tree
CONFIG_DTFILE_DIR := "${@bb.utils.which(d.getVar('BBPATH'), 'conf/dts/zynq-zc706-sdt-full')}"
CONFIG_DTFILE ?= "${CONFIG_DTFILE_DIR}/cortexa9-linux.dts"
CONFIG_DTFILE[vardepsexclude] += "CONFIG_DTFILE_DIR"

DTB_FILE_PATH ?= "${RECIPE_SYSROOT}/boot/devicetree/${@os.path.basename(d.getVar('CONFIG_DTFILE').replace('.dts', '.dtb'))}"

# Serial Console Settings
SERIAL_CONSOLES ?= "115200;ttyPS0"

# Yocto u-boot-xlnx variables

# Set DDR Base address for u-boot-xlnx-scr variables
DDR_BASEADDR ?= "0x100000"
SKIP_APPEND_BASEADDR ?= "0"

# Yocto KERNEL Variables
UBOOT_ENTRYPOINT ?= "0x300000"
UBOOT_LOADADDRESS ?= "0x300000"
KERNEL_EXTRA_ARGS += "UIMAGE_LOADADDR=${UBOOT_ENTRYPOINT}"

# Yocto MACHINE_FEATURES Variable
MACHINE_FEATURES += "fpga-overlay"

# Required generic machine inclusion
require conf/machine/zynq-generic.conf

QB_MEM = "-m 1024"
QEMU_HW_SERIAL = "-serial null -serial mon:stdio"

# This is an 'SDT' based BSP
XILINX_WITH_ESW = "sdt"

# Original SDT artifacts URL
SDT_URI = "https://edf.amd.com/sswreleases/rel-v2026.1/sdt/2026.1/2026.1_0428_1_04280544/external/zynq-zc706-sdt-full/zynq-zc706-sdt-full_2026.1_0428_1_04280544.tar.gz"
SDT_URI[sha256sum] = "6a9d41acad014c66d7f49493d8a0cf99fe927e541b4a4564767e88a85ebfe5ba"
SDT_URI[S] = "${WORKDIR}/zynq-zc706-sdt-full_2026.1_0428_1_04280544"

# Set the system device trees
SYSTEM_DTFILE_DEPENDS = "sdt-artifacts"
SYSTEM_DTFILE_DIR = "${RECIPE_SYSROOT}${datadir}/sdt/${MACHINE}"
SYSTEM_DTFILE = "${SYSTEM_DTFILE_DIR}/system-top.dts"

# Load the dynamic machine features
include conf/machine/include/zynq-zc706-sdt-full/${BB_CURRENT_MC}-features.conf
LIBXIL_CONFIG = "conf/machine/include/zynq-zc706-sdt-full/${BB_CURRENT_MC}-libxil.conf"

# Primary Bootmode value
DEFAULT_HW_BOOT_MODE = "5"

# Update bootbin to use proper device tree
BIF_PARTITION_IMAGE[device-tree] = "${DTB_FILE_PATH}"

# Remap boot files to ensure the right device tree is listed first
IMAGE_BOOT_FILES =+ "devicetree/${@os.path.basename(d.getVar('CONFIG_DTFILE').replace('.dts', '.dtb'))}"

#### No additional settings should be after the Postamble
#### Postamble
PACKAGE_EXTRA_ARCHS:append = "${@['', ' zynq_zc706_sdt_full']['zynq-zc706-sdt-full' != '${MACHINE}']}"
```
