## meta-amd-adaptive-socs-bsp/conf/machine/zynq-zc702-sdt-full.conf
```bitbake
#@TYPE: Machine
#@NAME: zynq-zc702-sdt-full
#@DESCRIPTION: Machine configuration for the AMD Zynq-7000 ZC702 evaluation kit (Cortex-A9 Linux plus FSBL sub-machine), built from system device tree.

BBMULTICONFIG += "zynq-zc702-sdt-full-cortexa9-fsbl"

#### Preamble
MACHINEOVERRIDES =. "${@['', 'zynq-zc702-sdt-full:']['zynq-zc702-sdt-full' !='${MACHINE}']}"
#### Regular settings follow

# First Stage Boot Loader
FSBL_DEPENDS = ""
FSBL_MCDEPENDS = "mc::zynq-zc702-sdt-full-cortexa9-fsbl:fsbl-firmware:do_deploy"
FSBL_DEPLOY_DIR = "${TMPDIR}-zynq-zc702-sdt-full-cortexa9-fsbl/deploy/images/${MACHINE}"

# Set the default (linux) domain device tree
CONFIG_DTFILE_DIR := "${@bb.utils.which(d.getVar('BBPATH'), 'conf/dts/zynq-zc702-sdt-full')}"
CONFIG_DTFILE ?= "${CONFIG_DTFILE_DIR}/cortexa9-linux.dts"
CONFIG_DTFILE[vardepsexclude] += "CONFIG_DTFILE_DIR"

DTB_FILE_PATH ?= "${RECIPE_SYSROOT}/boot/devicetree/${@os.path.basename(d.getVar('CONFIG_DTFILE').replace('.dts', '.dtb'))}"

# Serial Console Settings
SERIAL_CONSOLES ?= "115200;ttyPS0"

# Yocto u-boot-xlnx variables

# Set DDR Base address for u-boot-xlnx-scr variables
DDR_BASEADDR ?= "0x100000"
SKIP_APPEND_BASEADDR ?= "0"

# Yocto KERNEL Variables
UBOOT_ENTRYPOINT ?= "0x300000"
UBOOT_LOADADDRESS ?= "0x300000"
KERNEL_EXTRA_ARGS += "UIMAGE_LOADADDR=${UBOOT_ENTRYPOINT}"

# Yocto MACHINE_FEATURES Variable
MACHINE_FEATURES += "fpga-overlay"

# Required generic machine inclusion
require conf/machine/zynq-generic.conf

QB_MEM = "-m 1024"
QEMU_HW_SERIAL = "-serial null -serial mon:stdio"

# This is an 'SDT' based BSP
XILINX_WITH_ESW = "sdt"

# Original SDT artifacts URL
SDT_URI = "https://edf.amd.com/sswreleases/rel-v2026.1/sdt/2026.1/2026.1_0609_1_06092108/external/zynq-zc702-sdt-full/zynq-zc702-sdt-full_2026.1_0609_1_06092108.tar.gz"
SDT_URI[sha256sum] = "8798bdee17bf5dbad65c68ddaba914f8fdf1da34f9c7b4a711426df02b10f33f"
SDT_URI[S] = "${WORKDIR}/zynq-zc702-sdt-full_2026.1_0609_1_06092108"

# Set the system device trees
SYSTEM_DTFILE_DEPENDS = "sdt-artifacts"
SYSTEM_DTFILE_DIR = "${RECIPE_SYSROOT}${datadir}/sdt/${MACHINE}"
SYSTEM_DTFILE = "${SYSTEM_DTFILE_DIR}/system-top.dts"

# Load the dynamic machine features
include conf/machine/include/zynq-zc702-sdt-full/${BB_CURRENT_MC}-features.conf
LIBXIL_CONFIG = "conf/machine/include/zynq-zc702-sdt-full/${BB_CURRENT_MC}-libxil.conf"

# Primary Bootmode value
DEFAULT_HW_BOOT_MODE = "5"

# Update bootbin to use proper device tree
BIF_PARTITION_IMAGE[device-tree] = "${DTB_FILE_PATH}"

# Remap boot files to ensure the right device tree is listed first
IMAGE_BOOT_FILES =+ "devicetree/${@os.path.basename(d.getVar('CONFIG_DTFILE').replace('.dts', '.dtb'))}"

#### No additional settings should be after the Postamble
#### Postamble
PACKAGE_EXTRA_ARCHS:append = "${@['', ' zynq_zc702_sdt_full']['zynq-zc702-sdt-full' != '${MACHINE}']}"
```

## meta-amd-adaptive-socs-bsp/conf/machine/zynqmp-zcu102-multidomain.conf
```bitbake
#@TYPE: Machine
#@NAME: zynqmp-zcu102-multidomain
#@DESCRIPTION: AMP/multidomain machine for the AMD Zynq UltraScale+ MPSoC ZCU102 evaluation kit: Cortex-A53 Linux plus Cortex-A53 FSBL and MicroBlaze PMU sub-machines built from system device tree.

BBMULTICONFIG += "zynqmp-zcu102-multidomain-cortexa53-fsbl zynqmp-zcu102-multidomain-microblaze-pmu"
MACHINEOVERRIDES .= ":zynqmp-zcu102-sdt-full"

#### Preamble
MACHINEOVERRIDES =. "${@['', 'zynqmp-zcu102-multidomain:']['zynqmp-zcu102-multidomain' !='${MACHINE}']}"
#### Regular settings follow
TUNEFILE[microblaze-pmu] = "conf/machine/include/zynqmp-zcu102-multidomain/microblaze.inc"

# First Stage Boot Loader
FSBL_DEPENDS = ""
FSBL_MCDEPENDS = "mc::zynqmp-zcu102-multidomain-cortexa53-fsbl:fsbl-firmware:do_deploy"
FSBL_DEPLOY_DIR = "${TMPDIR}-zynqmp-zcu102-multidomain-cortexa53-fsbl/deploy/images/${MACHINE}"

# PMU Firmware
PMU_DEPENDS = ""
PMU_MCDEPENDS = "mc::zynqmp-zcu102-multidomain-microblaze-pmu:pmu-firmware:do_deploy"
PMU_FIRMWARE_DEPLOY_DIR = "${TMPDIR}-zynqmp-zcu102-multidomain-microblaze-pmu/deploy/images/${MACHINE}"

# Set the default (linux) domain device tree
CONFIG_DTFILE_DIR := "${@bb.utils.which(d.getVar('BBPATH'), 'conf/dts/zynqmp-zcu102-multidomain')}"
CONFIG_DTFILE ?= "${CONFIG_DTFILE_DIR}/cortexa53-linux.dts"
CONFIG_DTFILE[vardepsexclude] += "CONFIG_DTFILE_DIR"

DTB_FILE_PATH ?= "${RECIPE_SYSROOT}/boot/devicetree/${@os.path.basename(d.getVar('CONFIG_DTFILE').replace('.dts', '.dtb'))}"

# Serial Console Settings
SERIAL_CONSOLES ?= "115200;ttyPS0"

# Yocto arm-trusted-firmware(TF-A) variables
TFA_CONSOLE ?= "cadence"
TFA_BL33_LOAD ?= "0x8000000"

# Yocto u-boot-xlnx variables

# Set DDR Base address for u-boot-xlnx-scr variables
DDR_BASEADDR ?= "0x0"
SKIP_APPEND_BASEADDR ?= "0"

# Yocto KERNEL Variables
UBOOT_ENTRYPOINT ?= "0x200000"
UBOOT_LOADADDRESS ?= "0x200000"

# Yocto MACHINE_FEATURES Variable
MACHINE_FEATURES += "mali400 fpga-overlay efi"

# Required generic machine inclusion
require conf/machine/zynqmp-generic.conf

QB_MEM = "-m 4G"
QEMU_HW_DTB_PS = "${QEMU_HW_DTB_PATH}/board-zynqmp-zcu102.dtb"
QEMU_HW_DTB_PMU = "${QEMU_HW_DTB_PATH}/zynqmp-pmu.dtb"

# This is an 'SDT' based BSP
XILINX_WITH_ESW = "sdt"

# Original SDT artifacts URL
SDT_URI = "https://edf.amd.com/sswreleases/rel-v2026.1/sdt/2026.1/2026.1_0609_1_06092108/external/zynqmp-zcu102-sdt-full/zynqmp-zcu102-sdt-full_2026.1_0609_1_06092108.tar.gz"
SDT_URI[sha256sum] = "6f831a046e8650eaea6ac283bdf004b1af42d8c727055e6b1b749eb3a6a25a5a"
SDT_URI[S] = "${WORKDIR}/zynqmp-zcu102-sdt-full_2026.1_0609_1_06092108"

# Set the system device trees
SYSTEM_DTFILE_DEPENDS = "sdt-artifacts"
SYSTEM_DTFILE_DIR = "${RECIPE_SYSROOT}${datadir}/sdt/${MACHINE}"
SYSTEM_DTFILE = "${SYSTEM_DTFILE_DIR}/system-top.dts"

# Load the dynamic machine features
include conf/machine/include/zynqmp-zcu102-multidomain/${BB_CURRENT_MC}-features.conf
LIBXIL_CONFIG = "conf/machine/include/zynqmp-zcu102-multidomain/${BB_CURRENT_MC}-libxil.conf"

# Primary Bootmode value
DEFAULT_HW_BOOT_MODE = "5"

# Update bootbin to use proper device tree
BIF_PARTITION_IMAGE[device-tree] = "${DTB_FILE_PATH}"

# Remap boot files to ensure the right device tree is listed first
IMAGE_BOOT_FILES =+ "devicetree/${@os.path.basename(d.getVar('CONFIG_DTFILE').replace('.dts', '.dtb'))}"
PACKAGE_EXTRA_ARCHS:append = " zynqmp_zcu102_sdt_full"

#### No additional settings should be after the Postamble
#### Postamble
PACKAGE_EXTRA_ARCHS:append = "${@['', ' zynqmp_zcu102_multidomain']['zynqmp-zcu102-multidomain' != '${MACHINE}']}"
```

## meta-amd-adaptive-socs-bsp/conf/machine/zynqmp-zcu208-sdt-full.conf
```bitbake
#@TYPE: Machine
#@NAME: zynqmp-zcu208-sdt-full
#@DESCRIPTION: Machine configuration for the AMD Zynq UltraScale+ RFSoC ZCU208 evaluation kit (Cortex-A53 Linux plus FSBL and MicroBlaze PMU sub-machines), built from system device tree.

BBMULTICONFIG += "zynqmp-zcu208-sdt-full-cortexa53-fsbl zynqmp-zcu208-sdt-full-microblaze-pmu"

#### Preamble
MACHINEOVERRIDES =. "${@['', 'zynqmp-zcu208-sdt-full:']['zynqmp-zcu208-sdt-full' !='${MACHINE}']}"
#### Regular settings follow
TUNEFILE[microblaze-pmu] = "conf/machine/include/zynqmp-zcu208-sdt-full/microblaze.inc"

# First Stage Boot Loader
FSBL_DEPENDS = ""
FSBL_MCDEPENDS = "mc::zynqmp-zcu208-sdt-full-cortexa53-fsbl:fsbl-firmware:do_deploy"
FSBL_DEPLOY_DIR = "${TMPDIR}-zynqmp-zcu208-sdt-full-cortexa53-fsbl/deploy/images/${MACHINE}"

# PMU Firmware
PMU_DEPENDS = ""
PMU_MCDEPENDS = "mc::zynqmp-zcu208-sdt-full-microblaze-pmu:pmu-firmware:do_deploy"
PMU_FIRMWARE_DEPLOY_DIR = "${TMPDIR}-zynqmp-zcu208-sdt-full-microblaze-pmu/deploy/images/${MACHINE}"

# Set the default (linux) domain device tree
CONFIG_DTFILE_DIR := "${@bb.utils.which(d.getVar('BBPATH'), 'conf/dts/zynqmp-zcu208-sdt-full')}"
CONFIG_DTFILE ?= "${CONFIG_DTFILE_DIR}/cortexa53-linux.dts"
CONFIG_DTFILE[vardepsexclude] += "CONFIG_DTFILE_DIR"

DTB_FILE_PATH ?= "${RECIPE_SYSROOT}/boot/devicetree/${@os.path.basename(d.getVar('CONFIG_DTFILE').replace('.dts', '.dtb'))}"

# Serial Console Settings
SERIAL_CONSOLES ?= "115200;ttyPS0"

# Yocto arm-trusted-firmware(TF-A) variables
TFA_CONSOLE ?= "cadence"
TFA_BL33_LOAD ?= "0x8000000"

# Yocto u-boot-xlnx variables

# Set DDR Base address for u-boot-xlnx-scr variables
DDR_BASEADDR ?= "0x0"
SKIP_APPEND_BASEADDR ?= "0"

# Yocto KERNEL Variables
UBOOT_ENTRYPOINT ?= "0x200000"
UBOOT_LOADADDRESS ?= "0x200000"

# Yocto MACHINE_FEATURES Variable
MACHINE_FEATURES += "rfsoc fpga-overlay efi"

# Required generic machine inclusion
require conf/machine/zynqmp-generic.conf

QB_MEM = "-m 4G"
QEMU_HW_DTB_PS = "${QEMU_HW_DTB_PATH}/board-zynqmp-zcu102.dtb"
QEMU_HW_DTB_PMU = "${QEMU_HW_DTB_PATH}/zynqmp-pmu.dtb"

# This is an 'SDT' based BSP
XILINX_WITH_ESW = "sdt"

# Original SDT artifacts URL
SDT_URI = "https://edf.amd.com/sswreleases/rel-v2026.1/sdt/2026.1/2026.1_0609_1_06092108/external/zynqmp-zcu208-sdt-full/zynqmp-zcu208-sdt-full_2026.1_0609_1_06092108.tar.gz"
SDT_URI[sha256sum] = "b4456817045ce6a9d47bf43166ebe6bd86fb1b439dcda09d68fd2ad03b4917e8"
SDT_URI[S] = "${WORKDIR}/zynqmp-zcu208-sdt-full_2026.1_0609_1_06092108"

# Set the system device trees
SYSTEM_DTFILE_DEPENDS = "sdt-artifacts"
SYSTEM_DTFILE_DIR = "${RECIPE_SYSROOT}${datadir}/sdt/${MACHINE}"
SYSTEM_DTFILE = "${SYSTEM_DTFILE_DIR}/system-top.dts"

# Load the dynamic machine features
include conf/machine/include/zynqmp-zcu208-sdt-full/${BB_CURRENT_MC}-features.conf
LIBXIL_CONFIG = "conf/machine/include/zynqmp-zcu208-sdt-full/${BB_CURRENT_MC}-libxil.conf"

# Primary Bootmode value
DEFAULT_HW_BOOT_MODE = "5"

# Update bootbin to use proper device tree
BIF_PARTITION_IMAGE[device-tree] = "${DTB_FILE_PATH}"

# Remap boot files to ensure the right device tree is listed first
IMAGE_BOOT_FILES =+ "devicetree/${@os.path.basename(d.getVar('CONFIG_DTFILE').replace('.dts', '.dtb'))}"

#### No additional settings should be after the Postamble
#### Postamble
PACKAGE_EXTRA_ARCHS:append = "${@['', ' zynqmp_zcu208_sdt_full']['zynqmp-zcu208-sdt-full' != '${MACHINE}']}"
```

## meta-amd-adaptive-socs-core/conf/layer.conf
```bitbake
# We have a conf and classes directory, add to BBPATH
BBPATH .= ":${LAYERDIR}"

# We have recipes-* directories, add to BBFILES
BBFILES += "${LAYERDIR}/recipes-*/*/*.bb \
            ${LAYERDIR}/recipes-*/*/*.bbappend"

BBFILE_COLLECTIONS += "amd-adaptive-socs-core"
BBFILE_PATTERN_amd-adaptive-socs-core = "^${LAYERDIR}/"
# Currently no files, so set an empty pattern means ignore the error
BBFILE_PATTERN_IGNORE_EMPTY_amd-adaptive-socs-core = "1"
BBFILE_PRIORITY_amd-adaptive-socs-core = "6"

LAYERSUMMARY_amd-adaptive-socs-core = "AMD adaptive SoC core recipes \
and classes"
LAYERDESCRIPTION_amd-adaptive-socs-core = "Core layer for AMD Adaptive \
SoC support: bbclasses, includes, and recipes shared across the BSP \
and reference distros for Versal, Zynq UltraScale+, Zynq-7000, and \
MicroBlaze-V targets."

LAYERDEPENDS_amd-adaptive-socs-core = "\
    core \
    xilinx \
    xilinx-standalone \
    xilinx-standalone-sdt \
    xilinx-microblaze \
    "

LAYERRECOMMENDS_amd-adaptive-socs-core = "\
     openamp-layer \
     "

LAYERSERIES_COMPAT_amd-adaptive-socs-core = "scarthgap"
```
