## meta-amd-adaptive-socs-bsp/conf/machine/versal-vek280-multidomain.conf
```bitbake
#@TYPE: Machine
#@NAME: versal-vek280-multidomain
#@DESCRIPTION: AMP/multidomain machine for the AMD Versal AI Edge VEK280 evaluation kit: Cortex-A72 Linux, Cortex-R5 FreeRTOS/baremetal, and MicroBlaze PMC/PSM sub-machines built from system device tree.

BBMULTICONFIG += "versal-vek280-multidomain-microblaze-pmc versal-vek280-multidomain-microblaze-psm versal-vek280-multidomain-cortexr5-0-freertos versal-vek280-multidomain-cortexr5-1-baremetal"
MACHINEOVERRIDES .= ":versal-vek280-sdt-seg"

#### Preamble
MACHINEOVERRIDES =. "${@['', 'versal-vek280-multidomain:']['versal-vek280-multidomain' !='${MACHINE}']}"
#### Regular settings follow
TUNEFILE[microblaze-pmc] = "conf/machine/include/versal-vek280-multidomain/microblaze.inc"
TUNEFILE[microblaze-psm] = "conf/machine/include/versal-vek280-multidomain/microblaze.inc"

# Platform Loader and Manager
PLM_DEPENDS = ""
PLM_MCDEPENDS = "mc::versal-vek280-multidomain-microblaze-pmc:plm-firmware:do_deploy"
PLM_DEPLOY_DIR = "${TMPDIR}-versal-vek280-multidomain-microblaze-pmc/deploy/images/${MACHINE}"

# PSM Firmware
PSM_DEPENDS = ""
PSM_MCDEPENDS = "mc::versal-vek280-multidomain-microblaze-psm:psm-firmware:do_deploy"
PSM_FIRMWARE_DEPLOY_DIR = "${TMPDIR}-versal-vek280-multidomain-microblaze-psm/deploy/images/${MACHINE}"

# Set the default (linux) domain device tree
CONFIG_DTFILE_DIR := "${@bb.utils.which(d.getVar('BBPATH'), 'conf/dts/versal-vek280-multidomain')}"
CONFIG_DTFILE ?= "${CONFIG_DTFILE_DIR}/cortexa72-linux.dts"
CONFIG_DTFILE[vardepsexclude] += "CONFIG_DTFILE_DIR"

DTB_FILE_PATH ?= "${RECIPE_SYSROOT}/boot/devicetree/${@os.path.basename(d.getVar('CONFIG_DTFILE').replace('.dts', '.dtb'))}"

# Serial Console Settings
SERIAL_CONSOLES ?= "115200;ttyAMA0"

# Yocto arm-trusted-firmware(TF-A) variables
TFA_CONSOLE ?= "pl011"
TFA_BL33_LOAD ?= "0x8000000"

# Yocto u-boot-xlnx variables

# Set DDR Base address for u-boot-xlnx-scr variables
DDR_BASEADDR ?= "0x0"
SKIP_APPEND_BASEADDR ?= "0"

# Yocto KERNEL Variables
UBOOT_ENTRYPOINT ?= "0x200000"
UBOOT_LOADADDRESS ?= "0x200000"

# Yocto MACHINE_FEATURES Variable
MACHINE_FEATURES += "vdu fpga-overlay efi"

# Required generic machine inclusion
require conf/machine/versal-generic.conf

# QEMU Memory Configuration
QB_MEM = "-machine dynamic-mem=on -device amd-ddr-memory,address=0x800000000,size=0x80000000 -device amd-ddr-memory,address=0x50000000000,size=0x100000000 -device amd-ddr-memory,address=0x60000000000,size=0x100000000"

QEMU_HW_DTB_PS = "${QEMU_HW_DTB_PATH}/board-versal-ps-vek280.dtb"
QEMU_HW_DTB_PMC = "${QEMU_HW_DTB_PATH}/board-versal-pmc-virt.dtb"
QEMU_FLASH_TYPE = "ospi"
# OSPI flash size (256MB)
SPI_IMAGE_SIZE = "0x1000_0000"
# Enable meta-xilinx-imgrcvry if available
include conf/enable-xilinx-imgrcvry.conf
# Enables the restoration of the multi-boot register for A/B firmware platforms
XLNX_CMAKE_BSP_VARS:pn-xilplmi:append = " -DPLM_ENABLE_RESTORE_MULTIBOOT"
# UEFI Capsule Update / LVFS Configuration
PRODUCT_NAME = "VEK280"
PRODUCT_GUID = "a1f0d8c9-b3a7-4e09-9f25-7c9823b8a6f2"
PRODUCT_URL = "https://www.amd.com/en/products/adaptive-socs-and-fpgas/versal.html"
# Enable libmetal application
BOOTBIN_INC = "libmetal-demo-rpu1.inc"

# This is an 'SDT' based BSP
XILINX_WITH_ESW = "sdt"

# Original SDT artifacts URL
SDT_URI = "https://edf.amd.com/sswreleases/rel-v2026.1/sdt/2026.1/2026.1_0609_1_06092108/external/versal-vek280-sdt-seg/versal-vek280-sdt-seg_2026.1_0609_1_06092108.tar.gz"
SDT_URI[sha256sum] = "ef096409a8822fa775e6b2a364e293f3f37b81a779679d4632b48140aa8d587d"
SDT_URI[S] = "${WORKDIR}/versal-vek280-sdt-seg_2026.1_0609_1_06092108"

# Set the system device trees
SYSTEM_DTFILE_DEPENDS = "sdt-artifacts"
SYSTEM_DTFILE_DIR = "${RECIPE_SYSROOT}${datadir}/sdt/${MACHINE}"
SYSTEM_DTFILE = "${SYSTEM_DTFILE_DIR}/system-top.dts"

# Load the dynamic machine features
include conf/machine/include/versal-vek280-multidomain/${BB_CURRENT_MC}-features.conf
LIBXIL_CONFIG = "conf/machine/include/versal-vek280-multidomain/${BB_CURRENT_MC}-libxil.conf"

# PDI variables
PDI_PATH_DEPENDS = "sdt-artifacts"
PDI_PATH_DIR = "${RECIPE_SYSROOT}${datadir}/sdt/${MACHINE}"
PDI_PATH = "${PDI_PATH_DIR}/vek280_base_boot.pdi"

# Primary Bootmode value
DEFAULT_HW_BOOT_MODE = "5"

# Update bootbin to use proper device tree
BIF_PARTITION_IMAGE[device-tree] = "${DTB_FILE_PATH}"

# Remap boot files to ensure the right device tree is listed first
IMAGE_BOOT_FILES =+ "devicetree/${@os.path.basename(d.getVar('CONFIG_DTFILE').replace('.dts', '.dtb'))}"
PACKAGE_EXTRA_ARCHS:append = " versal_vek280_sdt_seg"

#### No additional settings should be after the Postamble
#### Postamble
PACKAGE_EXTRA_ARCHS:append = "${@['', ' versal_vek280_multidomain']['versal-vek280-multidomain' != '${MACHINE}']}"
```

## meta-amd-adaptive-socs-bsp/conf/machine/versal-vek280-sdt-seg.conf
```bitbake
#@TYPE: Machine
#@NAME: versal-vek280-sdt-seg
#@DESCRIPTION: Segmented SDT machine for the AMD Versal AI Edge VEK280 evaluation kit: Cortex-A72 Linux plus MicroBlaze PMC/PSM firmware sub-machines.

BBMULTICONFIG += "versal-vek280-sdt-seg-microblaze-pmc versal-vek280-sdt-seg-microblaze-psm"

#### Preamble
MACHINEOVERRIDES =. "${@['', 'versal-vek280-sdt-seg:']['versal-vek280-sdt-seg' !='${MACHINE}']}"
#### Regular settings follow
TUNEFILE[microblaze-pmc] = "conf/machine/include/versal-vek280-sdt-seg/microblaze.inc"
TUNEFILE[microblaze-psm] = "conf/machine/include/versal-vek280-sdt-seg/microblaze.inc"

# Platform Loader and Manager
PLM_DEPENDS = ""
PLM_MCDEPENDS = "mc::versal-vek280-sdt-seg-microblaze-pmc:plm-firmware:do_deploy"
PLM_DEPLOY_DIR = "${TMPDIR}-versal-vek280-sdt-seg-microblaze-pmc/deploy/images/${MACHINE}"

# PSM Firmware
PSM_DEPENDS = ""
PSM_MCDEPENDS = "mc::versal-vek280-sdt-seg-microblaze-psm:psm-firmware:do_deploy"
PSM_FIRMWARE_DEPLOY_DIR = "${TMPDIR}-versal-vek280-sdt-seg-microblaze-psm/deploy/images/${MACHINE}"

# Set the default (linux) domain device tree
CONFIG_DTFILE_DIR := "${@bb.utils.which(d.getVar('BBPATH'), 'conf/dts/versal-vek280-sdt-seg')}"
CONFIG_DTFILE ?= "${CONFIG_DTFILE_DIR}/cortexa72-linux.dts"
CONFIG_DTFILE[vardepsexclude] += "CONFIG_DTFILE_DIR"

DTB_FILE_PATH ?= "${RECIPE_SYSROOT}/boot/devicetree/${@os.path.basename(d.getVar('CONFIG_DTFILE').replace('.dts', '.dtb'))}"

# Serial Console Settings
SERIAL_CONSOLES ?= "115200;ttyAMA0"

# Yocto arm-trusted-firmware(TF-A) variables
TFA_CONSOLE ?= "pl011"
TFA_BL33_LOAD ?= "0x8000000"

# Yocto u-boot-xlnx variables

# Set DDR Base address for u-boot-xlnx-scr variables
DDR_BASEADDR ?= "0x0"
SKIP_APPEND_BASEADDR ?= "0"

# Yocto KERNEL Variables
UBOOT_ENTRYPOINT ?= "0x200000"
UBOOT_LOADADDRESS ?= "0x200000"

# Yocto MACHINE_FEATURES Variable
MACHINE_FEATURES += "vdu fpga-overlay efi"

# Required generic machine inclusion
require conf/machine/versal-generic.conf

# QEMU Memory Configuration
QB_MEM = "-machine dynamic-mem=on -device amd-ddr-memory,address=0x800000000,size=0x80000000 -device amd-ddr-memory,address=0x50000000000,size=0x100000000 -device amd-ddr-memory,address=0x60000000000,size=0x100000000"

QEMU_HW_DTB_PS = "${QEMU_HW_DTB_PATH}/board-versal-ps-vek280.dtb"
QEMU_HW_DTB_PMC = "${QEMU_HW_DTB_PATH}/board-versal-pmc-virt.dtb"
QEMU_FLASH_TYPE = "ospi"
# OSPI flash size (256M)
SPI_IMAGE_SIZE = "0x1000_0000"

# This is an 'SDT' based BSP
XILINX_WITH_ESW = "sdt"

# Original SDT artifacts URL
SDT_URI = "https://edf.amd.com/sswreleases/rel-v2026.1/sdt/2026.1/2026.1_0609_1_06092108/external/versal-vek280-sdt-seg/versal-vek280-sdt-seg_2026.1_0609_1_06092108.tar.gz"
SDT_URI[sha256sum] = "ef096409a8822fa775e6b2a364e293f3f37b81a779679d4632b48140aa8d587d"
SDT_URI[S] = "${WORKDIR}/versal-vek280-sdt-seg_2026.1_0609_1_06092108"

# Set the system device trees
SYSTEM_DTFILE_DEPENDS = "sdt-artifacts"
SYSTEM_DTFILE_DIR = "${RECIPE_SYSROOT}${datadir}/sdt/${MACHINE}"
SYSTEM_DTFILE = "${SYSTEM_DTFILE_DIR}/system-top.dts"

# Load the dynamic machine features
include conf/machine/include/versal-vek280-sdt-seg/${BB_CURRENT_MC}-features.conf
LIBXIL_CONFIG = "conf/machine/include/versal-vek280-sdt-seg/${BB_CURRENT_MC}-libxil.conf"

# PDI variables
PDI_PATH_DEPENDS = "sdt-artifacts"
PDI_PATH_DIR = "${RECIPE_SYSROOT}${datadir}/sdt/${MACHINE}"
PDI_PATH = "${PDI_PATH_DIR}/vek280_base_boot.pdi"

# Primary Bootmode value
DEFAULT_HW_BOOT_MODE = "5"

# Update bootbin to use proper device tree
BIF_PARTITION_IMAGE[device-tree] = "${DTB_FILE_PATH}"

# Remap boot files to ensure the right device tree is listed first
IMAGE_BOOT_FILES =+ "devicetree/${@os.path.basename(d.getVar('CONFIG_DTFILE').replace('.dts', '.dtb'))}"

#### No additional settings should be after the Postamble
#### Postamble
PACKAGE_EXTRA_ARCHS:append = "${@['', ' versal_vek280_sdt_seg']['versal-vek280-sdt-seg' != '${MACHINE}']}"
```

## meta-amd-adaptive-socs-bsp/conf/machine/versal-vm-p-m1369-00-reva-x-prc-01-reva-multidomain.conf
```bitbake
#@TYPE: Machine
#@NAME: versal-vm-p-m1369-00-reva-x-prc-01-reva-multidomain
#@DESCRIPTION: AMP/multidomain machine for the AMD Versal VM-P-M1369-00 Rev A system-on-module on the X-PRC-01 Rev A carrier card: Cortex-A72 Linux, Cortex-R5 FreeRTOS/baremetal, and MicroBlaze PMC/PSM sub-machines built from system device tree.

BBMULTICONFIG += "versal-vm-p-m1369-00-reva-x-prc-01-reva-multidomain-microblaze-pmc versal-vm-p-m1369-00-reva-x-prc-01-reva-multidomain-microblaze-psm versal-vm-p-m1369-00-reva-x-prc-01-reva-multidomain-cortexr5-0-freertos versal-vm-p-m1369-00-reva-x-prc-01-reva-multidomain-cortexr5-1-baremetal"
MACHINEOVERRIDES .= ":versal-vm-p-m1369-00-reva-x-prc-01-reva-sdt-seg"

#### Preamble
MACHINEOVERRIDES =. "${@['', 'versal-vm-p-m1369-00-reva-x-prc-01-reva-multidomain:']['versal-vm-p-m1369-00-reva-x-prc-01-reva-multidomain' !='${MACHINE}']}"
#### Regular settings follow
TUNEFILE[microblaze-pmc] = "conf/machine/include/versal-vm-p-m1369-00-reva-x-prc-01-reva-multidomain/microblaze.inc"
TUNEFILE[microblaze-psm] = "conf/machine/include/versal-vm-p-m1369-00-reva-x-prc-01-reva-multidomain/microblaze.inc"

# Platform Loader and Manager
PLM_DEPENDS = ""
PLM_MCDEPENDS = "mc::versal-vm-p-m1369-00-reva-x-prc-01-reva-multidomain-microblaze-pmc:plm-firmware:do_deploy"
PLM_DEPLOY_DIR = "${TMPDIR}-versal-vm-p-m1369-00-reva-x-prc-01-reva-multidomain-microblaze-pmc/deploy/images/${MACHINE}"

# PSM Firmware
PSM_DEPENDS = ""
PSM_MCDEPENDS = "mc::versal-vm-p-m1369-00-reva-x-prc-01-reva-multidomain-microblaze-psm:psm-firmware:do_deploy"
PSM_FIRMWARE_DEPLOY_DIR = "${TMPDIR}-versal-vm-p-m1369-00-reva-x-prc-01-reva-multidomain-microblaze-psm/deploy/images/${MACHINE}"

# Set the default (linux) domain device tree
CONFIG_DTFILE_DIR := "${@bb.utils.which(d.getVar('BBPATH'), 'conf/dts/versal-vm-p-m1369-00-reva-x-prc-01-reva-multidomain')}"
CONFIG_DTFILE ?= "${CONFIG_DTFILE_DIR}/cortexa72-linux.dts"
CONFIG_DTFILE[vardepsexclude] += "CONFIG_DTFILE_DIR"

DTB_FILE_PATH ?= "${RECIPE_SYSROOT}/boot/devicetree/${@os.path.basename(d.getVar('CONFIG_DTFILE').replace('.dts', '.dtb'))}"

# Serial Console Settings
SERIAL_CONSOLES ?= "115200;ttyAMA0"

# Yocto arm-trusted-firmware(TF-A) variables
TFA_CONSOLE ?= "pl011"
TFA_BL33_LOAD ?= "0x8000000"

# Yocto u-boot-xlnx variables

# Set DDR Base address for u-boot-xlnx-scr variables
DDR_BASEADDR ?= "0x0"
SKIP_APPEND_BASEADDR ?= "0"

# Yocto KERNEL Variables
UBOOT_ENTRYPOINT ?= "0x200000"
UBOOT_LOADADDRESS ?= "0x200000"

# Yocto MACHINE_FEATURES Variable
MACHINE_FEATURES += "fpga-overlay efi"

# Required generic machine inclusion
require conf/machine/versal-generic.conf

QEMU_HW_DTB_PS = "${QEMU_HW_DTB_PATH}/board-versal-ps-vm-p-m1369-00.dtb"
QEMU_HW_DTB_PMC = "${QEMU_HW_DTB_PATH}/board-versal-pmc-virt.dtb"
# Enable libmetal application
BOOTBIN_INC = "libmetal-demo-rpu1.inc"

# This is an 'SDT' based BSP
XILINX_WITH_ESW = "sdt"

# Original SDT artifacts URL
SDT_URI = "https://edf.amd.com/sswreleases/rel-v2026.1/sdt/2026.1/2026.1_0609_1_06092108/external/versal-vm-p-m1369-00-reva-x-prc-01-reva-sdt-seg/versal-vm-p-m1369-00-reva-x-prc-01-reva-sdt-seg_2026.1_0609_1_06092108.tar.gz"
SDT_URI[sha256sum] = "d93511b3f09c27eb04a17dbcc77efa3f2b09fd35df488834fbbd8fed923769a9"
SDT_URI[S] = "${WORKDIR}/versal-vm-p-m1369-00-reva-x-prc-01-reva-sdt-seg_2026.1_0609_1_06092108"

# Set the system device trees
SYSTEM_DTFILE_DEPENDS = "sdt-artifacts"
SYSTEM_DTFILE_DIR = "${RECIPE_SYSROOT}${datadir}/sdt/${MACHINE}"
SYSTEM_DTFILE = "${SYSTEM_DTFILE_DIR}/system-top.dts"

# Load the dynamic machine features
include conf/machine/include/versal-vm-p-m1369-00-reva-x-prc-01-reva-multidomain/${BB_CURRENT_MC}-features.conf
LIBXIL_CONFIG = "conf/machine/include/versal-vm-p-m1369-00-reva-x-prc-01-reva-multidomain/${BB_CURRENT_MC}-libxil.conf"

# PDI variables
PDI_PATH_DEPENDS = "sdt-artifacts"
PDI_PATH_DIR = "${RECIPE_SYSROOT}${datadir}/sdt/${MACHINE}"
PDI_PATH = "${PDI_PATH_DIR}/vm-p-m1369-00_base_boot.pdi"

# Primary Bootmode value
DEFAULT_HW_BOOT_MODE = "5"

# Update bootbin to use proper device tree
BIF_PARTITION_IMAGE[device-tree] = "${DTB_FILE_PATH}"

# Remap boot files to ensure the right device tree is listed first
IMAGE_BOOT_FILES =+ "devicetree/${@os.path.basename(d.getVar('CONFIG_DTFILE').replace('.dts', '.dtb'))}"
PACKAGE_EXTRA_ARCHS:append = " versal_vm_p_m1369_00_reva_x_prc_01_reva_sdt_seg"

#### No additional settings should be after the Postamble
#### Postamble
PACKAGE_EXTRA_ARCHS:append = "${@['', ' versal_vm_p_m1369_00_reva_x_prc_01_reva_multidomain']['versal-vm-p-m1369-00-reva-x-prc-01-reva-multidomain' != '${MACHINE}']}"
```
