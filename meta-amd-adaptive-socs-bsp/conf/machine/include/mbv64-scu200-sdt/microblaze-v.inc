## meta-amd-adaptive-socs-bsp/conf/machine/include/mbv64-scu200-sdt/microblaze-v.inc
```bitbake
# compatible = "xlnx,microblaze_v";
TUNE_FEATURES:tune-microblaze-v = "${@mbv.tune.riscv_isa_to_tune("rv64imafdcb_zicsr_zifencei_zbc_zicbom")}"
```

## meta-amd-adaptive-socs-bsp/conf/machine/include/versal-vek280-sdt-seg/versal-vek280-sdt-seg-cortexa72-1-baremetal-features.conf
```bitbake
MACHINE_FEATURES = "canfd cframe cfupmc common coresightps-dcc csudma emacps gpiops iicps ipipsu ospipsv rtcpsu scugic sdps sysmonpsv trngpsv ttcps uartlite uartpsv usbpsu zdma"
```

## meta-amd-adaptive-socs-bsp/conf/machine/include/versal-vek280-sdt-seg/versal-vek280-sdt-seg-cortexr5-1-freertos-features.conf
```bitbake
MACHINE_FEATURES = "canfd cframe cfupmc common coresightps-dcc csudma emacps gpiops iicps ospipsv rtcpsu scugic sdps sysmonpsv trngpsv uartlite uartpsv usbpsu zdma"
```

## meta-amd-adaptive-socs-bsp/conf/machine/include/versal-vek280-sdt-seg/versal-vek280-sdt-seg-microblaze-psm-features.conf
```bitbake
MACHINE_FEATURES = "canfd cframe cfupmc common csudma emacps gpio gpiops iicps intc iomodule ipipsu ospipsv rtcpsu sdps sysmonpsv tmr-inject tmr-manager trngpsv ttcps uartlite uartpsv usbpsu zdma"
```

## meta-amd-adaptive-socs-bsp/conf/machine/include/versal-vpk360-multidomain/versal-vpk360-multidomain-microblaze-psm-features.conf
```bitbake
MACHINE_FEATURES = "cframe cfupmc common csudma emacps gpiops iicps iomodule ipipsu ospipsv rtcpsu sdps sysmonpsv tmr-inject tmr-manager trngpsv ttcps uartlite uartpsv usbpsu zdma"
```

## meta-amd-adaptive-socs-bsp/conf/machine/include/zynq-zc706-sdt-full/zynq-zc706-sdt-full-cortexa9-fsbl-features.conf
```bitbake
MACHINE_FEATURES = "bram common coresightps-dcc devcfg dmaps emacps gpio gpiops iicps qspips scugic scutimer scuwdt sdps ttcps uartps usbps xadcps"
```

## meta-amd-adaptive-socs-bsp/conf/machine/include/zynqmp-zcu208-sdt-full/zynqmp-zcu208-sdt-full-cortexa53-fsbl-features.conf
```bitbake
MACHINE_FEATURES = "axipmon bram clockps common coresightps-dcc csudma ddrcpsu emacps gpio gpiops iicps ipipsu qspipsu resetps rtcpsu scugic sdps sysmonpsu ttcps uartps usbpsu wdtps zdma"
```

## meta-amd-adaptive-socs-bsp/conf/machine/include/zynqmp-zcu208-sdt-full/zynqmp-zcu208-sdt-full-microblaze-pmu-features.conf
```bitbake
MACHINE_FEATURES = "axipmon bram clockps common csudma ddrcpsu emacps gpio gpiops iicps ipipsu qspipsu resetps rtcpsu sdps sysmonpsu ttcps uartps usbpsu wdtps zdma"
```

## meta-amd-adaptive-socs-bsp/conf/machine/mbv64-scu200-sdt.conf
```bitbake
#@TYPE: Machine
#@NAME: mbv64-scu200-sdt
#@DESCRIPTION: Machine configuration for the AMD SCU200 board running a 64-bit AMD MicroBlaze V processor (soft-core RISC-V processor IP), built from system device tree.

#### Preamble
MACHINEOVERRIDES =. "${@['', 'mbv64-scu200-sdt:']['mbv64-scu200-sdt' !='${MACHINE}']}"
#### Regular settings follow

# MicroBlaze V Tune features Settings
require conf/machine/include/mbv64-scu200-sdt/microblaze-v.inc

# Set the default (linux) domain device tree
CONFIG_DTFILE_DIR := "${@bb.utils.which(d.getVar('BBPATH'), 'conf/dts/mbv64-scu200-sdt')}"
CONFIG_DTFILE ?= "${CONFIG_DTFILE_DIR}/microblaze-riscv-linux.dts"
CONFIG_DTFILE[vardepsexclude] += "CONFIG_DTFILE_DIR"

DTB_FILE_PATH ?= "${RECIPE_SYSROOT}/boot/devicetree/${@os.path.basename(d.getVar('CONFIG_DTFILE').replace('.dts', '.dtb'))}"

# Yocto u-boot-xlnx variables
UBOOT_MACHINE ?= "xilinx_mbv64_smode_defconfig xilinx_mbv_ospi.config"
SPL_BINARY ?= "spl/u-boot-spl.bin"

# Set DDR Base address for u-boot-xlnx-scr variables
DDR_BASEADDR ?= "0x0"
SKIP_APPEND_BASEADDR ?= "0"

# Yocto KERNEL Variables
UBOOT_ENTRYPOINT ?= "0x1200000"
UBOOT_LOADADDRESS ?= "0x1200000"

# Required generic machine inclusion
require conf/machine/microblaze-v-generic.conf

# Yocto Riscv OPENSBI variables
RISCV_SBI_FW_TEXT_START = "0x0"

# This is an 'SDT' based BSP
XILINX_WITH_ESW = "sdt"

# Original SDT artifacts URL
SDT_URI = "https://edf.amd.com/sswreleases/rel-v2026.1/sdt/2026.1/2026.1_0511_1_05110825/external/mbv64-scu200-sdt/mbv64-scu200-sdt_2026.1_0511_1_05110825.tar.gz"
SDT_URI[sha256sum] = "d9c098b684987e9792f01a548a517c7058e150744c8e74f424663b0039d76c16"
SDT_URI[S] = "${WORKDIR}/mbv64-scu200-sdt_2026.1_0511_1_05110825"

# Set the system device trees
SYSTEM_DTFILE_DEPENDS = "sdt-artifacts"
SYSTEM_DTFILE_DIR = "${RECIPE_SYSROOT}${datadir}/sdt/${MACHINE}"
SYSTEM_DTFILE = "${SYSTEM_DTFILE_DIR}/system-top.dts"

# PDI variables
PDI_PATH_DEPENDS = "sdt-artifacts"
PDI_PATH_DIR = "${RECIPE_SYSROOT}${datadir}/sdt/${MACHINE}"
PDI_PATH = "${PDI_PATH_DIR}/scu200_base.pdi"

# Primary Bootmode value
DEFAULT_HW_BOOT_MODE = ""

# Update bootbin to use proper device tree
BIF_PARTITION_IMAGE[device-tree] = "${DTB_FILE_PATH}"

# Remap boot files to ensure the right device tree is listed first
IMAGE_BOOT_FILES =+ "devicetree/${@os.path.basename(d.getVar('CONFIG_DTFILE').replace('.dts', '.dtb'))}"

#### No additional settings should be after the Postamble
#### Postamble
PACKAGE_EXTRA_ARCHS:append = "${@['', ' mbv64_scu200_sdt']['mbv64-scu200-sdt' != '${MACHINE}']}"
```

## meta-amd-adaptive-socs-bsp/conf/machine/mbv64-sp701-sdt.conf
```bitbake
#@TYPE: Machine
#@NAME: mbv64-sp701-sdt
#@DESCRIPTION: Machine configuration for the AMD SP701 board running a 64-bit AMD MicroBlaze V processor (soft-core RISC-V processor IP), built from system device tree.

#### Preamble
MACHINEOVERRIDES =. "${@['', 'mbv64-sp701-sdt:']['mbv64-sp701-sdt' !='${MACHINE}']}"
#### Regular settings follow

# MicroBlaze V Tune features Settings
require conf/machine/include/mbv64-sp701-sdt/microblaze-v.inc

# Set the default (linux) domain device tree
CONFIG_DTFILE_DIR := "${@bb.utils.which(d.getVar('BBPATH'), 'conf/dts/mbv64-sp701-sdt')}"
CONFIG_DTFILE ?= "${CONFIG_DTFILE_DIR}/microblaze-riscv-linux.dts"
CONFIG_DTFILE[vardepsexclude] += "CONFIG_DTFILE_DIR"

DTB_FILE_PATH ?= "${RECIPE_SYSROOT}/boot/devicetree/${@os.path.basename(d.getVar('CONFIG_DTFILE').replace('.dts', '.dtb'))}"

# Yocto u-boot-xlnx variables
SPL_BINARY ?= "spl/u-boot-spl.bin"

# Set DDR Base address for u-boot-xlnx-scr variables
DDR_BASEADDR ?= "0x80000000"
SKIP_APPEND_BASEADDR ?= "0"

# Yocto KERNEL Variables
UBOOT_ENTRYPOINT ?= "0x81200000"
UBOOT_LOADADDRESS ?= "0x81200000"

# Required generic machine inclusion
require conf/machine/microblaze-v-generic.conf

# Yocto Riscv OPENSBI variables
RISCV_SBI_FW_TEXT_START = "0x80000000"

# This is an 'SDT' based BSP
XILINX_WITH_ESW = "sdt"

# Original SDT artifacts URL
SDT_URI = "https://edf.amd.com/sswreleases/rel-v2026.1/sdt/2026.1/2026.1_0609_1_06092108/external/mbv64-sp701-sdt/mbv64-sp701-sdt_2026.1_0609_1_06092108.tar.gz"
SDT_URI[sha256sum] = "e528b59514227633787c0da2429da80aeb7c68b0459be6a6941b2b1e82235b37"
SDT_URI[S] = "${WORKDIR}/mbv64-sp701-sdt_2026.1_0609_1_06092108"

# Set the system device trees
SYSTEM_DTFILE_DEPENDS = "sdt-artifacts"
SYSTEM_DTFILE_DIR = "${RECIPE_SYSROOT}${datadir}/sdt/${MACHINE}"
SYSTEM_DTFILE = "${SYSTEM_DTFILE_DIR}/system-top.dts"

# microblaze-v bitstream path 
BITSTREAM_PATH_DEPENDS = "sdt-artifacts"
BITSTREAM_PATH_DIR = "${RECIPE_SYSROOT}${datadir}/sdt/${MACHINE}"
BITSTREAM_PATH = "${BITSTREAM_PATH_DIR}/sp701_base.bit"

# Primary Bootmode value
DEFAULT_HW_BOOT_MODE = ""

# Update bootbin to use proper device tree
BIF_PARTITION_IMAGE[device-tree] = "${DTB_FILE_PATH}"

# Remap boot files to ensure the right device tree is listed first
IMAGE_BOOT_FILES =+ "devicetree/${@os.path.basename(d.getVar('CONFIG_DTFILE').replace('.dts', '.dtb'))}"

#### No additional settings should be after the Postamble
#### Postamble
PACKAGE_EXTRA_ARCHS:append = "${@['', ' mbv64_sp701_sdt']['mbv64-sp701-sdt' != '${MACHINE}']}"
```

## meta-amd-adaptive-socs-bsp/conf/machine/qemu-microblaze-v-64.conf
```bitbake
#@TYPE: Machine
#@NAME: qemu Microblaze-V riscv64 machine
#@DESCRIPTION: Machine configuration for running a generic riscv64

#### Preamble
MACHINEOVERRIDES =. "${@['', 'qemu-microblaze-v-64:']['qemu-microblaze-v-64' != '${MACHINE}']}"
#### Regular settings follow

# Set the default for a modern full feature (64-bit) microblaze-v...
TUNE_FEATURES:tune-microblaze-v = "${@mbv.tune.riscv_isa_to_tune("rv64imafdc_zicbom_zicsr_zifencei_zba_zbb_zbs")}"

UBOOT_MACHINE ?= "qemu-riscv64_smode_defconfig"

# Required generic machine inclusion
require conf/machine/microblaze-v-generic.conf
require conf/machine/include/qemuriscv-xilinx.inc

RISCV_SBI_FW_TEXT_START = "0x80000000"

# This is NOT a true 'SDT" based BSP
XILINX_WITH_ESW = ""

#### No additional settings should be after the Postamble
#### Postamble
PACKAGE_EXTRA_ARCHS:append = "${@['', ' qemu_microblaze_v_64']['qemu-microblaze-v-64' != '${MACHINE}']}"
```

## meta-amd-adaptive-socs-bsp/conf/machine/versal-2ve-2vm-vek385-multidomain.conf
```bitbake
#@TYPE: Machine
#@NAME: versal-2ve-2vm-vek385-multidomain
#@DESCRIPTION: AMP/multidomain machine for the AMD Versal Gen 2 VEK385 evaluation kit: Cortex-A78 Linux, Cortex-R52 baremetal/Zephyr, and MicroBlaze PMC sub-machines built from system device tree.

BBMULTICONFIG += "versal-2ve-2vm-vek385-multidomain-cortexr52-0-zephyr versal-2ve-2vm-vek385-multidomain-cortexr52-1-baremetal versal-2ve-2vm-vek385-multidomain-microblaze-pmc"
MACHINEOVERRIDES .= ":versal-2ve-2vm-vek385-sdt-seg"

#### Preamble
MACHINEOVERRIDES =. "${@['', 'versal-2ve-2vm-vek385-multidomain:']['versal-2ve-2vm-vek385-multidomain' !='${MACHINE}']}"
#### Regular settings follow
TUNEFILE[microblaze-pmc] = "conf/machine/include/versal-2ve-2vm-vek385-multidomain/microblaze.inc"

# Platform Loader and Manager
PLM_DEPENDS = ""
PLM_MCDEPENDS = "mc::versal-2ve-2vm-vek385-multidomain-microblaze-pmc:plm-firmware:do_deploy"
PLM_DEPLOY_DIR = "${TMPDIR}-versal-2ve-2vm-vek385-multidomain-microblaze-pmc/deploy/images/${MACHINE}"

# Set the default (linux) domain device tree
CONFIG_DTFILE_DIR := "${@bb.utils.which(d.getVar('BBPATH'), 'conf/dts/versal-2ve-2vm-vek385-multidomain')}"
CONFIG_DTFILE ?= "${CONFIG_DTFILE_DIR}/cortexa78-linux.dts"
CONFIG_DTFILE[vardepsexclude] += "CONFIG_DTFILE_DIR"

DTB_FILE_PATH ?= "${RECIPE_SYSROOT}/boot/devicetree/${@os.path.basename(d.getVar('CONFIG_DTFILE').replace('.dts', '.dtb'))}"

# Serial Console Settings
SERIAL_CONSOLES ?= "115200;ttyAMA1"

# Yocto arm-trusted-firmware(TF-A) variables
TFA_CONSOLE ?= "pl011_1"
ATF_MEM_BASE ?= "0x1600000"
ATF_MEM_SIZE ?= "0x200000"
TFA_BL33_LOAD ?= "0x40000000"

# Yocto OP-TEE variables
OPTEE_CONSOLE ?= "1"

# Yocto u-boot-xlnx variables

# Set DDR Base address for u-boot-xlnx-scr variables
DDR_BASEADDR ?= "0x0"
SKIP_APPEND_BASEADDR ?= "1"

# Yocto KERNEL Variables
UBOOT_ENTRYPOINT ?= "0x20200000"
UBOOT_LOADADDRESS ?= "0x20200000"

# Yocto MACHINE_FEATURES Variable
MACHINE_FEATURES += "vcu2 malig78ae optee fpga-overlay efi"

# Required generic machine inclusion
require conf/machine/versal-2ve-2vm-generic.conf

# QEMU Memory Configuration
QB_MEM = "-machine dynamic-mem=on -device amd-ddr-memory,address=0x800000000,size=0x80000000 -device amd-ddr-memory,address=0x50000000000,size=0x100000000 -device amd-ddr-memory,address=0x60000000000,size=0x80000000"

QEMU_HW_DTB_PS = "${QEMU_HW_DTB_PATH}/board-versal2-psxc-vek385.dtb"
QEMU_HW_SERIAL = "-serial null -serial null -serial null -serial mon:stdio"
QEMU_FLASH_TYPE = "ospi"
QB_DEFAULT_FSTYPE = "wic.ufs"
# OSPI flash size (256MB)
SPI_IMAGE_SIZE = "0x1000_0000"
QEMU_SECONDARY_BOOT_MODE = "11"
# Enable meta-xilinx-imgrcvry if available
include conf/enable-xilinx-imgrcvry.conf
# Enables the restoration of the multi-boot register for A/B firmware platforms
XLNX_CMAKE_BSP_VARS:pn-xilplmi:append = " -DPLM_ENABLE_RESTORE_MULTIBOOT"
# UEFI Capsule Update / LVFS Configuration
PRODUCT_NAME = "VEK385"
PRODUCT_GUID = "cb27e54d-8f3a-4c77-8a72-1c76d2d4e938"
PRODUCT_URL = "https://www.amd.com/en/products/adaptive-socs-and-fpgas/versal.html"
# Enable libmetal application
BOOTBIN_INC = "libmetal-demo-rpu1.inc"

# This is an 'SDT' based BSP
XILINX_WITH_ESW = "sdt"

# Original SDT artifacts URL
SDT_URI = "https://edf.amd.com/sswreleases/rel-v2026.1/sdt/2026.1/2026.1_0609_1_06092108/external/versal-2ve-2vm-vek385-sdt-seg/versal-2ve-2vm-vek385-sdt-seg_2026.1_0609_1_06092108.tar.gz"
SDT_URI[sha256sum] = "01789eb6f26e6e2e657f6c0764c7ec575985d204ab8d8e8cbddab297566ad2af"
SDT_URI[S] = "${WORKDIR}/versal-2ve-2vm-vek385-sdt-seg_2026.1_0609_1_06092108"

# Set the system device trees
SYSTEM_DTFILE_DEPENDS = "sdt-artifacts"
SYSTEM_DTFILE_DIR = "${RECIPE_SYSROOT}${datadir}/sdt/${MACHINE}"
SYSTEM_DTFILE = "${SYSTEM_DTFILE_DIR}/system-top.dts"

# Load the dynamic machine features
include conf/machine/include/versal-2ve-2vm-vek385-multidomain/${BB_CURRENT_MC}-features.conf
LIBXIL_CONFIG = "conf/machine/include/versal-2ve-2vm-vek385-multidomain/${BB_CURRENT_MC}-libxil.conf"

# PDI variables
PDI_PATH_DEPENDS = "sdt-artifacts"
PDI_PATH_DIR = "${RECIPE_SYSROOT}${datadir}/sdt/${MACHINE}"
PDI_PATH = "${PDI_PATH_DIR}/vek385_base_boot.pdi"

# Primary Bootmode value
DEFAULT_HW_BOOT_MODE = "8"

# Update bootbin to use proper device tree
BIF_PARTITION_IMAGE[device-tree] = "${DTB_FILE_PATH}"

# Remap boot files to ensure the right device tree is listed first
IMAGE_BOOT_FILES =+ "devicetree/${@os.path.basename(d.getVar('CONFIG_DTFILE').replace('.dts', '.dtb'))}"
PACKAGE_EXTRA_ARCHS:append = " versal_2ve_2vm_vek385_sdt_seg"

#### No additional settings should be after the Postamble
#### Postamble
PACKAGE_EXTRA_ARCHS:append = "${@['', ' versal_2ve_2vm_vek385_multidomain']['versal-2ve-2vm-vek385-multidomain' != '${MACHINE}']}"
```
