## meta-amd-adaptive-socs-bsp/conf/machine/versal-2ve-2vm-vek385-revb-sdt-seg.conf
```bitbake
#@TYPE: Machine
#@NAME: versal-2ve-2vm-vek385-revb-sdt-seg
#@DESCRIPTION: Segmented SDT machine for the AMD Versal Gen 2 VEK385 (Rev B) evaluation kit: Cortex-A78 Linux plus MicroBlaze PMC firmware sub-machine.

BBMULTICONFIG += "versal-2ve-2vm-vek385-revb-sdt-seg-microblaze-pmc"

#### Preamble
MACHINEOVERRIDES =. "${@['', 'versal-2ve-2vm-vek385-revb-sdt-seg:']['versal-2ve-2vm-vek385-revb-sdt-seg' !='${MACHINE}']}"
#### Regular settings follow
TUNEFILE[microblaze-pmc] = "conf/machine/include/versal-2ve-2vm-vek385-revb-sdt-seg/microblaze.inc"

# Platform Loader and Manager
PLM_DEPENDS = ""
PLM_MCDEPENDS = "mc::versal-2ve-2vm-vek385-revb-sdt-seg-microblaze-pmc:plm-firmware:do_deploy"
PLM_DEPLOY_DIR = "${TMPDIR}-versal-2ve-2vm-vek385-revb-sdt-seg-microblaze-pmc/deploy/images/${MACHINE}"

# Set the default (linux) domain device tree
CONFIG_DTFILE_DIR := "${@bb.utils.which(d.getVar('BBPATH'), 'conf/dts/versal-2ve-2vm-vek385-revb-sdt-seg')}"
CONFIG_DTFILE ?= "${CONFIG_DTFILE_DIR}/cortexa78-linux.dts"
CONFIG_DTFILE[vardepsexclude] += "CONFIG_DTFILE_DIR"

DTB_FILE_PATH ?= "${RECIPE_SYSROOT}/boot/devicetree/${@os.path.basename(d.getVar('CONFIG_DTFILE').replace('.dts', '.dtb'))}"

# Serial Console Settings
SERIAL_CONSOLES ?= "115200;ttyAMA1"

# Yocto arm-trusted-firmware(TF-A) variables
TFA_CONSOLE ?= "pl011_1"
ATF_MEM_BASE ?= "0x1600000"
ATF_MEM_SIZE ?= "0x200000"
TFA_BL33_LOAD ?= "0x40000000"

# Yocto OP-TEE variables
OPTEE_CONSOLE ?= "0"

# Yocto u-boot-xlnx variables

# Set DDR Base address for u-boot-xlnx-scr variables
DDR_BASEADDR ?= "0x0"
SKIP_APPEND_BASEADDR ?= "0"

# Yocto KERNEL Variables
UBOOT_ENTRYPOINT ?= "0x200000"
UBOOT_LOADADDRESS ?= "0x200000"

# Yocto MACHINE_FEATURES Variable
MACHINE_FEATURES += "vcu2 malig78ae fpga-overlay efi"

# Required generic machine inclusion
require conf/machine/versal-2ve-2vm-generic.conf

# QEMU Memory Configuration
QB_MEM = "-machine dynamic-mem=on -device amd-ddr-memory,address=0x800000000,size=0x180000000 -device amd-ddr-memory,address=0x50000000000,size=0x200000000 -device amd-ddr-memory,address=0x60000000000,size=0x100000000"

QEMU_HW_DTB_PS = "${QEMU_HW_DTB_PATH}/board-versal2-psxc-vek385-revB.dtb"
QEMU_HW_SERIAL = "-serial null -serial null -serial null -serial mon:stdio"
QEMU_FLASH_TYPE = "ospi"
QB_DEFAULT_FSTYPE = "wic.ufs"
# OSPI flash size (256M)
SPI_IMAGE_SIZE = "0x1000_0000"
QEMU_SECONDARY_BOOT_MODE = "11"

# This is an 'SDT' based BSP
XILINX_WITH_ESW = "sdt"

# Original SDT artifacts URL
SDT_URI = "https://edf.amd.com/sswreleases/rel-v2026.1/sdt/2026.1/2026.1_0609_1_06092108/external/versal-2ve-2vm-vek385-revb-sdt-seg/versal-2ve-2vm-vek385-revb-sdt-seg_2026.1_0609_1_06092108.tar.gz"
SDT_URI[sha256sum] = "21cb39acec7a89d73768f56ae928ea49de74a892e7f2abd3d6bc60e3b55523f9"
SDT_URI[S] = "${WORKDIR}/versal-2ve-2vm-vek385-revb-sdt-seg_2026.1_0609_1_06092108"

# Set the system device trees
SYSTEM_DTFILE_DEPENDS = "sdt-artifacts"
SYSTEM_DTFILE_DIR = "${RECIPE_SYSROOT}${datadir}/sdt/${MACHINE}"
SYSTEM_DTFILE = "${SYSTEM_DTFILE_DIR}/system-top.dts"

# Load the dynamic machine features
include conf/machine/include/versal-2ve-2vm-vek385-revb-sdt-seg/${BB_CURRENT_MC}-features.conf
LIBXIL_CONFIG = "conf/machine/include/versal-2ve-2vm-vek385-revb-sdt-seg/${BB_CURRENT_MC}-libxil.conf"

# PDI variables
PDI_PATH_DEPENDS = "sdt-artifacts"
PDI_PATH_DIR = "${RECIPE_SYSROOT}${datadir}/sdt/${MACHINE}"
PDI_PATH = "${PDI_PATH_DIR}/vek385_revb_base_boot.pdi"

# Primary Bootmode value
DEFAULT_HW_BOOT_MODE = "8"

# Update bootbin to use proper device tree
BIF_PARTITION_IMAGE[device-tree] = "${DTB_FILE_PATH}"

# Remap boot files to ensure the right device tree is listed first
IMAGE_BOOT_FILES =+ "devicetree/${@os.path.basename(d.getVar('CONFIG_DTFILE').replace('.dts', '.dtb'))}"

#### No additional settings should be after the Postamble
#### Postamble
PACKAGE_EXTRA_ARCHS:append = "${@['', ' versal_2ve_2vm_vek385_revb_sdt_seg']['versal-2ve-2vm-vek385-revb-sdt-seg' != '${MACHINE}']}"
```

## meta-amd-adaptive-socs-bsp/conf/machine/versal-2ve-2vm-vek386-multidomain.conf
```bitbake
#@TYPE: Machine
#@NAME: versal-2ve-2vm-vek386-multidomain
#@DESCRIPTION: AMP/multidomain machine for the AMD Versal Gen 2 VEK386 evaluation kit: Cortex-A78 Linux, Cortex-R52 baremetal/Zephyr, and MicroBlaze PMC sub-machines built from system device tree.

BBMULTICONFIG += "versal-2ve-2vm-vek386-multidomain-cortexr52-0-zephyr versal-2ve-2vm-vek386-multidomain-cortexr52-1-baremetal versal-2ve-2vm-vek386-multidomain-microblaze-pmc"
MACHINEOVERRIDES .= ":versal-2ve-2vm-vek386-sdt-seg"

#### Preamble
MACHINEOVERRIDES =. "${@['', 'versal-2ve-2vm-vek386-multidomain:']['versal-2ve-2vm-vek386-multidomain' !='${MACHINE}']}"
#### Regular settings follow
TUNEFILE[microblaze-pmc] = "conf/machine/include/versal-2ve-2vm-vek386-multidomain/microblaze.inc"

# Platform Loader and Manager
PLM_DEPENDS = ""
PLM_MCDEPENDS = "mc::versal-2ve-2vm-vek386-multidomain-microblaze-pmc:plm-firmware:do_deploy"
PLM_DEPLOY_DIR = "${TMPDIR}-versal-2ve-2vm-vek386-multidomain-microblaze-pmc/deploy/images/${MACHINE}"

# Set the default (linux) domain device tree
CONFIG_DTFILE_DIR := "${@bb.utils.which(d.getVar('BBPATH'), 'conf/dts/versal-2ve-2vm-vek386-multidomain')}"
CONFIG_DTFILE ?= "${CONFIG_DTFILE_DIR}/cortexa78-linux.dts"
CONFIG_DTFILE[vardepsexclude] += "CONFIG_DTFILE_DIR"

DTB_FILE_PATH ?= "${RECIPE_SYSROOT}/boot/devicetree/${@os.path.basename(d.getVar('CONFIG_DTFILE').replace('.dts', '.dtb'))}"

# Serial Console Settings
SERIAL_CONSOLES ?= "115200;ttyAMA1"

# Yocto arm-trusted-firmware(TF-A) variables
TFA_CONSOLE ?= "pl011_1"
ATF_MEM_BASE ?= "0x1600000"
ATF_MEM_SIZE ?= "0x200000"
TFA_BL33_LOAD ?= "0x40000000"

# Yocto OP-TEE variables
OPTEE_CONSOLE ?= "1"

# Yocto u-boot-xlnx variables

# Set DDR Base address for u-boot-xlnx-scr variables
DDR_BASEADDR ?= "0x0"
SKIP_APPEND_BASEADDR ?= "1"

# Yocto KERNEL Variables
UBOOT_ENTRYPOINT ?= "0x20200000"
UBOOT_LOADADDRESS ?= "0x20200000"

# Yocto MACHINE_FEATURES Variable
MACHINE_FEATURES += "vcu2 malig78ae optee fpga-overlay efi"

# Required generic machine inclusion
require conf/machine/versal-2ve-2vm-generic.conf

# QEMU Memory Configuration
QB_MEM = "-machine dynamic-mem=on -device amd-ddr-memory,address=0x800000000,size=0x180000000 -device amd-ddr-memory,address=0x50000000000,size=0x200000000 -device amd-ddr-memory,address=0x60000000000,size=0x100000000"

QEMU_HW_DTB_PS = "${QEMU_HW_DTB_PATH}/board-versal2-psxc-vek386.dtb"
QEMU_HW_SERIAL = "-serial null -serial null -serial null -serial mon:stdio"
QEMU_FLASH_TYPE = "ospi"
QB_DEFAULT_FSTYPE = "wic.ufs"
# OSPI flash size (256MB)
SPI_IMAGE_SIZE = "0x1000_0000"
QEMU_SECONDARY_BOOT_MODE = "11"
# Enable meta-xilinx-imgrcvry if available
include conf/enable-xilinx-imgrcvry.conf
# Enables the restoration of the multi-boot register for A/B firmware platforms
XLNX_CMAKE_BSP_VARS:pn-xilplmi:append = " -DPLM_ENABLE_RESTORE_MULTIBOOT"
# UEFI Capsule Update / LVFS Configuration
PRODUCT_NAME = "VEK386"
PRODUCT_GUID = "be7dd653-a934-586e-bda8-de8433dbd3b7"
PRODUCT_URL = "https://www.amd.com/en/products/adaptive-socs-and-fpgas/versal.html"
# Enable Push Button support
CFLAGS:pn-image-selector:append = " -DXIS_ENABLE_PB"
# Enable libmetal application
BOOTBIN_INC = "libmetal-demo-rpu1.inc"

# This is an 'SDT' based BSP
XILINX_WITH_ESW = "sdt"

# Original SDT artifacts URL
SDT_URI = "https://edf.amd.com/sswreleases/rel-v2026.1/sdt/2026.1/2026.1_0609_1_06092108/external/versal-2ve-2vm-vek386-sdt-seg/versal-2ve-2vm-vek386-sdt-seg_2026.1_0609_1_06092108.tar.gz"
SDT_URI[sha256sum] = "1aa67cef5e35376043e146c66b76520d46fcf90bffef4f30dfee06fbaa655709"
SDT_URI[S] = "${WORKDIR}/versal-2ve-2vm-vek386-sdt-seg_2026.1_0609_1_06092108"

# Set the system device trees
SYSTEM_DTFILE_DEPENDS = "sdt-artifacts"
SYSTEM_DTFILE_DIR = "${RECIPE_SYSROOT}${datadir}/sdt/${MACHINE}"
SYSTEM_DTFILE = "${SYSTEM_DTFILE_DIR}/system-top.dts"

# Load the dynamic machine features
include conf/machine/include/versal-2ve-2vm-vek386-multidomain/${BB_CURRENT_MC}-features.conf
LIBXIL_CONFIG = "conf/machine/include/versal-2ve-2vm-vek386-multidomain/${BB_CURRENT_MC}-libxil.conf"

# PDI variables
PDI_PATH_DEPENDS = "sdt-artifacts"
PDI_PATH_DIR = "${RECIPE_SYSROOT}${datadir}/sdt/${MACHINE}"
PDI_PATH = "${PDI_PATH_DIR}/vek386_base_boot.pdi"

# Primary Bootmode value
DEFAULT_HW_BOOT_MODE = "8"

# Update bootbin to use proper device tree
BIF_PARTITION_IMAGE[device-tree] = "${DTB_FILE_PATH}"

# Remap boot files to ensure the right device tree is listed first
IMAGE_BOOT_FILES =+ "devicetree/${@os.path.basename(d.getVar('CONFIG_DTFILE').replace('.dts', '.dtb'))}"
PACKAGE_EXTRA_ARCHS:append = " versal_2ve_2vm_vek386_sdt_seg"

#### No additional settings should be after the Postamble
#### Postamble
PACKAGE_EXTRA_ARCHS:append = "${@['', ' versal_2ve_2vm_vek386_multidomain']['versal-2ve-2vm-vek386-multidomain' != '${MACHINE}']}"
```

## meta-amd-adaptive-socs-bsp/conf/machine/versal-vck190-multidomain.conf
```bitbake
#@TYPE: Machine
#@NAME: versal-vck190-multidomain
#@DESCRIPTION: AMP/multidomain machine for the AMD Versal AI Core VCK190 evaluation kit: Cortex-A72 Linux, Cortex-R5 FreeRTOS/baremetal, and MicroBlaze PMC/PSM sub-machines built from system device tree.

BBMULTICONFIG += "versal-vck190-multidomain-microblaze-pmc versal-vck190-multidomain-microblaze-psm versal-vck190-multidomain-cortexr5-0-freertos versal-vck190-multidomain-cortexr5-1-baremetal"
MACHINEOVERRIDES .= ":versal-vck190-sdt-seg"

#### Preamble
MACHINEOVERRIDES =. "${@['', 'versal-vck190-multidomain:']['versal-vck190-multidomain' !='${MACHINE}']}"
#### Regular settings follow
TUNEFILE[microblaze-pmc] = "conf/machine/include/versal-vck190-multidomain/microblaze.inc"
TUNEFILE[microblaze-psm] = "conf/machine/include/versal-vck190-multidomain/microblaze.inc"

# Platform Loader and Manager
PLM_DEPENDS = ""
PLM_MCDEPENDS = "mc::versal-vck190-multidomain-microblaze-pmc:plm-firmware:do_deploy"
PLM_DEPLOY_DIR = "${TMPDIR}-versal-vck190-multidomain-microblaze-pmc/deploy/images/${MACHINE}"

# PSM Firmware
PSM_DEPENDS = ""
PSM_MCDEPENDS = "mc::versal-vck190-multidomain-microblaze-psm:psm-firmware:do_deploy"
PSM_FIRMWARE_DEPLOY_DIR = "${TMPDIR}-versal-vck190-multidomain-microblaze-psm/deploy/images/${MACHINE}"

# Set the default (linux) domain device tree
CONFIG_DTFILE_DIR := "${@bb.utils.which(d.getVar('BBPATH'), 'conf/dts/versal-vck190-multidomain')}"
CONFIG_DTFILE ?= "${CONFIG_DTFILE_DIR}/cortexa72-linux.dts"
CONFIG_DTFILE[vardepsexclude] += "CONFIG_DTFILE_DIR"

DTB_FILE_PATH ?= "${RECIPE_SYSROOT}/boot/devicetree/${@os.path.basename(d.getVar('CONFIG_DTFILE').replace('.dts', '.dtb'))}"

# Serial Console Settings
SERIAL_CONSOLES ?= "115200;ttyAMA0"

# Yocto arm-trusted-firmware(TF-A) variables
TFA_CONSOLE ?= "pl011"
TFA_BL33_LOAD ?= "0x8000000"

# Yocto u-boot-xlnx variables

# Set DDR Base address for u-boot-xlnx-scr variables
DDR_BASEADDR ?= "0x0"
SKIP_APPEND_BASEADDR ?= "0"

# Yocto KERNEL Variables
UBOOT_ENTRYPOINT ?= "0x200000"
UBOOT_LOADADDRESS ?= "0x200000"

# Yocto MACHINE_FEATURES Variable
MACHINE_FEATURES += "vdu fpga-overlay efi"

# Required generic machine inclusion
require conf/machine/versal-generic.conf

# QEMU Memory Configuration
QB_MEM = "-machine dynamic-mem=on -device amd-ddr-memory,address=0x800000000,size=0x180000000 -device amd-ddr-memory,address=0x50000000000,size=0x100000000 -device amd-ddr-memory,address=0x60000000000,size=0x100000000"

QEMU_HW_DTB_PS = "${QEMU_HW_DTB_PATH}/board-versal-ps-vck190.dtb"
QEMU_HW_DTB_PMC = "${QEMU_HW_DTB_PATH}/board-versal-pmc-virt.dtb"
QEMU_FLASH_TYPE = "qspi"
# QSPI flash size (256MB) - XBM daughter card
SPI_IMAGE_SIZE = "0x1000_0000"
# Boot.bin A/B offsets for 256MB QSPI
SPI_BOOTBIN_OFFSET = "0x15C_0000 0x47C_0000"
SPI_USER_SCRATCH_OFFSET = "0x7A0_0000"
SPI_MANIFEST_OFFSET = "0x7FF_0000"
# Enable meta-xilinx-imgrcvry if available
include conf/enable-xilinx-imgrcvry.conf
# Enables the restoration of the multi-boot register for A/B firmware platforms
XLNX_CMAKE_BSP_VARS:pn-xilplmi:append = " -DPLM_ENABLE_RESTORE_MULTIBOOT"
# Enable QSPI flash
CFLAGS:pn-image-selector:append = " -DXIS_QSPI_FLSH"
# Enable libmetal application
BOOTBIN_INC = "libmetal-demo-rpu1.inc"

# This is an 'SDT' based BSP
XILINX_WITH_ESW = "sdt"

# Original SDT artifacts URL
SDT_URI = "https://edf.amd.com/sswreleases/rel-v2026.1/sdt/2026.1/2026.1_0609_1_06092108/external/versal-vck190-sdt-seg/versal-vck190-sdt-seg_2026.1_0609_1_06092108.tar.gz"
SDT_URI[sha256sum] = "f9daccb1e2b3c8928996de3ae671dcdbe8c15a8f692c9772f43c424501792d2a"
SDT_URI[S] = "${WORKDIR}/versal-vck190-sdt-seg_2026.1_0609_1_06092108"

# Set the system device trees
SYSTEM_DTFILE_DEPENDS = "sdt-artifacts"
SYSTEM_DTFILE_DIR = "${RECIPE_SYSROOT}${datadir}/sdt/${MACHINE}"
SYSTEM_DTFILE = "${SYSTEM_DTFILE_DIR}/system-top.dts"

# Load the dynamic machine features
include conf/machine/include/versal-vck190-multidomain/${BB_CURRENT_MC}-features.conf
LIBXIL_CONFIG = "conf/machine/include/versal-vck190-multidomain/${BB_CURRENT_MC}-libxil.conf"

# PDI variables
PDI_PATH_DEPENDS = "sdt-artifacts"
PDI_PATH_DIR = "${RECIPE_SYSROOT}${datadir}/sdt/${MACHINE}"
PDI_PATH = "${PDI_PATH_DIR}/vck190_base_boot.pdi"

# Primary Bootmode value
DEFAULT_HW_BOOT_MODE = "14"

# Update bootbin to use proper device tree
BIF_PARTITION_IMAGE[device-tree] = "${DTB_FILE_PATH}"

# Remap boot files to ensure the right device tree is listed first
IMAGE_BOOT_FILES =+ "devicetree/${@os.path.basename(d.getVar('CONFIG_DTFILE').replace('.dts', '.dtb'))}"
PACKAGE_EXTRA_ARCHS:append = " versal_vck190_sdt_seg"

#### No additional settings should be after the Postamble
#### Postamble
PACKAGE_EXTRA_ARCHS:append = "${@['', ' versal_vck190_multidomain']['versal-vck190-multidomain' != '${MACHINE}']}"
```
