## meta-amd-adaptive-socs-bsp/conf/machine/include/mbv64-sp701-sdt/microblaze-v.inc
```bitbake
# compatible = "xlnx,microblaze_v";
TUNE_FEATURES:tune-microblaze-v = "${@oe.tune.riscv_isa_to_tune("rv64imafdcb_zicsr_zifencei_zbc_zicbom")}"
```

## meta-amd-adaptive-socs-bsp/conf/machine/include/versal-2ve-2vm-vek385-sdt-seg/microblaze-riscv.inc
```bitbake
# compatible = "xlnx,asu-microblaze_riscv";
TUNEVALID[rv32imac_zicsr_zifencei] = "Enable-march=rv32imac_zicsr_zifencei"
TUNE_CCARGS:append = "${@bb.utils.contains('TUNE_FEATURES', 'rv32imac_zicsr_zifencei', ' -march=rv32imac_zicsr_zifencei', ' ', d)}"
AVAILTUNES += "microblaze-riscv-asu"
TUNE_FEATURES:tune-microblaze-riscv-asu = "riscv32nf rv32imac_zicsr_zifencei"
TUNE_ARCH:tune-microblaze-riscv-asu = "riscv32"
TUNE_PKGARCH:tune-microblaze-riscv-asu = "riscv32nf"
PACKAGE_EXTRA_ARCHS:tune-microblaze-riscv-asu = "${TUNE_PKGARCH}"

require conf/machine/include/riscv/tune-riscv.inc
```

## meta-amd-adaptive-socs-bsp/conf/machine/include/versal-2ve-2vm-vek385-sdt-seg/versal-2ve-2vm-vek385-sdt-seg-microblaze-pmc-features.conf
```bitbake
MACHINE_FEATURES = "canfd cframe cfupmc common csudma dcsub emacps gpiops iicps iomodule ipipsu mmidp ospipsv rtcpsu sysmonpsv tmr-inject tmr-manager trngpsx ttcps uartpsv ufspsxc usbpsu video-common xdmapcie zdma"
```

## meta-amd-adaptive-socs-bsp/conf/machine/include/versal-2ve-2vm-vek385-sdt-seg/versal-2ve-2vm-vek385-sdt-seg-microblaze-pmc-libxil.conf
```bitbake
PACKAGECONFIG[canfd] = "${RECIPE_SYSROOT}/usr/lib/libcanfd.a,,canfd,,"
PACKAGECONFIG[cframe] = "${RECIPE_SYSROOT}/usr/lib/libcframe.a,,cframe,,"
PACKAGECONFIG[cfupmc] = "${RECIPE_SYSROOT}/usr/lib/libcfupmc.a,,cfupmc,,"
PACKAGECONFIG[common] = "${RECIPE_SYSROOT}/usr/lib/libcommon.a,,common,,"
PACKAGECONFIG[csudma] = "${RECIPE_SYSROOT}/usr/lib/libcsudma.a,,csudma,,"
PACKAGECONFIG[dcsub] = "${RECIPE_SYSROOT}/usr/lib/libdcsub.a,,dcsub,,"
PACKAGECONFIG[emacps] = "${RECIPE_SYSROOT}/usr/lib/libemacps.a,,emacps,,"
PACKAGECONFIG[gpiops] = "${RECIPE_SYSROOT}/usr/lib/libgpiops.a,,gpiops,,"
PACKAGECONFIG[iicps] = "${RECIPE_SYSROOT}/usr/lib/libiicps.a,,iicps,,"
PACKAGECONFIG[iomodule] = "${RECIPE_SYSROOT}/usr/lib/libiomodule.a,,iomodule,,"
PACKAGECONFIG[ipipsu] = "${RECIPE_SYSROOT}/usr/lib/libipipsu.a,,ipipsu,,"
PACKAGECONFIG[mmidp] = "${RECIPE_SYSROOT}/usr/lib/libmmidp.a,,mmidp,,"
PACKAGECONFIG[ospipsv] = "${RECIPE_SYSROOT}/usr/lib/libospipsv.a,,ospipsv,,"
PACKAGECONFIG[rtcpsu] = "${RECIPE_SYSROOT}/usr/lib/librtcpsu.a,,rtcpsu,,"
PACKAGECONFIG[sysmonpsv] = "${RECIPE_SYSROOT}/usr/lib/libsysmonpsv.a,,sysmonpsv,,"
PACKAGECONFIG[tmr-inject] = "${RECIPE_SYSROOT}/usr/lib/libtmr_inject.a,,tmr-inject,,"
PACKAGECONFIG[tmr-manager] = "${RECIPE_SYSROOT}/usr/lib/libtmr_manager.a,,tmr-manager,,"
PACKAGECONFIG[trngpsx] = "${RECIPE_SYSROOT}/usr/lib/libtrngpsx.a,,trngpsx,,"
PACKAGECONFIG[ttcps] = "${RECIPE_SYSROOT}/usr/lib/libttcps.a,,ttcps,,"
PACKAGECONFIG[uartpsv] = "${RECIPE_SYSROOT}/usr/lib/libuartpsv.a,,uartpsv,,"
PACKAGECONFIG[ufspsxc] = "${RECIPE_SYSROOT}/usr/lib/libufspsxc.a,,ufspsxc,,"
PACKAGECONFIG[usbpsu] = "${RECIPE_SYSROOT}/usr/lib/libusbpsu.a,,usbpsu,,"
PACKAGECONFIG[video-common] = "${RECIPE_SYSROOT}/usr/lib/libvideo_common.a,,video-common,,"
PACKAGECONFIG[xdmapcie] = "${RECIPE_SYSROOT}/usr/lib/libxdmapcie.a,,xdmapcie,,"
PACKAGECONFIG[zdma] = "${RECIPE_SYSROOT}/usr/lib/libzdma.a,,zdma,,"
```

## meta-amd-adaptive-socs-bsp/conf/machine/include/versal-2ve-2vm-vek385-sdt-seg/versal-2ve-2vm-vek385-sdt-seg-microblaze-riscv-asu-features.conf
```bitbake
MACHINE_FEATURES = "common csudma dcsub emacps gpiops iicps iomodule ipipsu mmidp rtcpsu uartpsv usbpsu video-common xdmapcie"
```

## meta-amd-adaptive-socs-bsp/conf/machine/include/versal-2ve-2vm-vek385-sdt-seg/versal-2ve-2vm-vek385-sdt-seg-microblaze-riscv-asu-libxil.conf
```bitbake
PACKAGECONFIG[common] = "${RECIPE_SYSROOT}/usr/lib/libcommon.a,,common,,"
PACKAGECONFIG[csudma] = "${RECIPE_SYSROOT}/usr/lib/libcsudma.a,,csudma,,"
PACKAGECONFIG[dcsub] = "${RECIPE_SYSROOT}/usr/lib/libdcsub.a,,dcsub,,"
PACKAGECONFIG[emacps] = "${RECIPE_SYSROOT}/usr/lib/libemacps.a,,emacps,,"
PACKAGECONFIG[gpiops] = "${RECIPE_SYSROOT}/usr/lib/libgpiops.a,,gpiops,,"
PACKAGECONFIG[iicps] = "${RECIPE_SYSROOT}/usr/lib/libiicps.a,,iicps,,"
PACKAGECONFIG[iomodule] = "${RECIPE_SYSROOT}/usr/lib/libiomodule.a,,iomodule,,"
PACKAGECONFIG[ipipsu] = "${RECIPE_SYSROOT}/usr/lib/libipipsu.a,,ipipsu,,"
PACKAGECONFIG[mmidp] = "${RECIPE_SYSROOT}/usr/lib/libmmidp.a,,mmidp,,"
PACKAGECONFIG[rtcpsu] = "${RECIPE_SYSROOT}/usr/lib/librtcpsu.a,,rtcpsu,,"
PACKAGECONFIG[uartpsv] = "${RECIPE_SYSROOT}/usr/lib/libuartpsv.a,,uartpsv,,"
PACKAGECONFIG[usbpsu] = "${RECIPE_SYSROOT}/usr/lib/libusbpsu.a,,usbpsu,,"
PACKAGECONFIG[video-common] = "${RECIPE_SYSROOT}/usr/lib/libvideo_common.a,,video-common,,"
PACKAGECONFIG[xdmapcie] = "${RECIPE_SYSROOT}/usr/lib/libxdmapcie.a,,xdmapcie,,"
```

## meta-amd-adaptive-socs-bsp/conf/machine/include/versal-2ve-2vm-vmk365-multidomain/versal-2ve-2vm-vmk365-multidomain-cortexr52-1-baremetal-features.conf
```bitbake
MACHINE_FEATURES = "cframe cfupmc common coresightps-dcc csudma emacps gpiops i3cpsx ipipsu ospipsv rtcpsu scugic sdps sysmonpsv trngpsx ttcps uartpsv ufspsxc usbpsu zdma"
```

## meta-amd-adaptive-socs-bsp/conf/machine/include/versal-2ve-2vm-vmk365-multidomain/versal-2ve-2vm-vmk365-multidomain-cortexr52-1-baremetal-libxil.conf
```bitbake
PACKAGECONFIG[cframe] = "${RECIPE_SYSROOT}/usr/lib/libcframe.a,,cframe,,"
PACKAGECONFIG[cfupmc] = "${RECIPE_SYSROOT}/usr/lib/libcfupmc.a,,cfupmc,,"
PACKAGECONFIG[common] = "${RECIPE_SYSROOT}/usr/lib/libcommon.a,,common,,"
PACKAGECONFIG[coresightps-dcc] = "${RECIPE_SYSROOT}/usr/lib/libcoresightps_dcc.a,,coresightps-dcc,,"
PACKAGECONFIG[csudma] = "${RECIPE_SYSROOT}/usr/lib/libcsudma.a,,csudma,,"
PACKAGECONFIG[emacps] = "${RECIPE_SYSROOT}/usr/lib/libemacps.a,,emacps,,"
PACKAGECONFIG[gpiops] = "${RECIPE_SYSROOT}/usr/lib/libgpiops.a,,gpiops,,"
PACKAGECONFIG[i3cpsx] = "${RECIPE_SYSROOT}/usr/lib/libi3cpsx.a,,i3cpsx,,"
PACKAGECONFIG[ipipsu] = "${RECIPE_SYSROOT}/usr/lib/libipipsu.a,,ipipsu,,"
PACKAGECONFIG[ospipsv] = "${RECIPE_SYSROOT}/usr/lib/libospipsv.a,,ospipsv,,"
PACKAGECONFIG[rtcpsu] = "${RECIPE_SYSROOT}/usr/lib/librtcpsu.a,,rtcpsu,,"
PACKAGECONFIG[scugic] = "${RECIPE_SYSROOT}/usr/lib/libscugic.a,,scugic,,"
PACKAGECONFIG[sdps] = "${RECIPE_SYSROOT}/usr/lib/libsdps.a,,sdps,,"
PACKAGECONFIG[sysmonpsv] = "${RECIPE_SYSROOT}/usr/lib/libsysmonpsv.a,,sysmonpsv,,"
PACKAGECONFIG[trngpsx] = "${RECIPE_SYSROOT}/usr/lib/libtrngpsx.a,,trngpsx,,"
PACKAGECONFIG[ttcps] = "${RECIPE_SYSROOT}/usr/lib/libttcps.a,,ttcps,,"
PACKAGECONFIG[uartpsv] = "${RECIPE_SYSROOT}/usr/lib/libuartpsv.a,,uartpsv,,"
PACKAGECONFIG[ufspsxc] = "${RECIPE_SYSROOT}/usr/lib/libufspsxc.a,,ufspsxc,,"
PACKAGECONFIG[usbpsu] = "${RECIPE_SYSROOT}/usr/lib/libusbpsu.a,,usbpsu,,"
PACKAGECONFIG[zdma] = "${RECIPE_SYSROOT}/usr/lib/libzdma.a,,zdma,,"
```

## meta-amd-adaptive-socs-bsp/conf/machine/include/versal-2ve-2vm-vmk365-multidomain/versal-2ve-2vm-vmk365-multidomain-microblaze-pmc-features.conf
```bitbake
MACHINE_FEATURES = "cframe cfupmc common csudma iomodule ipipsu qspipsu sdps sysmonpsv trngpsx ttcps uartpsv zdma"
```

## meta-amd-adaptive-socs-bsp/conf/machine/include/versal-2ve-2vm-vmk365-sdt-seg/versal-2ve-2vm-vmk365-sdt-seg-microblaze-pmc-features.conf
```bitbake
MACHINE_FEATURES = "cframe cfupmc common csudma emacps gpiops iicps iomodule ipipsu ospipsv sdps sysmonpsv trngpsx ttcps uartpsv ufspsxc usbpsu zdma"
```

## meta-amd-adaptive-socs-bsp/conf/machine/include/versal-2ve-2vm-vmk365-sdt-seg/versal-2ve-2vm-vmk365-sdt-seg-microblaze-pmc-libxil.conf
```bitbake
PACKAGECONFIG[cframe] = "${RECIPE_SYSROOT}/usr/lib/libcframe.a,,cframe,,"
PACKAGECONFIG[cfupmc] = "${RECIPE_SYSROOT}/usr/lib/libcfupmc.a,,cfupmc,,"
PACKAGECONFIG[common] = "${RECIPE_SYSROOT}/usr/lib/libcommon.a,,common,,"
PACKAGECONFIG[csudma] = "${RECIPE_SYSROOT}/usr/lib/libcsudma.a,,csudma,,"
PACKAGECONFIG[iomodule] = "${RECIPE_SYSROOT}/usr/lib/libiomodule.a,,iomodule,,"
PACKAGECONFIG[ipipsu] = "${RECIPE_SYSROOT}/usr/lib/libipipsu.a,,ipipsu,,"
PACKAGECONFIG[qspipsu] = "${RECIPE_SYSROOT}/usr/lib/libqspipsu.a,,qspipsu,,"
PACKAGECONFIG[sdps] = "${RECIPE_SYSROOT}/usr/lib/libsdps.a,,sdps,,"
PACKAGECONFIG[sysmonpsv] = "${RECIPE_SYSROOT}/usr/lib/libsysmonpsv.a,,sysmonpsv,,"
PACKAGECONFIG[trngpsx] = "${RECIPE_SYSROOT}/usr/lib/libtrngpsx.a,,trngpsx,,"
PACKAGECONFIG[ttcps] = "${RECIPE_SYSROOT}/usr/lib/libttcps.a,,ttcps,,"
PACKAGECONFIG[uartpsv] = "${RECIPE_SYSROOT}/usr/lib/libuartpsv.a,,uartpsv,,"
PACKAGECONFIG[zdma] = "${RECIPE_SYSROOT}/usr/lib/libzdma.a,,zdma,,"
```

## meta-amd-adaptive-socs-bsp/conf/machine/include/versal-vek280-sdt-seg/versal-vek280-sdt-seg-cortexr5-0-freertos-libxil.conf
```bitbake
PACKAGECONFIG[common] = "${RECIPE_SYSROOT}/usr/lib/libcommon.a,,common,,"
PACKAGECONFIG[ipipsu] = "${RECIPE_SYSROOT}/usr/lib/libipipsu.a,,ipipsu,,"
PACKAGECONFIG[scugic] = "${RECIPE_SYSROOT}/usr/lib/libscugic.a,,scugic,,"
PACKAGECONFIG[ttcps] = "${RECIPE_SYSROOT}/usr/lib/libttcps.a,,ttcps,,"
```

## meta-amd-adaptive-socs-bsp/conf/machine/include/versal-vmk180-md/versal-vmk180-md-cortexr5-1-baremetal-features.conf
```bitbake
MACHINE_FEATURES = "canfd cframe cfupmc common coresightps-dcc csudma emacps gpiops iicps ipipsu qspipsu rtcpsu scugic sdps sysmonpsv trngpsv uartlite uartpsv usbpsu zdma"
```

## meta-amd-adaptive-socs-bsp/conf/machine/include/versal-vmk180-sdt-seg/versal-vmk180-sdt-seg-microblaze-psm-features.conf
```bitbake
MACHINE_FEATURES = "canfd cframe cfupmc common csudma emacps gpiops iicps iomodule ipipsu qspipsu rtcpsu sdps sysmonpsv tmr-inject tmr-manager trngpsv ttcps uartlite uartpsv usbpsu zdma"
```

## meta-amd-adaptive-socs-bsp/conf/machine/include/versal-vpk120-md/versal-vpk120-md-cortexr5-1-baremetal-features.conf
```bitbake
MACHINE_FEATURES = "cframe cfupmc common coresightps-dcc csudma emacps gpiops iicps ipipsu qspipsu rtcpsu scugic sdps sysmonpsv trngpsv uartlite uartpsv usbpsu zdma"
```

## meta-amd-adaptive-socs-bsp/conf/machine/include/versal-vpk120-multidomain/versal-vpk120-multidomain-microblaze-psm-features.conf
```bitbake
MACHINE_FEATURES = "cframe cfupmc common csudma emacps gpiops iicps iomodule ipipsu qspipsu rtcpsu sdps sysmonpsv tmr-inject tmr-manager trngpsv ttcps uartlite uartpsv usbpsu zdma"
```

## meta-amd-adaptive-socs-bsp/conf/machine/include/versal-vpk180-multidomain/versal-vpk180-multidomain-cortexr5-1-baremetal-features.conf
```bitbake
MACHINE_FEATURES = "cframe cfupmc common coresightps-dcc csudma emacps gpiops iicps ipipsu qspipsu rtcpsu scugic sdps sysmonpsv trngpsv ttcps uartlite uartpsv usbpsu zdma"
```

## meta-amd-adaptive-socs-bsp/conf/machine/include/versal-vpk360-sdt-seg/versal-vpk360-sdt-seg-microblaze-pmc-features.conf
```bitbake
MACHINE_FEATURES = "cframe cfupmc common csudma emacps gpiops iicps iomodule ipipsu ospipsv sdps sysmonpsv trngpsv uartlite uartpsv usbpsu zdma"
```

## meta-amd-adaptive-socs-bsp/conf/machine/include/versal-vpk360-sdt-seg/versal-vpk360-sdt-seg-microblaze-psm-features.conf
```bitbake
MACHINE_FEATURES = "cframe cfupmc common csudma emacps gpiops iicps iomodule ipipsu ospipsv rtcpsu sdps sysmonpsv tmr-inject tmr-manager trngpsv uartlite uartpsv usbpsu zdma"
```

## meta-amd-adaptive-socs-bsp/conf/machine/include/versal-vrk160-md/versal-vrk160-md-cortexr5-1-baremetal-features.conf
```bitbake
MACHINE_FEATURES = "cframe cfupmc common coresightps-dcc csudma emacps gpiops iicps ipipsu ospipsv rtcpsu scugic sdps sysmonpsv trngpsv uartlite uartpsv usbpsu zdma"
```

## meta-amd-adaptive-socs-bsp/conf/machine/mbv32-scu200-zephyr-sdt.conf
```bitbake
#@TYPE: Machine
#@NAME: mbv32-scu200-zephyr-sdt
#@DESCRIPTION: Machine configuration for the mbv32-scu200-zephyr-sdt boards.


#### Preamble
MACHINEOVERRIDES =. "${@['', 'mbv32-scu200-zephyr-sdt:']['mbv32-scu200-zephyr-sdt' !='${MACHINE}']}"
#### Regular settings follow

# MicroBlaze V Tune features Settings
DEFAULTTUNE = "microblaze-v"
require conf/machine/include/mbv32-scu200-zephyr-sdt/microblaze-v.inc

# Zephyr RTOS settings
ZEPHYR_BOARD = "mbv32"
ARCH = "riscv32"

# Warn if this machine is used with a non-Zephyr DISTRO
INHERIT += "xilinx-deprecated"
XILINX_DEPRECATED[mbv32-scu200-zephyr-sdt] = "${@'This configuration is only intended for use with DISTRO set to amd-zephyr.  It will likely fail with other configurations.' if (d.getVar('DISTRO') != 'amd-zephyr') else ''}"

# Set the default (zephyr) domain device tree
CONFIG_DTFILE_DIR := "${@bb.utils.which(d.getVar('BBPATH'), 'conf/dts/mbv32-scu200-zephyr-sdt')}"
CONFIG_DTFILE ?= "${CONFIG_DTFILE_DIR}/microblaze-riscv-zephyr.dts"
CONFIG_DTFILE[vardepsexclude] += "CONFIG_DTFILE_DIR"
ZEPHYR_SDT_BOARD_KCONFIG_DEFCONFIG = "${CONFIG_DTFILE_DIR}/microblaze-riscv-zephyr-board_Kconfig.defconfig"

# This is an 'SDT' based BSP
XILINX_WITH_ESW = "sdt"

# Original SDT artifacts URL
SDT_URI = "https://edf.amd.com/sswreleases/rel-v2026.2/sdt/2026.2/2026.2_0913_1_09130540/external/mbv32-scu200-zephyr-sdt/mbv32-scu200-zephyr-sdt_2026.2_0913_1_09130540.tar.gz"
SDT_URI[sha256sum] = "19e40e142da1179aef4e8b33611df857c1048692a0db54ab9520c6bc55346160"
SDT_URI[S] = "${UNPACKDIR}/mbv32-scu200-zephyr-sdt_2026.2_0913_1_09130540"

# PDI variables
PDI_PATH_DEPENDS = "sdt-artifacts"
PDI_PATH_DIR = "${RECIPE_SYSROOT}${datadir}/sdt/${MACHINE}"
PDI_PATH = "${PDI_PATH_DIR}/scu200_zephyr_32bit.pdi"

#### No additional settings should be after the Postamble
#### Postamble
PACKAGE_EXTRA_ARCHS:append = "${@['', ' mbv32_scu200_zephyr_sdt']['mbv32-scu200-zephyr-sdt' != '${MACHINE}']}"
```
