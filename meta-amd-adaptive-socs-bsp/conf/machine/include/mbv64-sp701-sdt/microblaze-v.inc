## meta-amd-adaptive-socs-bsp/conf/machine/versal-2ve-2vm-vek385-md.conf
```bitbake
#@TYPE: Machine
#@NAME: versal-2ve-2vm-vek385-md
#@DESCRIPTION: Machine configuration for the versal-2ve-2vm-vek385-md boards.


BBMULTICONFIG += "versal-2ve-2vm-vek385-md-cortexr52-0-zephyr versal-2ve-2vm-vek385-md-cortexr52-1-baremetal versal-2ve-2vm-vek385-md-microblaze-pmc"
MACHINEOVERRIDES .= ":versal-2ve-2vm-vek385-sdt-seg"

#### Preamble
MACHINEOVERRIDES =. "${@['', 'versal-2ve-2vm-vek385-md:']['versal-2ve-2vm-vek385-md' !='${MACHINE}']}"
#### Regular settings follow
TUNEFILE[microblaze-pmc] = "conf/machine/include/versal-2ve-2vm-vek385-md/microblaze.inc"

# Platform Loader and Manager
PLM_DEPENDS = ""
PLM_MCDEPENDS = "mc::versal-2ve-2vm-vek385-md-microblaze-pmc:plm-firmware:do_deploy"
PLM_DEPLOY_DIR = "${TMPDIR}-versal-2ve-2vm-vek385-md-microblaze-pmc/deploy/images/${MACHINE}"

# Set the default (linux) domain device tree
CONFIG_DTFILE_DIR := "${@bb.utils.which(d.getVar('BBPATH'), 'conf/dts/versal-2ve-2vm-vek385-md')}"
CONFIG_DTFILE ?= "${CONFIG_DTFILE_DIR}/cortexa78-linux.dts"
CONFIG_DTFILE[vardepsexclude] += "CONFIG_DTFILE_DIR"

# Serial Console Settings
SERIAL_CONSOLES ?= "115200;ttyAMA1"

# Yocto arm-trusted-firmware(TF-A) variables
TFA_CONSOLE ?= "pl011_1"
ATF_MEM_BASE ?= "0x1600000"
ATF_MEM_SIZE ?= "0x200000"
TFA_BL33_LOAD ?= "0x40000000"

# Yocto OP-TEE variables
OPTEE_CONSOLE ?= "1"

# Yocto u-boot-xlnx variables

# Set DDR Base address for u-boot-xlnx-scr variables
DDR_BASEADDR ?= "0x0"
SKIP_APPEND_BASEADDR ?= "1"

# Yocto KERNEL Variables
UBOOT_ENTRYPOINT ?= "0x20200000"
UBOOT_LOADADDRESS ?= "0x20200000"

# Yocto MACHINE_FEATURES Variable
MACHINE_FEATURES += "vcu2 malig78ae optee fpga-overlay efi"

# Required generic machine inclusion
require conf/machine/versal-2ve-2vm-generic.conf

QEMU_HW_DTB_PS = "${QEMU_HW_DTB_PATH}/board-versal2-psxc-vek385.dtb"
QEMU_HW_BOOT_MODE = "8"
QEMU_HW_SERIAL = "-serial null -serial null -serial null -serial mon:stdio"
QEMU_HW_OSPI_FILE = "qemu-ospi-${MACHINE}.bin"
QB_OPT_APPEND:append := " -drive file=@DEPLOY_DIR_IMAGE@/${QEMU_HW_OSPI_FILE},if=mtd,format=raw,index=0"
QB_DEFAULT_FSTYPE = "wic.ufs"
QB_ROOTFS_OPT = "-device scsi-hd,drive=d1,bus=scsi.0,channel=0,scsi-id=0,lun=0,logical_block_size=4096,physical_block_size=4096 -drive file=@ROOTFS@,if=none,id=d1,format=raw"
# Enable meta-xilinx-imgrcvry if available
include conf/enable-xilinx-imgrcvry.conf
# Enables the restoration of the multi-boot register for A/B firmware platforms
XLNX_CMAKE_BSP_VARS:pn-xilplmi:append = " -DPLM_ENABLE_RESTORE_MULTIBOOT"
# UEFI Capsule Update / LVFS Configuration
PRODUCT_NAME = "VEK385"
PRODUCT_GUID = "cb27e54d-8f3a-4c77-8a72-1c76d2d4e938"
PRODUCT_URL = "https://www.amd.com/en/products/adaptive-socs-and-fpgas/versal.html"
# Enable hello-world application
BOOTBIN_INC = "versal-2ve-2vm-hello-world-r52-1-baremetal.inc"

# This is an 'SDT' based BSP
XILINX_WITH_ESW = "sdt"

# Original SDT artifacts URL
SDT_URI = "https://edf.amd.com/sswreleases/rel-v2026.1/sdt/2026.1/2026.1_0225_1_02260207/external/versal-2ve-2vm-vek385-sdt-seg/versal-2ve-2vm-vek385-sdt-seg_2026.1_0225_1_02260207.tar.gz"
SDT_URI[sha256sum] = "60d97cfe55aad16e6ea0b1a488b26d62afde030a7ebf9d3b19c4edc230d7a8d5"
SDT_URI[S] = "${WORKDIR}/versal-2ve-2vm-vek385-sdt-seg_2026.1_0225_1_02260207"

# Set the system device trees
SYSTEM_DTFILE_DEPENDS = "sdt-artifacts"
SYSTEM_DTFILE_DIR = "${RECIPE_SYSROOT}${datadir}/sdt/${MACHINE}"
SYSTEM_DTFILE = "${SYSTEM_DTFILE_DIR}/system-top.dts"

# Load the dynamic machine features
include conf/machine/include/versal-2ve-2vm-vek385-md/${BB_CURRENT_MC}-features.conf
LIBXIL_CONFIG = "conf/machine/include/versal-2ve-2vm-vek385-md/${BB_CURRENT_MC}-libxil.conf"

# PDI variables
PDI_PATH_DEPENDS = "sdt-artifacts"
PDI_PATH_DIR = "${RECIPE_SYSROOT}${datadir}/sdt/${MACHINE}"
PDI_PATH = "${PDI_PATH_DIR}/vek385_base_boot.pdi"

# Primary Bootmode value
DEFAULT_HW_BOOT_MODE = "8"

# Update bootbin to use proper device tree
BIF_PARTITION_IMAGE[device-tree] = "${RECIPE_SYSROOT}/boot/devicetree/${@os.path.basename(d.getVar('CONFIG_DTFILE').replace('.dts', '.dtb'))}"

# Remap boot files to ensure the right device tree is listed first
IMAGE_BOOT_FILES =+ "devicetree/${@os.path.basename(d.getVar('CONFIG_DTFILE').replace('.dts', '.dtb'))}"
PACKAGE_EXTRA_ARCHS:append = " versal_2ve_2vm_vek385_sdt_seg"

#### No additional settings should be after the Postamble
#### Postamble
PACKAGE_EXTRA_ARCHS:append = "${@['', ' versal_2ve_2vm_vek385_md']['versal-2ve-2vm-vek385-md' != '${MACHINE}']}"
```

## meta-amd-adaptive-socs-bsp/conf/machine/versal-2ve-2vm-vek385-sdt-seg.conf
```bitbake
#@TYPE: Machine
#@NAME: versal-2ve-2vm-vek385-sdt-seg
#@DESCRIPTION: Machine configuration for the versal-2ve-2vm-vek385-sdt-seg boards.


BBMULTICONFIG += "versal-2ve-2vm-vek385-sdt-seg-cortexr52-0-zephyr versal-2ve-2vm-vek385-sdt-seg-cortexr52-1-baremetal versal-2ve-2vm-vek385-sdt-seg-microblaze-pmc"

#### Preamble
MACHINEOVERRIDES =. "${@['', 'versal-2ve-2vm-vek385-sdt-seg:']['versal-2ve-2vm-vek385-sdt-seg' !='${MACHINE}']}"
#### Regular settings follow
TUNEFILE[microblaze-pmc] = "conf/machine/include/versal-2ve-2vm-vek385-sdt-seg/microblaze.inc"

# Platform Loader and Manager
PLM_DEPENDS = ""
PLM_MCDEPENDS = "mc::versal-2ve-2vm-vek385-sdt-seg-microblaze-pmc:plm-firmware:do_deploy"
PLM_DEPLOY_DIR = "${TMPDIR}-versal-2ve-2vm-vek385-sdt-seg-microblaze-pmc/deploy/images/${MACHINE}"

# Set the default (linux) domain device tree
CONFIG_DTFILE_DIR := "${@bb.utils.which(d.getVar('BBPATH'), 'conf/dts/versal-2ve-2vm-vek385-sdt-seg')}"
CONFIG_DTFILE ?= "${CONFIG_DTFILE_DIR}/cortexa78-linux.dts"
CONFIG_DTFILE[vardepsexclude] += "CONFIG_DTFILE_DIR"

# Serial Console Settings
SERIAL_CONSOLES ?= "115200;ttyAMA1"

# Yocto arm-trusted-firmware(TF-A) variables
TFA_CONSOLE ?= "pl011_1"
ATF_MEM_BASE ?= "0x1600000"
ATF_MEM_SIZE ?= "0x200000"
TFA_BL33_LOAD ?= "0x40000000"

# Yocto OP-TEE variables
OPTEE_CONSOLE ?= "1"

# Yocto u-boot-xlnx variables

# Set DDR Base address for u-boot-xlnx-scr variables
DDR_BASEADDR ?= "0x0"
SKIP_APPEND_BASEADDR ?= "1"

# Yocto KERNEL Variables
UBOOT_ENTRYPOINT ?= "0x20200000"
UBOOT_LOADADDRESS ?= "0x20200000"

# Yocto MACHINE_FEATURES Variable
MACHINE_FEATURES += "vcu2 malig78ae  optee fpga-overlay"

# Required generic machine inclusion
require conf/machine/versal-2ve-2vm-generic.conf

# Enable meta-xilinx-imgrcvry if available
include conf/enable-xilinx-imgrcvry.conf
QEMU_HW_DTB_PS = "${QEMU_HW_DTB_PATH}/board-versal2-psxc-vek385.dtb"
QEMU_HW_BOOT_MODE = "8"
QEMU_HW_SERIAL = "-serial null -serial null -serial null -serial mon:stdio"
QEMU_HW_OSPI_FILE = "qemu-ospi-${MACHINE}.bin"
QB_OPT_APPEND:append := " -drive file=@DEPLOY_DIR_IMAGE@/${QEMU_HW_OSPI_FILE},if=mtd,format=raw,index=0"
QB_DEFAULT_FSTYPE = "wic.ufs"
QB_ROOTFS_OPT = "-device scsi-hd,drive=d1,bus=scsi.0,channel=0,scsi-id=0,lun=0,logical_block_size=4096,physical_block_size=4096 -drive file=@ROOTFS@,if=none,id=d1,format=raw"
# GUID for the capsule update
UEFI_CAB_GUID = "cb27e54d-8f3a-4c77-8a72-1c76d2d4e938"
# Enables the restoration of the multi-boot register for A/B firmware platforms
XLNX_CMAKE_BSP_VARS:pn-xilplmi:append = " -DPLM_ENABLE_RESTORE_MULTIBOOT"

# This is an 'SDT' based BSP
XILINX_WITH_ESW = "sdt"

# Original SDT artifacts URL
SDT_URI = "https://edf.amd.com/sswreleases/rel-v2026.1/sdt/2026.1/2026.1_0108_1_01090000/external/versal-2ve-2vm-vek385-sdt-seg/versal-2ve-2vm-vek385-sdt-seg_2026.1_0108_1_01090000.tar.gz"
SDT_URI[sha256sum] = "ac752130a0c53ec5399c2bb1f34a6f976053682bb0427627bb7710e728ebf767"
SDT_URI[S] = "${WORKDIR}/versal-2ve-2vm-vek385-sdt-seg_2026.1_0108_1_01090000"

# Set the system device trees
SYSTEM_DTFILE_DEPENDS = "sdt-artifacts"
SYSTEM_DTFILE_DIR = "${RECIPE_SYSROOT}${datadir}/sdt/${MACHINE}"
SYSTEM_DTFILE = "${SYSTEM_DTFILE_DIR}/system-top.dts"

# Load the dynamic machine features
include conf/machine/include/versal-2ve-2vm-vek385-sdt-seg/${BB_CURRENT_MC}-features.conf
LIBXIL_CONFIG = "conf/machine/include/versal-2ve-2vm-vek385-sdt-seg/${BB_CURRENT_MC}-libxil.conf"

# Versal PDI
PDI_PATH_DEPENDS = "sdt-artifacts"
PDI_PATH_DIR = "${RECIPE_SYSROOT}${datadir}/sdt/${MACHINE}"
PDI_PATH = "${PDI_PATH_DIR}/vek385_base_boot.pdi"

# Update bootbin to use proper device tree
BIF_PARTITION_IMAGE[device-tree] = "${RECIPE_SYSROOT}/boot/devicetree/${@os.path.basename(d.getVar('CONFIG_DTFILE').replace('.dts', '.dtb'))}"

# Remap boot files to ensure the right device tree is listed first
IMAGE_BOOT_FILES =+ "devicetree/${@os.path.basename(d.getVar('CONFIG_DTFILE').replace('.dts', '.dtb'))}"

#### No additional settings should be after the Postamble
#### Postamble
PACKAGE_EXTRA_ARCHS:append = "${@['', ' versal_2ve_2vm_vek385_sdt_seg']['versal-2ve-2vm-vek385-sdt-seg' != '${MACHINE}']}"
```
