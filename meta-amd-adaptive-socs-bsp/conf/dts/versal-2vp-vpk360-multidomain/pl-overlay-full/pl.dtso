/dts-v1/;
/plugin/;

&fpga {
        firmware-name = "vpk360_base_pld.pdi";
};

&amba {

        zyxclmm_drm {
                interrupts = <0x0 0x89 0x4 0x0 0x90 0x4 0x0 0x91 0x4 0x0 0x92 0x4 0x0 0x93 0x4 0x0 0x94 0x4 0x0 0x95 0x4 0x0 0x96 0x4>;
                interrupt-parent = <&gic>;
                compatible = "xlnx,zocl-versal";
        };
};

