/dts-v1/;
/plugin/;
&fpga{
	#address-cells = <2>;
	#size-cells = <2>;
	firmware-name = "vek280_noAIE_SegConfig_pld.pdi";
};
&amba{
	#address-cells = <2>;
	#size-cells = <2>;
	axi_bram_ctrl_0: axi_bram_ctrl@20100000000 {
		xlnx,protocol = "AXI4";
		xlnx,edk-special = "BRAM_CTRL";
		compatible = "xlnx,axi-bram-ctrl-4.1";
		xlnx,ecc-onoff-reset-value = <0x0>;
		xlnx,ecc-type = <0x0>;
		xlnx,rd-cmd-optimization = <0x0>;
		xlnx,memory-depth = <0x800>;
		xlnx,use-ecc = <0x0>;
		xlnx,rable = <0x0>;
		xlnx,fault-inject = <0x0>;
		xlnx,ip-name = "axi_bram_ctrl";
		reg = <0x201 0x0 0x0 0x2000>;
		xlnx,bmg-instance = "EXTERNAL";
		clocks = <&versal_clk 0x41>;
		xlnx,s-axi-ctrl-addr-width = <0x20>;
		xlnx,read-latency = <0x1>;
		xlnx,s-axi-supports-narrow-burst = <0x0>;
		xlnx,id-width = <0x0>;
		xlnx,supports-narrow-burst = <0x0>;
		xlnx,single-port-bram = <0x1>;
		xlnx,ecc = <0x0>;
		xlnx,edk-iptype = "PERIPHERAL";
		status = "okay";
		clock-names = "s_axi_aclk";
		xlnx,bram-addr-width = <0xb>;
		xlnx,bram-inst-mode = "EXTERNAL";
		xlnx,data-width = <0x20>;
		xlnx,s-axi-ctrl-data-width = <0x20>;
		xlnx,s-axi-id-width = <0x1>;
		xlnx,mem-depth = <0x800>;
		xlnx,name = "axi_bram_ctrl_0";
	};
	axi_uartlite_0: axi_uartlite@20100010000 {
		interrupts = <0x0 0x54 0x1>;
		compatible = "xlnx,axi-uartlite-2.0", "xlnx,xps-uartlite-1.00.a";
		xlnx,uartlite-board-interface = "Custom";
		xlnx,s-axi-aclk-freq-hz-d = <0x13de4210>;
		interrupt-parent = <&gic_a72>;
		xlnx,rable = <0x0>;
		xlnx,ip-name = "axi_uartlite";
		reg = <0x201 0x10000 0x0 0x10000>;
		xlnx,baudrate = <0x1c200>;
		clocks = <&versal_clk 0x41>;
		current-speed = <0x1c200>;
		xlnx,use-parity = <0x0>;
		xlnx,edk-iptype = "PERIPHERAL";
		xlnx,odd-parity = <0x0>;
		status = "okay";
		clock-names = "s_axi_aclk";
		interrupt-names = "interrupt";
		xlnx,name = "axi_uartlite_0";
		xlnx,data-bits = <0x8>;
		xlnx,parity = "No_Parity";
	};
};