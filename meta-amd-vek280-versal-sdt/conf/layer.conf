## meta-amd-vek280-versal-sdt/conf/layer.conf
```bitbake
# We have a conf and classes directory, add to BBPATH
BBPATH .= ":${LAYERDIR}"

# We need to set sdtgen dts and pdi path in machine conf files instead of
# hardcoded path which was generated during gen-machine-conf sdt processing.
BSPLAYERDIR_amd-vek280-versal-sdt = "${LAYERDIR}"

# We have recipes-* directories, add to BBFILES
BBFILES += "${LAYERDIR}/recipes-*/*/*.bb \
            ${LAYERDIR}/recipes-*/*/*.bbappend"

BBFILE_COLLECTIONS += "amd-vek280-versal-sdt"
BBFILE_PATTERN_amd-vek280-versal-sdt = "^${LAYERDIR}/"
BBFILE_PRIORITY_amd-vek280-versal-sdt = "6"

LAYERDEPENDS_meta-amd-vek280-versal-sdt = "\
    core \
    xilinx \
    xilinx-standalone \
    xilinx-standalone-sdt \
    xilinx-microblaze \
    amd-adaptive-socs-core \
    openamp-layer \
    "

LAYERRECOMMENDS_amd-vek280-versal-sdt = "\
    xilinx-virtualization \
    virtualization-layer \
    security \
    tpm-layer \
    "

LAYERSERIES_COMPAT_amd-vek280-versal-sdt = "scarthgap"
```

## meta-amd-vek280-versal-sdt/conf/machine/include/xlnx-versal-vek280-revb/microblaze-0-pmc-features.conf
```bitbake
MACHINE_FEATURES = "canfd cframe cfupmc common csudma emacps gpiops iicps iomodule ipipsu ospipsv rtcpsu sdps sysmonpsv tmr-inject tmr-manager trngpsv uartlite uartpsv usbpsu zdma"
```

## meta-amd-vek280-versal-sdt/conf/machine/xlnx-versal-vek280-revb.conf
```bitbake
#@TYPE: Machine
#@NAME: xlnx-versal-vek280-revb
#@DESCRIPTION: Machine configuration for the xlnx-versal-vek280-revb boards.

BBMULTICONFIG += " microblaze-0-pmc microblaze-0-psm"

#### Preamble
MACHINEOVERRIDES =. "${@['', 'xlnx-versal-vek280-revb:']['xlnx-versal-vek280-revb' !='${MACHINE}']}"
#### Regular settings follow
TUNEFILE[microblaze-pmc] = "conf/machine/include/xlnx-versal-vek280-revb/microblaze.inc"
TUNEFILE[microblaze-psm] = "conf/machine/include/xlnx-versal-vek280-revb/microblaze.inc"

# Set the default (linux) domain device tree
CONFIG_DTFILE_DIR = "${BSPLAYERDIR_amd-vek280-versal-sdt}/conf/dts/xlnx-versal-vek280-revb"
CONFIG_DTFILE ?= "${CONFIG_DTFILE_DIR}/cortexa72-versal-linux.dts"
CONFIG_DTFILE[vardepsexclude] += "CONFIG_DTFILE_DIR"

# System Device Tree does not use HDF_MACHINE
HDF_MACHINE = ""

# Set the system device trees
SYSTEM_DTFILE_DIR = "${BSPLAYERDIR_amd-vek280-versal-sdt}/sdtgen/vek280_noAIE_SegConfig-vek280-sdtws-2024.2"
SYSTEM_DTFILE = "${SYSTEM_DTFILE_DIR}/system-top.dts"
SYSTEM_DTFILE[vardepsexclude] += "SYSTEM_DTFILE_DIR"

# Load the dynamic machine features
include conf/machine/include/xlnx-versal-vek280-revb/${BB_CURRENT_MC}-features.conf
LIBXIL_CONFIG = "conf/machine/include/xlnx-versal-vek280-revb/${BB_CURRENT_MC}-libxil.conf"

# Platform Loader and Manager
PLM_DEPENDS = ""
PLM_MCDEPENDS = "mc::microblaze-0-pmc:plm-firmware:do_deploy"
PLM_DEPLOY_DIR = "${MC_TMPDIR_PREFIX}-microblaze-0-pmc/deploy/images/${MACHINE}"

# PSM Firware
PSM_DEPENDS = ""
PSM_MCDEPENDS = "mc::microblaze-0-psm:psm-firmware:do_deploy"
PSM_FIRMWARE_DEPLOY_DIR = "${MC_TMPDIR_PREFIX}-microblaze-0-psm/deploy/images/${MACHINE}"

# Versal PDI
PDI_PATH_DIR = "${BSPLAYERDIR_amd-vek280-versal-sdt}/sdtgen/vek280_noAIE_SegConfig-vek280-sdtws-2024.2"
PDI_PATH = "${PDI_PATH_DIR}/vek280_noAIE_SegConfig_boot.pdi"
PDI_PATH[vardepsexclude] += "PDI_PATH_DIR"

# Exclude MC_TMPDIR_PREFIX from hash calculations
MC_TMPDIR_PREFIX ??= "${TMPDIR}"
BB_HASHEXCLUDE_COMMON:append = " MC_TMPDIR_PREFIX"

# Update bootbin to use proper device tree
BIF_PARTITION_IMAGE[device-tree] = "${RECIPE_SYSROOT}/boot/devicetree/${@os.path.basename(d.getVar('CONFIG_DTFILE').replace('.dts', '.dtb'))}"

# Remap boot files to ensure the right device tree is listed first
IMAGE_BOOT_FILES =+ "devicetree/${@os.path.basename(d.getVar('CONFIG_DTFILE').replace('.dts', '.dtb'))}"

# Yocto arm-trusted-firmware(TF-A) variables
ATF_CONSOLE ?= "pl011"
TFA_BL33_LOAD ?= "0x8000000"

# Set DDR Base address for u-boot-xlnx-scr variables
DDR_BASEADDR ?= "0x0"
SKIP_APPEND_BASEADDR ?= "0"

# Yocto KERNEL Variables
UBOOT_ENTRYPOINT  ?= "0x200000"
UBOOT_LOADADDRESS ?= "0x200000"

# Yocto MACHINE_FEATURES Variable
MACHINE_FEATURES += "fpga-overlay"

# Required generic machine inclusion
require conf/machine/versal-ai-edge-generic.conf

# VEK280 board has 12GB memory only but default versal-generic has QB_MEM set to
# 8G, Hence we need set 12G in QB_MEM.
QB_MEM = "-m 12G"

# VEK280 QEMU DTB Settings.
QEMU_HW_DTB_PS = "${QEMU_HW_DTB_PATH}/board-versal-ps-vek280.dtb"
QEMU_HW_DTB_PMC = "${QEMU_HW_DTB_PATH}/board-versal-pmc-virt.dtb"

#### No additional settings should be after the Postamble
#### Postamble
PACKAGE_EXTRA_ARCHS:append = "${@['', ' xlnx_versal_vek280_revb']['xlnx-versal-vek280-revb' != '${MACHINE}']}"
```
